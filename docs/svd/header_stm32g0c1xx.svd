# STM32G0C1xx register map
File version: 1.0
Registers are 32-bit, read-write, reset 0x0 unless marked. A register's access mark holds for its fields unless they carry their own. Offsets are from the block's base; lines under a group give offsets from that group; [hi:lo] are bit positions; {n}, {i} and the like mark numbered series; 'fields as' and 'values as' point back to an identical list; <NAME> marks a mode.

## Memory map
0x40000000 TIM2 — TIM
0x40000400 TIM3 — TIM
0x40000800 TIM4 — TIM
0x40001000 TIM6 — TIM
0x40001400 TIM7 — TIM
0x40002000 TIM14 — TIM
0x40002800 RTC — Real-Time Clock
0x40002C00 WWDG — Window WATCHDOG
0x40003000 IWDG — Independent WATCHDOG
0x40003800 SPI2 — Serial Peripheral Interface
0x40003C00 SPI3 — Serial Peripheral Interface
0x40004400 USART2 — Universal Synchronous Asynchronous Receiver Transmitter
0x40004800 USART3 — Universal Synchronous Asynchronous Receiver Transmitter
0x40004C00 USART4 — Universal Synchronous Asynchronous Receiver Transmitter
0x40005000 USART5 — Universal Synchronous Asynchronous Receiver Transmitter
0x40005400 I2C1 — Inter-integrated Circuit Interface
0x40005800 I2C2 — Inter-integrated Circuit Interface
0x40005C00 USB_DRD_FS — Universal Serial Bus Full Speed Dual Role Device
0x40006400 FDCAN1 — FD Controller Area Network
0x40006500 FDCAN_CONFIG — FD Controller Area Network Configuration
0x40006800 FDCAN2 — FD Controller Area Network
0x40006C00 CRS — Clock Recovery System
0x40007000 PWR — Power Control
0x40007400 DAC — Digital to Analog Converter
0x40007400 DAC1 — Digital to Analog Converter
0x40007800 CEC — HDMI-CEC
0x40007C00 LPTIM1 — LPTIMER
0x40008000 LPUART1 — Universal Synchronous Asynchronous Receiver Transmitter
0x40008400 LPUART2 — Universal Synchronous Asynchronous Receiver Transmitter
0x40008800 I2C3 — Inter-integrated Circuit Interface
0x40009400 LPTIM2 — LPTIMER
0x40009800 USB_DRD_PMA_BUFF — Universal Serial Bus PacketMemoryArea Buffer Descriptor Table
0x4000A000 UCPD1 — UCPD
0x4000A400 UCPD2 — UCPD
0x4000B000 TAMP — Tamper and backup registers
0x40010000 SYSCFG — System configuration controller
0x40010030 VREFBUF
0x40010200 COMP1 — Comparator
0x40010200 COMP12_COMMON
0x40010204 COMP2 — Comparator
0x40010204 COMP23_COMMON
0x40010208 COMP3 — Comparator
0x40012400 ADC1 — Analog to Digital Converter
0x40012C00 TIM1 — TIM
0x40013000 SPI1 — Serial Peripheral Interface
0x40013800 USART1 — Universal Synchronous Asynchronous Receiver Transmitter
0x40013C00 USART6 — Universal Synchronous Asynchronous Receiver Transmitter
0x40014000 TIM15 — TIM
0x40014400 TIM16 — TIM
0x40014800 TIM17 — TIM
0x40015800 DBG — Debug MCU
0x40020000 DMA1
0x40020400 DMA2
0x40020800 DMAMUX1 — DMA Multiplexer
0x40021000 RCC — Reset and Clock Control
0x40021800 EXTI — Asynch Interrupt/Event Controller (EXTI)
0x40022000 FLASH — FLASH Registers
0x40023000 CRC — CRC calculation unit
0x40025000 RNG
0x40026000 AES — AES hardware accelerator
0x40026000 AES1 — AES hardware accelerator
0x50000000 GPIOA — General Purpose I/O
0x50000400 GPIOB — General Purpose I/O
0x50000800 GPIOC — General Purpose I/O
0x50000C00 GPIOD — General Purpose I/O
0x50001000 GPIOE — General Purpose I/O
0x50001400 GPIOF — General Purpose I/O

## Interrupts
0 WWDG — Window WatchDog Interrupt
2 RTC_TAMP (RTC, TAMP) — RTC interrupt through the EXTI line 19 & 21
3 FLASH — FLASH global Interrupt
4 RCC_CRS (CRS, RCC) — RCC and CRS global Interrupt
5 EXTI0_1 (EXTI) — EXTI 0 and 1 Interrupts
6 EXTI2_3 (EXTI) — EXTI Line 2 and 3 Interrupts
7 EXTI4_15 (EXTI) — EXTI Line 4 to 15 Interrupts
8 USB_UCPD1_2 (UCPD1) — USB, UCPD1 and UCPD2 global Interrupt
9 DMA1_Channel1 (DMA1) — DMA1 Channel 1 Interrupt
10 DMA1_Channel2_3 (DMA1) — DMA1 Channel 2 and Channel 3 Interrupts
11 DMA1_Ch4_7_DMA2_Ch1_5_DMAMUX1_OVR (DMA1, DMA2, DMAMUX1) — DMA1 Ch4 to Ch7, DMA2 Ch1 to Ch5 and DMAMUX1 Overrun Interrupts
12 ADC1_COMP (ADC1) — ADC1, COMP1,COMP2, COMP3 Interrupts (combined with EXTI 17 & 18)
13 TIM1_BRK_UP_TRG_COM (TIM1) — TIM1 Break, Update, Trigger and Commutation Interrupts
14 TIM1_CC (TIM1) — TIM1 Capture Compare Interrupt
15 TIM2 — TIM2 Interrupt
16 TIM3_TIM4 (TIM3, TIM4) — TIM3, TIM4 global Interrupt
17 TIM6_DAC_LPTIM1 (TIM6, DAC, LPTIM1) — TIM6, DAC and LPTIM1 global Interrupts
18 TIM7_LPTIM2 (TIM7, LPTIM2) — TIM7 and LPTIM2 global Interrupt
19 TIM14 — TIM14 global Interrupt
20 TIM15 — TIM15 global Interrupt
21 TIM16_FDCAN_IT0 (TIM16) — TIM16, FDCAN1_IT0 and FDCAN2_IT0 Interrupt
22 TIM17_FDCAN_IT1 (TIM17) — TIM17, FDCAN1_IT1 and FDCAN2_IT1 Interrupt
23 I2C1 — I2C1 Interrupt (combined with EXTI 23)
24 I2C2_3 (I2C2) — I2C2, I2C3 Interrupt (combined with EXTI 24 and EXTI 22)
25 SPI1 — SPI1/I2S1 Interrupt
26 SPI2_3 (SPI2) — SPI2/I2S2, SPI3/I2S3 Interrupt
27 USART1 — USART1 Interrupt
28 USART2_LPUART2 (USART2, LPUART2) — USART2 + LPUART2 Interrupt
29 USART3_4_5_6_LPUART1 (USART3, LPUART1) — USART3, USART4, USART5, USART6, LPUART1 globlal Interrupts (combined with EXTI 28)
30 CEC — CEC Interrupt(combined with EXTI 27)
31 AES_RNG (RNG, AES) — AES & RNG Interrupt

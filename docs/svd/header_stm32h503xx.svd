# STM32H503xx register map
File version: 1.0
Registers are 32-bit, read-write, reset 0x0 unless marked. A register's access mark holds for its fields unless they carry their own. Offsets are from the block's base; lines under a group give offsets from that group; [hi:lo] are bit positions; {n}, {i} and the like mark numbered series; 'fields as' and 'values as' point back to an identical list; <NAME> marks a mode.

## Memory map
0x0BF8FE6C NSSLIB_PFUNC — RSSLib secure callable function pointer structure
0x40000000 TIM2 — TIM
0x40000400 TIM3 — TIM
0x40001000 TIM6 — TIM
0x40001400 TIM7 — TIM
0x40002C00 WWDG
0x40003000 IWDG
0x40003400 OPAMP1 — Operational Amplifier (OPAMP)
0x40003800 SPI2 — SPI
0x40003C00 SPI3 — SPI
0x40004000 COMP1 — Comparator
0x40004400 USART2 — Universal Synchronous Asynchronous Receiver Transmitter
0x40004800 USART3 — Universal Synchronous Asynchronous Receiver Transmitter
0x40005400 I2C1 — Inter-integrated Circuit Interface
0x40005800 I2C2 — Inter-integrated Circuit Interface
0x40005C00 I3C1 — Improved Inter-integrated Circuit Interface
0x40006000 CRS — Clock Recovery System
0x40008C00 DTS
0x40009400 LPTIM2 — LPTIMER
0x4000A400 FDCAN1 — FD Controller Area Network
0x4000A500 FDCAN_CONFIG — FD Controller Area Network Configuration
0x40012C00 TIM1 — TIM
0x40013000 SPI1 — SPI
0x40013800 USART1 — Universal Synchronous Asynchronous Receiver Transmitter
0x40016000 USB_DRD_FS — Universal Serial Bus Full Speed Dual Role Device
0x40016400 USB_DRD_PMA_BUFF — Universal Serial Bus PacketMemoryArea Buffer Descriptor Table
0x40020000 GPDMA1 — DMA Controller
0x40021000 GPDMA2 — DMA Controller
0x40022000 FLASH — FLASH Registers
0x40023000 CRC — CRC calculation unit
0x40026000 RAMCFG
0x40026100 RAMCFG_BKPRAM — SRAMs configuration controller
0x40030400 ICACHE — Instruction Cache
0x40032400 GTZC_TZSC1 — Global TrustZone Controller
0x40032C00 GTZC_MPCBB1
0x40033000 GTZC_MPCBB2
0x42020000 GPIOA — General Purpose I/O
0x42020400 GPIOB — General Purpose I/O
0x42020800 GPIOC — General Purpose I/O
0x42020C00 GPIOD — General Purpose I/O
0x42021C00 GPIOH — General Purpose I/O
0x42028000 ADC1 — ADC
0x42028300 ADC12_COMMON
0x42028400 DAC1 — DAC
0x420C0400 HASH
0x420C0800 RNG
0x44000400 SBS — System configuration, Boot and Security
0x44002400 LPUART1 — Universal Synchronous Asynchronous Receiver Transmitter
0x44003000 I3C2 — Improved Inter-integrated Circuit Interface
0x44004400 LPTIM1 — LPTIMER
0x44007800 RTC — Real-Time Clock
0x44007C00 TAMP — Tamper and backup registers
0x44020800 PWR — Power Control
0x44020C00 RCC — Reset and Clock Control
0x44022000 EXTI — Asynch Interrupt/Event Controller (EXTI)
0x44024000 DBGMCU — Debug MCU

## Interrupts
0 WWDG — Window WatchDog interrupt
2 RTC — RTC non-secure interrupt
4 TAMP — Tamper global interrupt
5 RAMCFG — RAMCFG global interrupt
6 FLASH — FLASH non-secure global interrupt
9 RCC — RCC non secure global interrupt
{n+11} EXTI{n} (EXTI) (n=0..15) — EXTI Line{n} interrupt
{n+27} GPDMA1_Channel{n} (GPDMA1) (n=0..7) — GPDMA1 Channel {n} global interrupt
35 IWDG — IWDG global interrupt
37 ADC1 — ADC1 global interrupt
38 DAC1 — DAC1 global interrupt
39 FDCAN1_IT0 (FDCAN1) — FDCAN1 interrupt 0
40 FDCAN1_IT1 (FDCAN1) — FDCAN1 interrupt 1
41 TIM1_BRK (TIM1) — TIM1 Break interrupt
42 TIM1_UP (TIM1) — TIM1 Update interrupt
43 TIM1_TRG_COM (TIM1) — TIM1 Trigger and Commutation interrupt
44 TIM1_CC (TIM1) — TIM1 Capture Compare interrupt
45 TIM2 — TIM2 global interrupt
46 TIM3 — TIM3 global interrupt
49 TIM6 — TIM6 global interrupt
50 TIM7 — TIM7 global interrupt
51 I2C1_EV (I2C1) — I2C1 Event interrupt
52 I2C1_ER (I2C1) — I2C1 Error interrupt
53 I2C2_EV (I2C2) — I2C2 Event interrupt
54 I2C2_ER (I2C2) — I2C2 Error interrupt
55 SPI1 — SPI1 global interrupt
56 SPI2 — SPI2 global interrupt
57 SPI3 — SPI3 global interrupt
58 USART1 — USART1 global interrupt
59 USART2 — USART2 global interrupt
60 USART3 — USART3 global interrupt
63 LPUART1 — LPUART1 global interrupt
64 LPTIM1 — LPTIM1 global interrupt
70 LPTIM2 — LPTIM2 global interrupt
74 USB_DRD_FS — USB FS global interrupt
75 CRS — CRS global interrupt
{n+90} GPDMA2_Channel{n} (GPDMA2) (n=0..7) — GPDMA2 Channel {n} global interrupt
104 ICACHE — Instruction cache global interrupt
113 DTS — DTS global interrupt
114 RNG — RNG global interrupt
117 HASH — HASH global interrupt
123 I3C1_EV (I3C1) — I3C1 event interrupt
124 I3C1_ER (I3C1) — I3C1 error interrupt
131 I3C2_EV (I3C2) — I3C2 Event interrupt
132 I3C2_ER (I3C2) — I3C2 Error interrupt
133 COMP1 — COMP global interrupt

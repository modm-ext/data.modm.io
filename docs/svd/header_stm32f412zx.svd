# STM32F412Zx register map
File version: 1.0
Registers are 32-bit, read-write, reset 0x0 unless marked. A register's access mark holds for its fields unless they carry their own. Offsets are from the block's base; lines under a group give offsets from that group; [hi:lo] are bit positions; {n}, {i} and the like mark numbered series; 'fields as' and 'values as' point back to an identical list; <NAME> marks a mode.

## Memory map
0x40000000 TIM2 — TIM
0x40000400 TIM3 — TIM
0x40000800 TIM4 — TIM
0x40000C00 TIM5 — TIM
0x40001000 TIM6 — TIM
0x40001400 TIM7 — TIM
0x40001800 TIM12 — TIM
0x40001C00 TIM13 — TIM
0x40002000 TIM14 — TIM
0x40002800 RTC — Real-Time Clock
0x40002C00 WWDG — Window WATCHDOG
0x40003000 IWDG — Independent WATCHDOG
0x40003400 I2S2ext — Serial Peripheral Interface
0x40003800 SPI2 — Serial Peripheral Interface
0x40003C00 SPI3 — Serial Peripheral Interface
0x40004000 I2S3ext — Serial Peripheral Interface
0x40004400 USART2 — Universal Synchronous Asynchronous Receiver Transmitter
0x40004800 USART3 — Universal Synchronous Asynchronous Receiver Transmitter
0x40005400 I2C1 — Inter-integrated Circuit Interface
0x40005800 I2C2 — Inter-integrated Circuit Interface
0x40005C00 I2C3 — Inter-integrated Circuit Interface
0x40006000 FMPI2C1 — Inter-integrated Circuit Interface
0x40006400 CAN1 — Controller Area Network
0x40006800 CAN2 — Controller Area Network
0x40007000 PWR — Power Control
0x40010000 TIM1 — TIM
0x40010400 TIM8 — TIM
0x40011000 USART1 — Universal Synchronous Asynchronous Receiver Transmitter
0x40011400 USART6 — Universal Synchronous Asynchronous Receiver Transmitter
0x40012000 ADC1 — Analog to Digital Converter
0x40012C00 SDIO — SD host Interface
0x40013000 SPI1 — Serial Peripheral Interface
0x40013400 SPI4 — Serial Peripheral Interface
0x40013800 SYSCFG — System configuration controller
0x40013C00 EXTI — External Interrupt/Event Controller
0x40014000 TIM9 — TIM
0x40014400 TIM10 — TIM
0x40014800 TIM11 — TIM
0x40015000 SPI5 — Serial Peripheral Interface
0x40016000 DFSDM1
0x40020000 GPIOA — General Purpose I/O
0x40020400 GPIOB — General Purpose I/O
0x40020800 GPIOC — General Purpose I/O
0x40020C00 GPIOD — General Purpose I/O
0x40021000 GPIOE — General Purpose I/O
0x40021400 GPIOF — General Purpose I/O
0x40021800 GPIOG — General Purpose I/O
0x40021C00 GPIOH — General Purpose I/O
0x40023000 CRC — CRC calculation unit
0x40023800 RCC — Reset and Clock Control
0x40023C00 FLASH — FLASH Registers
0x40026000 DMA1
0x40026400 DMA2
0x50000000 USB_OTG_FS — USB_OTG_Core_Registers
0x50060800 RNG
0xA0000000 FSMC_Bank1 — Flexible Static Memory Controller
0xA0000104 FSMC_Bank1E — Flexible Static Memory Controller Bank1E
0xA0001000 QUADSPI — QUAD Serial Peripheral Interface
0xE0042000 DBGMCU — Debug MCU

## Interrupts
0 WWDG — Window WatchDog Interrupt
3 RTC_WKUP (RTC) — RTC Wakeup interrupt through the EXTI line
4 FLASH — FLASH global Interrupt
5 RCC — RCC global Interrupt
6 EXTI0 (EXTI) — EXTI Line0 Interrupt
7 EXTI1 (EXTI) — EXTI Line1 Interrupt
8 EXTI2 (EXTI) — EXTI Line2 Interrupt
9 EXTI3 (EXTI) — EXTI Line3 Interrupt
10 EXTI4 (EXTI) — EXTI Line4 Interrupt
11 DMA1_Stream0 (DMA1) — DMA1 Stream 0 global Interrupt
12 DMA1_Stream1 (DMA1) — DMA1 Stream 1 global Interrupt
13 DMA1_Stream2 (DMA1) — DMA1 Stream 2 global Interrupt
14 DMA1_Stream3 (DMA1) — DMA1 Stream 3 global Interrupt
15 DMA1_Stream4 (DMA1) — DMA1 Stream 4 global Interrupt
16 DMA1_Stream5 (DMA1) — DMA1 Stream 5 global Interrupt
17 DMA1_Stream6 (DMA1) — DMA1 Stream 6 global Interrupt
18 ADC (ADC1) — ADC1, ADC2 and ADC3 global Interrupts
19 CAN1_TX (CAN1) — CAN1 TX Interrupt
20 CAN1_RX0 (CAN1) — CAN1 RX0 Interrupt
21 CAN1_RX1 (CAN1) — CAN1 RX1 Interrupt
22 CAN1_SCE (CAN1) — CAN1 SCE Interrupt
23 EXTI9_5 (EXTI) — External Line[9:5] Interrupts
24 TIM1_BRK_TIM9 (TIM1, TIM9) — TIM1 Break interrupt and TIM9 global interrupt
25 TIM1_UP_TIM10 (TIM10) — TIM1 Update Interrupt and TIM10 global interrupt
26 TIM1_TRG_COM_TIM11 (TIM11) — TIM1 Trigger and Commutation Interrupt and TIM11 global interrupt
27 TIM1_CC (TIM1) — TIM1 Capture Compare Interrupt
28 TIM2 — TIM2 global Interrupt
29 TIM3 — TIM3 global Interrupt
30 TIM4 — TIM4 global Interrupt
31 I2C1_EV (I2C1) — I2C1 Event Interrupt
32 I2C1_ER (I2C1) — I2C1 Error Interrupt
33 I2C2_EV (I2C2) — I2C2 Event Interrupt
34 I2C2_ER (I2C2) — I2C2 Error Interrupt
35 SPI1 — SPI1 global Interrupt
36 SPI2 — SPI2 global Interrupt
37 USART1 — USART1 global Interrupt
38 USART2 — USART2 global Interrupt
39 USART3 — USART3 global Interrupt
40 EXTI15_10 (EXTI) — External Line[15:10] Interrupts
41 RTC_Alarm (RTC) — RTC Alarm (A and B) through EXTI Line Interrupt
42 OTG_FS_WKUP (USB_OTG_FS) — USB OTG FS Wakeup through EXTI line interrupt
43 TIM8_BRK_TIM12 (TIM12, TIM8) — TIM8 Break Interrupt and TIM12 global interrupt
44 TIM8_UP_TIM13 (TIM13, TIM8) — TIM8 Update Interrupt and TIM13 global interrupt
45 TIM8_TRG_COM_TIM14 (TIM14, TIM8) — TIM8 Trigger and Commutation Interrupt and TIM14 global interrupt
46 TIM8_CC (TIM8) — TIM8 Capture Compare global interrupt
47 DMA1_Stream7 (DMA1) — DMA1 Stream7 Interrupt
49 SDIO — SDIO global Interrupt
50 TIM5 — TIM5 global Interrupt
51 SPI3 — SPI3 global Interrupt
54 TIM6 — TIM6 global interrupt
55 TIM7 — TIM7 global interrupt
56 DMA2_Stream0 (DMA2) — DMA2 Stream 0 global Interrupt
57 DMA2_Stream1 (DMA2) — DMA2 Stream 1 global Interrupt
58 DMA2_Stream2 (DMA2) — DMA2 Stream 2 global Interrupt
59 DMA2_Stream3 (DMA2) — DMA2 Stream 3 global Interrupt
60 DMA2_Stream4 (DMA2) — DMA2 Stream 4 global Interrupt
61 DFSDM1_FLT0 (DFSDM1) — DFSDM1 Filter 0 global Interrupt
62 DFSDM1_FLT1 (DFSDM1) — DFSDM1 Filter 1 global Interrupt
63 CAN2_TX (CAN2) — CAN2 TX Interrupt
64 CAN2_RX0 (CAN2) — CAN2 RX0 Interrupt
65 CAN2_RX1 (CAN2) — CAN2 RX1 Interrupt
66 CAN2_SCE (CAN2) — CAN2 SCE Interrupt
67 OTG_FS (USB_OTG_FS) — USB OTG FS global Interrupt
68 DMA2_Stream5 (DMA2) — DMA2 Stream 5 global interrupt
69 DMA2_Stream6 (DMA2) — DMA2 Stream 6 global interrupt
70 DMA2_Stream7 (DMA2) — DMA2 Stream 7 global interrupt
71 USART6 — USART6 global interrupt
72 I2C3_EV (I2C3) — I2C3 event interrupt
73 I2C3_ER (I2C3) — I2C3 error interrupt
80 RNG — RNG global Interrupt
84 SPI4 — SPI4 global Interrupt
85 SPI5 — SPI5 global Interrupt
92 QUADSPI — QuadSPI global Interrupt
95 FMPI2C1_EV (FMPI2C1) — FMPI2C1 Event Interrupt
96 FMPI2C1_ER (FMPI2C1) — FMPI2C1 Error Interrupt

# STM32L562xx register map
File version: 1.0
Registers are 32-bit, read-write, reset 0x0 unless marked. A register's access mark holds for its fields unless they carry their own. Offsets are from the block's base; lines under a group give offsets from that group; [hi:lo] are bit positions; {n}, {i} and the like mark numbered series; 'fields as' and 'values as' point back to an identical list; <NAME> marks a mode.

## Memory map
0x0BF97F40 RSSLIB_PFUNC — RSSLib function pointer structure
0x40000000 TIM2 — TIM
0x40000400 TIM3 — TIM
0x40000800 TIM4 — TIM
0x40000C00 TIM5 — TIM
0x40001000 TIM6 — TIM
0x40001400 TIM7 — TIM
0x40002800 RTC — Real-Time Clock
0x40002C00 WWDG — Window WATCHDOG
0x40003000 IWDG — Independent WATCHDOG
0x40003400 TAMP — Tamper and backup registers
0x40003800 SPI2 — Serial Peripheral Interface
0x40003C00 SPI3 — Serial Peripheral Interface
0x40004400 USART2 — Universal Synchronous Asynchronous Receiver Transmitter
0x40004800 USART3 — Universal Synchronous Asynchronous Receiver Transmitter
0x40004C00 UART4 — Universal Synchronous Asynchronous Receiver Transmitter
0x40005000 UART5 — Universal Synchronous Asynchronous Receiver Transmitter
0x40005400 I2C1 — Inter-integrated Circuit Interface
0x40005800 I2C2 — Inter-integrated Circuit Interface
0x40005C00 I2C3 — Inter-integrated Circuit Interface
0x40006000 CRS — Clock Recovery System
0x40007000 PWR — Power Control
0x40007400 DAC1 — Digital to Analog Converter
0x40007400 DAC — Digital to Analog Converter
0x40007800 OPAMP12_COMMON
0x40007800 OPAMP1 — Operational Amplifier (OPAMP)
0x40007800 OPAMP — Operational Amplifier (OPAMP)
0x40007810 OPAMP2 — Operational Amplifier (OPAMP)
0x40007C00 LPTIM1 — LPTIMER
0x40008000 LPUART1 — Universal Synchronous Asynchronous Receiver Transmitter
0x40008400 I2C4 — Inter-integrated Circuit Interface
0x40009400 LPTIM2 — LPTIMER
0x40009800 LPTIM3 — LPTIMER
0x4000A400 FDCAN1 — FD Controller Area Network
0x4000A500 FDCAN_CONFIG — FD Controller Area Network Configuration
0x4000D400 USB — Universal Serial Bus Full Speed Device
0x4000DC00 UCPD1 — UCPD
0x40010000 SYSCFG — System configuration controller
0x40010100 VREFBUF
0x40010200 COMP1 — Comparator
0x40010204 COMP12_COMMON
0x40010204 COMP2 — Comparator
0x40012C00 TIM1 — TIM
0x40013000 SPI1 — Serial Peripheral Interface
0x40013400 TIM8 — TIM
0x40013800 USART1 — Universal Synchronous Asynchronous Receiver Transmitter
0x40014000 TIM15 — TIM
0x40014400 TIM16 — TIM
0x40014800 TIM17 — TIM
0x40015400 SAI1 — Serial Audio Interface
0x40015800 SAI2 — Serial Audio Interface
0x40016000 DFSDM1
0x40020000 DMA1 — DMA Controller
0x40020400 DMA2 — DMA Controller
0x40020800 DMAMUX1 — DMA Multiplexer
0x40021000 RCC — Reset and Clock Control
0x40022000 FLASH — FLASH Registers
0x40023000 CRC — CRC calculation unit
0x40024000 TSC — Touch Sensing Controller (TSC)
0x4002F400 EXTI — Asynch Interrupt/Event Controller (EXTI)
0x40030400 ICACHE — Instruction Cache
0x40032400 GTZC_TZSC — Global TrustZone Controller
0x40032800 GTZC_TZIC
0x40032C00 GTZC_MPCBB1
0x40033000 GTZC_MPCBB2
0x42020000 GPIOA — General Purpose I/O
0x42020400 GPIOB — General Purpose I/O
0x42020800 GPIOC — General Purpose I/O
0x42020C00 GPIOD — General Purpose I/O
0x42021000 GPIOE — General Purpose I/O
0x42021400 GPIOF — General Purpose I/O
0x42021800 GPIOG — General Purpose I/O
0x42021C00 GPIOH — General Purpose I/O
0x42028000 ADC1 — Analog to Digital Converter
0x42028100 ADC2 — Analog to Digital Converter
0x42028300 ADC12_COMMON
0x420C0000 AES — AES hardware accelerator
0x420C0400 HASH
0x420C0800 RNG
0x420C2000 PKA — Public Key Accelerator (PKA)
0x420C5000 OTFDEC1
0x420C8000 SDMMC1 — Secure digital input/output Interface
0x44020000 FMC_Bank1_R — Flexible Memory Controller
0x44020080 FMC_Bank3_R — Flexible Memory Controller Bank3
0x44020104 FMC_Bank1E_R — Flexible Memory Controller Bank1E
0x44021000 OCTOSPI1 — OCTO Serial Peripheral Interface
0x50000000 TIM2_S — TIM
0x50000400 TIM3_S — TIM
0x50000800 TIM4_S — TIM
0x50000C00 TIM5_S — TIM
0x50001000 TIM6_S — TIM
0x50001400 TIM7_S — TIM
0x50002800 RTC_S — Real-Time Clock
0x50002C00 WWDG_S — Window WATCHDOG
0x50003000 IWDG_S — Independent WATCHDOG
0x50003400 TAMP_S — Tamper and backup registers
0x50003800 SPI2_S — Serial Peripheral Interface
0x50003C00 SPI3_S — Serial Peripheral Interface
0x50004400 USART2_S — Universal Synchronous Asynchronous Receiver Transmitter
0x50004800 USART3_S — Universal Synchronous Asynchronous Receiver Transmitter
0x50004C00 UART4_S — Universal Synchronous Asynchronous Receiver Transmitter
0x50005000 UART5_S — Universal Synchronous Asynchronous Receiver Transmitter
0x50005400 I2C1_S — Inter-integrated Circuit Interface
0x50005800 I2C2_S — Inter-integrated Circuit Interface
0x50005C00 I2C3_S — Inter-integrated Circuit Interface
0x50006000 CRS_S — Clock Recovery System
0x50007000 PWR_S — Power Control
0x50007400 DAC1_S — Digital to Analog Converter
0x50007400 DAC_S — Digital to Analog Converter
0x50007800 OPAMP12_COMMON_S
0x50007800 OPAMP1_S — Operational Amplifier (OPAMP)
0x50007800 OPAMP_S — Operational Amplifier (OPAMP)
0x50007810 OPAMP2_S — Operational Amplifier (OPAMP)
0x50007C00 LPTIM1_S — LPTIMER
0x50008000 LPUART1_S — Universal Synchronous Asynchronous Receiver Transmitter
0x50008400 I2C4_S — Inter-integrated Circuit Interface
0x50009400 LPTIM2_S — LPTIMER
0x50009800 LPTIM3_S — LPTIMER
0x5000A400 FDCAN1_S — FD Controller Area Network
0x5000A500 FDCAN_CONFIG_S — FD Controller Area Network Configuration
0x5000D400 USB_S — Universal Serial Bus Full Speed Device
0x5000DC00 UCPD1_S — UCPD
0x50010000 SYSCFG_S — System configuration controller
0x50010100 VREFBUF_S — VREFBUF
0x50010200 COMP1_S — Comparator
0x50010204 COMP12_COMMON_S
0x50010204 COMP2_S — Comparator
0x50012C00 TIM1_S — TIM
0x50013000 SPI1_S — Serial Peripheral Interface
0x50013400 TIM8_S — TIM
0x50013800 USART1_S — Universal Synchronous Asynchronous Receiver Transmitter
0x50014000 TIM15_S — TIM
0x50014400 TIM16_S — TIM
0x50014800 TIM17_S — TIM
0x50015400 SAI1_S — Serial Audio Interface
0x50015800 SAI2_S — Serial Audio Interface
0x50016000 DFSDM1_S
0x50020000 DMA1_S — DMA Controller
0x50020400 DMA2_S — DMA Controller
0x50020800 DMAMUX1_S — DMA Multiplexer
0x50021000 RCC_S — Reset and Clock Control
0x50022000 FLASH_S — FLASH Registers
0x50023000 CRC_S — CRC calculation unit
0x50024000 TSC_S — Touch Sensing Controller (TSC)
0x5002F400 EXTI_S — Asynch Interrupt/Event Controller (EXTI)
0x50030400 ICACHE_S — Instruction Cache
0x50032400 GTZC_TZSC_S — Global TrustZone Controller
0x50032800 GTZC_TZIC_S
0x50032C00 GTZC_MPCBB1_S
0x50033000 GTZC_MPCBB2_S
0x52020000 GPIOA_S — General Purpose I/O
0x52020400 GPIOB_S — General Purpose I/O
0x52020800 GPIOC_S — General Purpose I/O
0x52020C00 GPIOD_S — General Purpose I/O
0x52021000 GPIOE_S — General Purpose I/O
0x52021400 GPIOF_S — General Purpose I/O
0x52021800 GPIOG_S — General Purpose I/O
0x52021C00 GPIOH_S — General Purpose I/O
0x52028000 ADC1_S — Analog to Digital Converter
0x52028100 ADC2_S — Analog to Digital Converter
0x52028300 ADC12_COMMON_S
0x520C0000 AES_S — AES hardware accelerator
0x520C0400 HASH_S — HASH
0x520C0800 RNG_S — RNG
0x520C2000 PKA_S — Public Key Accelerator (PKA)
0x520C5000 OTFDEC1_S
0x520C8000 SDMMC1_S — Secure digital input/output Interface
0x54020000 FMC_Bank1_R_S — Flexible Memory Controller
0x54020080 FMC_Bank3_R_S — Flexible Memory Controller Bank3
0x54020104 FMC_Bank1E_R_S — Flexible Memory Controller Bank1E
0x54021000 OCTOSPI1_S — OCTO Serial Peripheral Interface
0xE0044000 DBGMCU — Debug MCU

## Interrupts
0 WWDG — Window WatchDog interrupt
2 RTC — RTC non-secure interrupts through the EXTI line 17
3 RTC_S — RTC secure interrupts through the EXTI line 18
4 TAMP — Tamper non-secure interrupts through the EXTI line 19
5 TAMP_S — Tamper and TimeStamp interrupts through the EXTI line 20
6 FLASH — FLASH non-secure global interrupt
7 FLASH_S — FLASH secure global interrupt
9 RCC — RCC non secure global interrupt
10 RCC_S — RCC secure global interrupt
{n+11} EXTI{n} (EXTI) (n=0..15) — EXTI Line{n} interrupt
27 DMAMUX1 — DMAMUX1 non-secure interrupt
28 DMAMUX1_S — DMAMUX1 secure interrupt
{n+28} DMA1_Channel{n} (DMA1) (n=1..8) — DMA1 Channel {n} global interrupt
37 ADC1_2 (ADC1) — ADC1 & ADC2 global interrupts
38 DAC — DAC global interrupts
39 FDCAN1_IT0 (FDCAN1) — FDCAN1 interrupt 0
40 FDCAN1_IT1 (FDCAN1) — FDCAN1 interrupt 1
41 TIM1_BRK (TIM1) — TIM1 Break interrupt
42 TIM1_UP (TIM1) — TIM1 Update interrupt
43 TIM1_TRG_COM (TIM1) — TIM1 Trigger and Commutation interrupt
44 TIM1_CC (TIM1) — TIM1 Capture Compare interrupt
45 TIM2 — TIM2 global interrupt
46 TIM3 — TIM3 global interrupt
47 TIM4 — TIM4 global interrupt
48 TIM5 — TIM5 global interrupt
49 TIM6 — TIM6 global interrupt
50 TIM7 — TIM7 global interrupt
51 TIM8_BRK (TIM8) — TIM8 Break interrupt
52 TIM8_UP (TIM8) — TIM8 Update interrupt
53 TIM8_TRG_COM (TIM8) — TIM8 Trigger and Commutation interrupt
54 TIM8_CC (TIM8) — TIM8 Capture Compare interrupt
55 I2C1_EV (I2C1) — I2C1 Event interrupt
56 I2C1_ER (I2C1) — I2C1 Error interrupt
57 I2C2_EV (I2C2) — I2C2 Event interrupt
58 I2C2_ER (I2C2) — I2C2 Error interrupt
59 SPI1 — SPI1 global interrupt
60 SPI2 — SPI2 global interrupt
61 USART1 — USART1 global interrupt
62 USART2 — USART2 global interrupt
63 USART3 — USART3 global interrupt
64 UART4 — UART4 global interrupt
65 UART5 — UART5 global interrupt
66 LPUART1 — LPUART1 global interrupt
67 LPTIM1 — LPTIM1 global interrupt
68 LPTIM2 — LPTIM2 global interrupt
69 TIM15 — TIM15 global interrupt
70 TIM16 — TIM16 global interrupt
71 TIM17 — TIM17 global interrupt
72 COMP (COMP1, COMP2) — COMP1 and COMP2 through EXTI Lines interrupts
73 USB_FS (USB) — USB FS global interrupt
74 CRS — CRS global interrupt
76 OCTOSPI1 — OctoSPI1 global interrupt
78 SDMMC1 — SDMMC1 global interrupt
{n+79} DMA2_Channel{n} (DMA2) (n=1..8) — DMA2 Channel {n} global interrupt
88 I2C3_EV (I2C3) — I2C3 event interrupt
89 I2C3_ER (I2C3) — I2C3 error interrupt
90 SAI1 — Serial Audio Interface 1 global interrupt
91 SAI2 — Serial Audio Interface 2 global interrupt
92 TSC — Touch Sense Controller global interrupt
93 AES — AES global interrupt
94 RNG — RNG global interrupt
96 HASH — HASH global interrupt
97 PKA — PKA global interrupt
98 LPTIM3 — LPTIM3 global interrupt
99 SPI3 — SPI3 global interrupt
100 I2C4_ER (I2C4) — I2C4 Error interrupt
101 I2C4_EV (I2C4) — I2C4 Event interrupt
102 DFSDM1_FLT0 (DFSDM1) — DFSDM1 Filter 0 global interrupt
103 DFSDM1_FLT1 (DFSDM1) — DFSDM1 Filter 1 global interrupt
104 DFSDM1_FLT2 (DFSDM1) — DFSDM1 Filter 2 global interrupt
105 DFSDM1_FLT3 (DFSDM1) — DFSDM1 Filter 3 global interrupt
106 UCPD1 — UCPD1 global interrupt
107 ICACHE — Instruction cache global interrupt
108 OTFDEC1 — OTFDEC1 global interrupt

# STM32F373xC register map
File version: 1.0
Registers are 32-bit, read-write, reset 0x0 unless marked. A register's access mark holds for its fields unless they carry their own. Offsets are from the block's base; lines under a group give offsets from that group; [hi:lo] are bit positions; {n}, {i} and the like mark numbered series; 'fields as' and 'values as' point back to an identical list; <NAME> marks a mode.

## Memory map
0x1FFFF800 OB — Option Bytes Registers
0x40000000 TIM2 — TIM
0x40000400 TIM3 — TIM
0x40000800 TIM4 — TIM
0x40000C00 TIM5 — TIM
0x40001000 TIM6 — TIM
0x40001400 TIM7 — TIM
0x40001800 TIM12 — TIM
0x40001C00 TIM13 — TIM
0x40002000 TIM14 — TIM
0x40002800 RTC — Real-Time Clock
0x40002C00 WWDG — Window WATCHDOG
0x40003000 IWDG — Independent WATCHDOG
0x40003800 SPI2 — Serial Peripheral Interface
0x40003C00 SPI3 — Serial Peripheral Interface
0x40004400 USART2 — Universal Synchronous Asynchronous Receiver Transmitter
0x40004800 USART3 — Universal Synchronous Asynchronous Receiver Transmitter
0x40005400 I2C1 — Inter-integrated Circuit Interface
0x40005800 I2C2 — Inter-integrated Circuit Interface
0x40005C00 USB — Universal Serial Bus Full Speed Device
0x40006400 CAN — Controller Area Network
0x40007000 PWR — Power Control
0x40007400 DAC — Digital to Analog Converter
0x40007400 DAC1 — Digital to Analog Converter
0x40007800 CEC — Consumer Electronics Control
0x40009800 DAC2 — Digital to Analog Converter
0x40009C00 TIM18 — TIM
0x40010000 SYSCFG — System configuration controller
0x4001001C COMP
0x4001001C COMP1 — Analog Comparators
0x4001001C COMP12_COMMON
0x4001001E COMP2 — Analog Comparators
0x40010400 EXTI — External Interrupt/Event Controller
0x40012400 ADC1 — Analog to Digital Converter
0x40013000 SPI1 — Serial Peripheral Interface
0x40013800 USART1 — Universal Synchronous Asynchronous Receiver Transmitter
0x40014000 TIM15 — TIM
0x40014400 TIM16 — TIM
0x40014800 TIM17 — TIM
0x40015C00 TIM19 — TIM
0x40016000 SDADC1 — Sigma-Delta Analog to Digital Converter (SDADC)
0x40016400 SDADC2 — Sigma-Delta Analog to Digital Converter (SDADC)
0x40016800 SDADC3 — Sigma-Delta Analog to Digital Converter (SDADC)
0x40020000 DMA1
0x40020400 DMA2
0x40021000 RCC — Reset and Clock Control
0x40022000 FLASH — FLASH Registers
0x40023000 CRC — CRC calculation unit
0x40024000 TSC — Touch Sensing Controller (TSC)
0x48000000 GPIOA — General Purpose I/O
0x48000400 GPIOB — General Purpose I/O
0x48000800 GPIOC — General Purpose I/O
0x48000C00 GPIOD — General Purpose I/O
0x48001000 GPIOE — General Purpose I/O
0x48001400 GPIOF — General Purpose I/O
0xE0042000 DBGMCU — Debug MCU

## Interrupts
0 WWDG — Window WatchDog Interrupt
3 RTC_WKUP (RTC) — RTC Wakeup interrupt through the EXTI line 20
4 FLASH — FLASH global Interrupt
5 RCC — RCC global Interrupt
6 EXTI0 (EXTI) — EXTI Line0 Interrupt
7 EXTI1 (EXTI) — EXTI Line1 Interrupt
8 EXTI2_TSC (TSC) — EXTI Line2 Interrupt and Touch Sense Controller Interrupt
9 EXTI3 (EXTI) — EXTI Line3 Interrupt
10 EXTI4 (EXTI) — EXTI Line4 Interrupt
11 DMA1_Channel1 (DMA1) — DMA1 Channel 1 Interrupt
12 DMA1_Channel2 (DMA1) — DMA1 Channel 2 Interrupt
13 DMA1_Channel3 (DMA1) — DMA1 Channel 3 Interrupt
14 DMA1_Channel4 (DMA1) — DMA1 Channel 4 Interrupt
15 DMA1_Channel5 (DMA1) — DMA1 Channel 5 Interrupt
16 DMA1_Channel6 (DMA1) — DMA1 Channel 6 Interrupt
17 DMA1_Channel7 (DMA1) — DMA1 Channel 7 Interrupt
18 ADC1 — ADC1 Interrupts
19 CAN_TX (CAN) — CAN TX Interrupt
20 CAN_RX0 (CAN) — CAN RX0 Interrupt
21 CAN_RX1 (CAN) — CAN RX1 Interrupt
22 CAN_SCE (CAN) — CAN SCE Interrupt
23 EXTI9_5 (EXTI) — External Line[9:5] Interrupts
24 TIM15 — TIM15 global Interrupt
25 TIM16 — TIM16 global Interrupt
26 TIM17 — TIM17 global Interrupt
27 TIM18_DAC2 (DAC2, TIM18) — TIM18 global Interrupt and DAC2 underrun Interrupt
28 TIM2 — TIM2 global Interrupt
29 TIM3 — TIM3 global Interrupt
30 TIM4 — TIM4 global Interrupt
31 I2C1_EV (I2C1) — I2C1 Event Interrupt & EXTI Line23 Interrupt (I2C1 wakeup)
32 I2C1_ER (I2C1) — I2C1 Error Interrupt
33 I2C2_EV (I2C2) — I2C2 Event Interrupt & EXTI Line24 Interrupt (I2C2 wakeup)
34 I2C2_ER (I2C2) — I2C2 Error Interrupt
35 SPI1 — SPI1 global Interrupt
36 SPI2 — SPI2 global Interrupt
37 USART1 — USART1 global Interrupt & EXTI Line25 Interrupt (USART1 wakeup)
38 USART2 — USART2 global Interrupt & EXTI Line26 Interrupt (USART2 wakeup)
39 USART3 — USART3 global Interrupt & EXTI Line28 Interrupt (USART3 wakeup)
40 EXTI15_10 (EXTI) — External Line[15:10] Interrupts
41 RTC_Alarm (RTC) — RTC Alarm (A and B) through EXTI Line 17 Interrupt
42 CEC — CEC Interrupt & EXTI Line27 Interrupt (CEC wakeup)
43 TIM12 — TIM12 global interrupt
44 TIM13 — TIM13 global interrupt
45 TIM14 — TIM14 global interrupt
50 TIM5 — TIM5 global Interrupt
51 SPI3 — SPI3 global Interrupt
54 TIM6_DAC1 (TIM6, DAC1) — TIM6 global and DAC1 underrun error Interrupts
55 TIM7 — TIM7 global Interrupt
56 DMA2_Channel1 (DMA2) — DMA2 Channel 1 global Interrupt
57 DMA2_Channel2 (DMA2) — DMA2 Channel 2 global Interrupt
58 DMA2_Channel3 (DMA2) — DMA2 Channel 3 global Interrupt
59 DMA2_Channel4 (DMA2) — DMA2 Channel 4 global Interrupt
60 DMA2_Channel5 (DMA2) — DMA2 Channel 5 global Interrupt
61 SDADC1 — ADC Sigma Delta 1 global Interrupt
62 SDADC2 — ADC Sigma Delta 2 global Interrupt
63 SDADC3 — ADC Sigma Delta 1 global Interrupt
64 COMP — COMP1 and COMP2 global Interrupt
74 USB_HP (USB) — USB High Priority global Interrupt
75 USB_LP (USB) — USB Low Priority global Interrupt
78 TIM19 — TIM19 global Interrupt

# STM32G544xx register map
File version: 1.0
Registers are 32-bit, read-write, reset 0x0 unless marked. A register's access mark holds for its fields unless they carry their own. Offsets are from the block's base; lines under a group give offsets from that group; [hi:lo] are bit positions; {n}, {i} and the like mark numbered series; 'fields as' and 'values as' point back to an identical list; <NAME> marks a mode.

## Memory map
0x0BFADB68 RSSLIB_PFUNC — RSSLib function pointer structure
0x0BFADB6C NSSLIB_PFUNC — RSSLib secure callable function pointer structure
0x40000000 TIM2 — Timer (TIM)
0x40001000 TIM6 — Timer (TIM)
0x40001400 TIM7 — Timer (TIM)
0x40001800 TIM9 — Timer (TIM)
0x40001C00 TIM10 — Timer (TIM)
0x40002000 TIM11 — Timer (TIM)
0x40002400 TIM12 — Timer (TIM)
0x40002800 TIM13 — Timer (TIM)
0x40002C00 TIM14 — Timer (TIM)
0x40003000 WWDG — System window watchdog (WWDG)
0x40003400 IWDG — Independent watchdog (IWDG)
0x40003800 SPI2 — Serial peripheral interface (SPI)
0x40004400 USART2 — Universal synchronous asynchronous receiver transmitter (USART)
0x40004C00 UART4 — Universal synchronous asynchronous receiver transmitter (USART)
0x40005000 UART5 — Universal synchronous asynchronous receiver transmitter (USART)
0x40005400 I2C1 — Inter-integrated circuit interface (I2C)
0x40005800 I2C2 — Inter-integrated circuit interface (I2C)
0x40005C00 I3C1 — Improved inter-integrated circuit (I3C)
0x40006400 UART6 — Universal synchronous asynchronous receiver transmitter (USART)
0x40008C00 DTS — Digital temperature sensor (DTS)
0x4000A000 FDCAN1 — FD Controller Area Network (FDCAN)
0x4000A100 FDCAN_CONFIG — FD Controller Area Network Configuration
0x40010000 HRTIM1
0x40012C00 TIM1 — Timer (TIM)
0x40013000 SPI1 — Serial peripheral interface (SPI)
0x40013400 TIM8 — Timer (TIM)
0x40013800 USART1 — Universal synchronous asynchronous receiver transmitter (USART)
0x40014000 TIM15 — Timer (TIM)
0x40014400 TIM16 — Timer (TIM)
0x40014800 TIM17 — Timer (TIM)
0x40020000 GPDMA1 — DMA Controller (DMA)
0x40021000 GPDMA2 — DMA Controller (DMA)
0x40022000 FLASH — Embedded flash memory (FLASH)
0x40023000 CRC — Cyclic redundancy check calculation unit (CRC)
0x40023800 CORDIC1 — CORDIC coprocessor (CORDIC)
0x40023C00 FMAC1 — Filter math accelerator (FMAC)
0x40026000 RAMCFG
0x40030400 ICACHE — Instruction cache (ICACHE)
0x40032400 GTZC1_TZSC1_PERIPH
0x40032800 GTZC1_TZIC1
0x40032C00 GTZC1_MPCBB1
0x40033000 GTZC1_MPCBB2
0x42020000 ADC1 — Analog to Digital Converter (ADC)
0x42020100 ADC2 — Analog to Digital Converter (ADC)
0x42020300 ADC12_COMMON
0x42021400 DAC1 — Digital to Analog Converter (DAC)
0x42021800 DAC2 — Digital to Analog Converter (DAC)
0x42022400 DAC5 — Digital to Analog Converter (DAC)
0x42022800 DAC6 — Digital to Analog Converter (DAC)
0x42022C00 DAC7 — Digital to Analog Converter (DAC)
0x42023000 DAC8 — Digital to Analog Converter (DAC)
0x42023400 DAC9 — Digital to Analog Converter (DAC)
0x42023800 DAC10 — Digital to Analog Converter (DAC)
0x44000400 SBS — System configuration, boot and security (SBS)
0x44000C00 TIM26 — Timer (TIM)
0x44001000 TIM27 — Timer (TIM)
0x44002400 LPUART1 — Universal synchronous asynchronous receiver transmitter (USART)
0x44004400 LPTIM1 — Low-power timer (LPTIM)
0x44007400 VREFBUF — Voltage reference buffer (VREFBUF)
0x44007800 RTC — Real-time clock (RTC)
0x44007C00 TAMP — Tamper and backup registers (TAMP)
0x44008400 COMP12_COMMON
{0x44008000+0x400*n} COMP{n} (n=1..8) — Comparator (COMP)
0x44008C00 COMP34_COMMON
0x44009400 COMP56_COMMON
0x44009C00 COMP78_COMMON
0x44020800 PWR — Power Control (PWR)
0x44020C00 RCC — Reset and clock control (RCC)
0x44022000 EXTI — Extended interrupts and event controller (EXTI)
0x44026000 DBGMCU — Microcontroller debug unit (DBGMCU)
0x46000000 GPIOA — General-purpose I/Os (GPIO)
0x46000400 GPIOB — General-purpose I/Os (GPIO)
0x46000800 GPIOC — General-purpose I/Os (GPIO)
0x46000C00 GPIOD — General-purpose I/Os (GPIO)
0x46001000 GPIOE — General-purpose I/Os (GPIO)
0x46001400 GPIOF — General-purpose I/Os (GPIO)
0x46001800 GPIOG — General-purpose I/Os (GPIO)
0x46001C00 GPIOH — General-purpose I/Os (GPIO)
0x46006000 AES — AES hardware accelerator (AES)
0x46006400 HASH — Hash processor (HASH)
0x46006800 RNG — True random number generator (RNG)
0x46008000 PKA — Public key accelerator (PKA)

## Interrupts
0 WWDG — Window Watchdog interrupt
2 IWDG — Independent watchdog interrupt
4 PWR_PVD_AVD (PWR) — Power Voltage Monitor/Analog Voltage Monitor
5 TAMP — Tamper global interrupts
7 FLASH_S (FLASH) — Flash secure global interrupt
8 FLASH — Flash non-secure global interrupt
11 RAMCFG — RAM configuration global interrupt
12 RCC_S (RCC) — RCC secure global interrupt
13 RCC — RCC non-secure global interrupt
14 ICACHE — Instruction cache global interrupt
17 RTC_S (RTC) — RTC global secure interrupts
18 RTC — RTC global non-secure interrupts
{n+19} EXTI{n} (EXTI) (n=0..15) — EXTI Line{n} interrupt
35 GPDMA1_CH0 (GPDMA1) — GPDMA1 channel 0 global interrupt
36 GPDMA1_CH1 (GPDMA1) — GPDMA1 channel 1 global interrupt
37 GPDMA1_CH2 (GPDMA1) — GPDMA1 channel 2 global interrupt
38 GPDMA1_CH3 (GPDMA1) — GPDMA1 channel 3 global interrupt
39 GPDMA1_CH4 (GPDMA1) — GPDMA1 channel 4 global interrupt
40 GPDMA1_CH5 (GPDMA1) — GPDMA1 channel 5 global interrupt
44 ADC1 — ADC1 global interrupt
45 DAC1 — DAC1 global interrupt
46 FDCAN1_IT0 (FDCAN1) — FDCAN1 Interrupt 0
47 FDCAN1_IT1 (FDCAN1) — FDCAN1 Interrupt 1
48 TIM1_BRK_TERR_IERR (TIM1) — TIM1 Break/TIM1 Transition error/TIM1 Index error
49 TIM1_UPD (TIM1) — TIM1 Update
50 TIM1_TRGI_COM_DIR_IDX (TIM1) — TIM1 trigger and commutation/TIM1 Direction Change interrupt/TIM1 Index
51 TIM1_CC (TIM1) — TIM1 capture compare interrupt
52 TIM2 — TIM2 global interrupt
56 TIM6 — TIM6 global interrupt
57 TIM7 — TIM7 global interrupt
58 I2C1_EV (I2C1) — I2C1 event interrupt
59 I2C1_ERR (I2C1) — I2C1 error interrupt
60 I2C2_EV (I2C2) — I2C2 event interrupt
61 I2C2_ERR (I2C2) — I2C2 error interrupt
62 SPI1 — SPI1 global interrupt
63 SPI2 — SPI2 global interrupt
65 USART1 — USART1 global interrupt
66 USART2 — USART2 global interrupt
68 UART4 — UART4 global interrupt
69 UART5 — UART5 global interrupt
70 LPUART1 — LPUART1 global interrupt
71 LPTIM1 — LPTIM1 global interrupt
72 TIM8_BRK_TERR_IERR (TIM8) — TIM8 Break interrupt/TIM8 Transition error/TIM8 Index error
73 TIM8_UPD (TIM8) — TIM8 Update interrupt
74 TIM8_TRGI_COM_DIR_IDX (TIM8)
75 TIM8_CC (TIM8) — TIM8 capture compare interrupt
76 ADC2 — ADC2 global interrupt
78 TIM15 — TIM15 global interrupt
79 TIM16 — TIM16 global interrupt
80 TIM17 — TIM17 global interrupt
86 TIM9 — TIM9 global interrupt
92 UART6 — UART6 global interrupt
97 GPDMA2_CH0 (GPDMA2) — GPDMA2 channel 0 global interrupt
98 GPDMA2_CH1 (GPDMA2) — GPDMA2 channel 1 global interrupt
99 GPDMA2_CH2 (GPDMA2) — GPDMA2 channel 2 global interrupt
100 GPDMA2_CH3 (GPDMA2) — GPDMA2 channe3 global interrupt
101 GPDMA2_CH4 (GPDMA2) — GPDMA2 channel 4 global interrupt
102 GPDMA2_CH5 (GPDMA2) — GPDMA2 channel 5 global interrupt
114 CORDIC1 — CORDIC1 interrupt
115 FMAC1 — FMAC1 interrupt
116 DTS — DTS interrupt OR DTS AIT through EXTI line
117 RNG — RNG global interrupt
119 AES — AES global interrupt
120 HASH — HASH interrupt
121 PKA — PKA global interrupt
122 TIM10 — TIM10 global interrupt
123 TIM12 — TIM12 global interrupt
124 TIM13 — TIM13 global interrupt
125 TIM14 — TIM14 global interrupt
126 I3C1_EV (I3C1) — I3C1 event interrupt
127 I3C1_ERR (I3C1) — I3C1 error interrupt
138 HRTIM1_M (HRTIM1) — HRtimer1 master interrupt
139 HRTIM1_TIMA (HRTIM1) — HRtimer1 slave1 interrupt
140 HRTIM1_TIMB (HRTIM1) — HRtimer1 slave2 interrupt
141 HRTIM1_TIMC (HRTIM1) — HRtimer1 slave3 interrupt
142 HRTIM1_TIMD (HRTIM1) — HRtimer1 slave4 interrupt
143 HRTIM1_TIME (HRTIM1) — HRtimer1 slave5 interrupt
144 HRTIM1_TIMF (HRTIM1) — HRtimer1 slave6 interrupt
145 HRTIM1_FLT (HRTIM1) — HRtimer1 error interrupt
{n+147} COMP{n} (n=1..8) — COMP{n} global interrupt (EXTI)
164 DAC2 — DAC2 global interrupt
167 DAC5 — DAC5 global interrupt
168 DAC6 — DAC6 global interrupt
169 DAC7 — DAC7 global interrupt
170 DAC8 — DAC8 global interrupt
171 DAC9 — DAC9 global interrupt
172 DAC10 — DAC10 global interrupt
187 TIM11 — TIM11 global interrupt
188 TIM26 — TIM26 global interrupt
189 TIM27 — TIM27 global interrupt

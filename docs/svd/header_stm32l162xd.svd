# STM32L162xD register map
File version: 1.0
Registers are 32-bit, read-write, reset 0x0 unless marked. A register's access mark holds for its fields unless they carry their own. Offsets are from the block's base; lines under a group give offsets from that group; [hi:lo] are bit positions; {n}, {i} and the like mark numbered series; 'fields as' and 'values as' point back to an identical list; <NAME> marks a mode.

## Memory map
0x1FF80000 OB — Option Bytes Registers
0x40000000 TIM2 — TIM
0x40000400 TIM3 — TIM
0x40000800 TIM4 — TIM
0x40000C00 TIM5 — TIM
0x40001000 TIM6 — TIM
0x40001400 TIM7 — TIM
0x40002400 LCD
0x40002800 RTC — Real-Time Clock
0x40002C00 WWDG — Window WATCHDOG
0x40003000 IWDG — Independent WATCHDOG
0x40003800 SPI2 — Serial Peripheral Interface
0x40003C00 SPI3 — Serial Peripheral Interface
0x40004400 USART2 — Universal Synchronous Asynchronous Receiver Transmitter
0x40004800 USART3 — Universal Synchronous Asynchronous Receiver Transmitter
0x40004C00 UART4 — Universal Synchronous Asynchronous Receiver Transmitter
0x40005000 UART5 — Universal Synchronous Asynchronous Receiver Transmitter
0x40005400 I2C1 — Inter-integrated Circuit Interface
0x40005800 I2C2 — Inter-integrated Circuit Interface
0x40005C00 USB — Universal Serial Bus Full Speed Device
0x40007000 PWR — Power Control
0x40007400 DAC1 — Digital to Analog Converter
0x40007C00 COMP — Comparator
0x40007C00 COMP1 — Comparator
0x40007C00 COMP12_COMMON
0x40007C01 COMP2 — Comparator
0x40007C04 RI — Routing Interface
0x40007C5C OPAMP — Operational Amplifier (OPAMP)
0x40007C5C OPAMP1 — Operational Amplifier (OPAMP)
0x40007C5C OPAMP123_COMMON
0x40007C5D OPAMP2 — Operational Amplifier (OPAMP)
0x40007C5E OPAMP3 — Operational Amplifier (OPAMP)
0x40010000 SYSCFG — SysTem Configuration
0x40010400 EXTI — External Interrupt/Event Controller
0x40010800 TIM9 — TIM
0x40010C00 TIM10 — TIM
0x40011000 TIM11 — TIM
0x40012400 ADC1 — Analog to Digital Converter
0x40012C00 SDIO — SD host Interface
0x40013000 SPI1 — Serial Peripheral Interface
0x40013800 USART1 — Universal Synchronous Asynchronous Receiver Transmitter
0x40020000 GPIOA — General Purpose IO
0x40020400 GPIOB — General Purpose IO
0x40020800 GPIOC — General Purpose IO
0x40020C00 GPIOD — General Purpose IO
0x40021000 GPIOE — General Purpose IO
0x40021400 GPIOH — General Purpose IO
0x40021800 GPIOF — General Purpose IO
0x40021C00 GPIOG — General Purpose IO
0x40023000 CRC — CRC calculation unit
0x40023800 RCC — Reset and Clock Control
0x40023C00 FLASH — FLASH Registers
0x40026000 DMA1
0x40026400 DMA2
0x50060000 AES — AES hardware accelerator
0xA0000000 FSMC_Bank1 — Flexible Static Memory Controller
0xA0000104 FSMC_Bank1E — Flexible Static Memory Controller Bank1E
0xE0042000 DBGMCU — Debug MCU

## Interrupts
0 WWDG — Window WatchDog Interrupt
3 RTC_WKUP (RTC) — RTC Wakeup Timer through EXTI Line Interrupt
4 FLASH — FLASH global Interrupt
5 RCC — RCC global Interrupt
6 EXTI0 (EXTI) — EXTI Line0 Interrupt
7 EXTI1 (EXTI) — EXTI Line1 Interrupt
8 EXTI2 (EXTI) — EXTI Line2 Interrupt
9 EXTI3 (EXTI) — EXTI Line3 Interrupt
10 EXTI4 (EXTI) — EXTI Line4 Interrupt
11 DMA1_Channel1 (DMA1) — DMA1 Channel 1 global Interrupt
12 DMA1_Channel2 (DMA1) — DMA1 Channel 2 global Interrupt
13 DMA1_Channel3 (DMA1) — DMA1 Channel 3 global Interrupt
14 DMA1_Channel4 (DMA1) — DMA1 Channel 4 global Interrupt
15 DMA1_Channel5 (DMA1) — DMA1 Channel 5 global Interrupt
16 DMA1_Channel6 (DMA1) — DMA1 Channel 6 global Interrupt
17 DMA1_Channel7 (DMA1) — DMA1 Channel 7 global Interrupt
18 ADC1 — ADC1 global Interrupt
19 USB_HP (USB) — USB High Priority Interrupt
20 USB_LP (USB) — USB Low Priority Interrupt
21 DAC (DAC1) — DAC Interrupt
22 COMP — Comparator through EXTI Line Interrupt
23 EXTI9_5 (EXTI) — External Line[9:5] Interrupts
24 LCD — LCD Interrupt
25 TIM9 — TIM9 global Interrupt
26 TIM10 — TIM10 global Interrupt
27 TIM11 — TIM11 global Interrupt
28 TIM2 — TIM2 global Interrupt
29 TIM3 — TIM3 global Interrupt
30 TIM4 — TIM4 global Interrupt
31 I2C1_EV (I2C1) — I2C1 Event Interrupt
32 I2C1_ER (I2C1) — I2C1 Error Interrupt
33 I2C2_EV (I2C2) — I2C2 Event Interrupt
34 I2C2_ER (I2C2) — I2C2 Error Interrupt
35 SPI1 — SPI1 global Interrupt
36 SPI2 — SPI2 global Interrupt
37 USART1 — USART1 global Interrupt
38 USART2 — USART2 global Interrupt
39 USART3 — USART3 global Interrupt
40 EXTI15_10 (EXTI) — External Line[15:10] Interrupts
41 RTC_Alarm (RTC) — RTC Alarm through EXTI Line Interrupt
42 USB_FS_WKUP (USB) — USB FS WakeUp from suspend through EXTI Line Interrupt
43 TIM6 — TIM6 global Interrupt
44 TIM7 — TIM7 global Interrupt
45 SDIO — SDIO global Interrupt
46 TIM5 — TIM5 global Interrupt
47 SPI3 — SPI3 global Interrupt
48 UART4 — UART4 global Interrupt
49 UART5 — UART5 global Interrupt
50 DMA2_Channel1 (DMA2) — DMA2 Channel 1 global Interrupt
51 DMA2_Channel2 (DMA2) — DMA2 Channel 2 global Interrupt
52 DMA2_Channel3 (DMA2) — DMA2 Channel 3 global Interrupt
53 DMA2_Channel4 (DMA2) — DMA2 Channel 4 global Interrupt
54 DMA2_Channel5 (DMA2) — DMA2 Channel 5 global Interrupt
55 AES — AES global Interrupt
56 COMP_ACQ (COMP) — Comparator Channel Acquisition global Interrupt

# STM32H5F5xx register map
File version: 1.0
Registers are 32-bit, read-write, reset 0x0 unless marked. A register's access mark holds for its fields unless they carry their own. Offsets are from the block's base; lines under a group give offsets from that group; [hi:lo] are bit positions; {n}, {i} and the like mark numbered series; 'fields as' and 'values as' point back to an identical list; <NAME> marks a mode.

## Memory map
0x0BFB6068 RSSLIB_PFUNC — RSSLib function pointer structure
0x0BFB606C NSSLIB_PFUNC — RSSLib secure callable function pointer structure
0x40000000 TIM2 — TIM
0x40000400 TIM3 — TIM
0x40000800 TIM4 — TIM
0x40000C00 TIM5 — TIM
0x40001000 TIM6 — TIM
0x40001400 TIM7 — TIM
0x40001800 TIM12 — TIM
0x40001C00 TIM13 — TIM
0x40002000 TIM14 — TIM
0x40002C00 WWDG
0x40003000 IWDG
0x40003400 OPAMP1 — Operational Amplifier (OPAMP)
0x40003800 SPI2 — SPI
0x40003C00 SPI3 — SPI
0x40004000 COMP12 — Comparator
0x4000400C COMP1
0x40004010 COMP2
0x40004400 USART2 — Universal Synchronous Asynchronous Receiver Transmitter
0x40004800 USART3 — Universal Synchronous Asynchronous Receiver Transmitter
0x40004C00 UART4 — Universal Synchronous Asynchronous Receiver Transmitter
0x40005000 UART5 — Universal Synchronous Asynchronous Receiver Transmitter
0x40005400 I2C1 — Inter-integrated Circuit Interface
0x40005800 I2C2 — Inter-integrated Circuit Interface
0x40005C00 I3C1 — Improved Inter-integrated Circuit Interface
0x40006000 CRS — Clock Recovery System
0x40006400 USART6 — Universal Synchronous Asynchronous Receiver Transmitter
0x40006800 USART10 — Universal Synchronous Asynchronous Receiver Transmitter
0x40006C00 USART11 — Universal Synchronous Asynchronous Receiver Transmitter
0x40007000 CEC — Consumer Electronics Control
0x40007800 UART7 — Universal Synchronous Asynchronous Receiver Transmitter
0x40007C00 UART8 — Universal Synchronous Asynchronous Receiver Transmitter
0x40008000 UART9 — Universal Synchronous Asynchronous Receiver Transmitter
0x40008400 UART12 — Universal Synchronous Asynchronous Receiver Transmitter
0x40008C00 DTS
0x40009400 LPTIM2 — LPTIMER
0x4000A000 FDCAN3 — FD Controller Area Network
0x4000A400 FDCAN1 — FD Controller Area Network
0x4000A500 FDCAN_CONFIG — FD Controller Area Network Configuration
0x4000A800 FDCAN2 — FD Controller Area Network
0x4000DC00 UCPD1 — UCPD
0x40012C00 TIM1 — TIM
0x40013000 SPI1 — SPI
0x40013400 TIM8 — TIM
0x40013800 USART1 — Universal Synchronous Asynchronous Receiver Transmitter
0x40014000 TIM15 — TIM
0x40014400 TIM16 — TIM
0x40014800 TIM17 — TIM
0x40014C00 SPI4 — SPI
0x40015000 SPI6 — SPI
0x40015400 SAI1 — Serial Audio Interface
0x40015800 SAI2 — Serial Audio Interface
0x40016C00 LTDC — LCD-TFT Display Controller
0x40017400 GFXTIM
0x40020000 GPDMA1 — DMA Controller
0x40021000 GPDMA2 — DMA Controller
0x40022000 FLASH — FLASH Registers
0x40023000 CRC — CRC calculation unit
0x40023800 CORDIC
0x40023C00 FMAC
0x40025000 MDF1 — MDF/ADF
0x40026000 RAMCFG
0x40026100 RAMCFG_BKPRAM — SRAMs configuration controller
0x40028000 ETH — Ethernet MAC
0x4002A000 DMA2D — DMA2D Controller
0x4002B000 JPEG — JPEG Codec
0x40030400 ICACHE — Instruction Cache
0x40031400 DCACHE1 — Data Cache
0x40032400 GTZC_TZSC1 — Global TrustZone Controller
0x40032800 GTZC_TZIC1
0x40032C00 GTZC_MPCBB1
0x40033000 GTZC_MPCBB2
0x40033400 GTZC_MPCBB3
0x40033800 GTZC_MPCBB4
0x40033C00 GTZC_MPCBB5
0x42020000 GPIOA — General Purpose I/O
0x42020400 GPIOB — General Purpose I/O
0x42020800 GPIOC — General Purpose I/O
0x42020C00 GPIOD — General Purpose I/O
0x42021000 GPIOE — General Purpose I/O
0x42021400 GPIOF — General Purpose I/O
0x42021800 GPIOG — General Purpose I/O
0x42021C00 GPIOH — General Purpose I/O
0x42022000 GPIOI — General Purpose I/O
0x42022400 GPIOJ — General Purpose I/O
0x42022800 GPIOK — General Purpose I/O
0x42028000 ADC1 — ADC
0x42028100 ADC2 — ADC
0x42028300 ADC12_COMMON
0x42028400 DAC1 — DAC
0x4202C000 DCMI
0x4202C400 PSSI
0x4202C800 ADF1 — MDF/ADF
0x4202D800 ADC3 — ADC
0x42040000 USB_OTG_HS — USB_OTG_Core_register
0x42080000 USB_OTG_FS — USB_OTG_Core_register
0x420C0000 AES — AES hardware accelerator
0x420C0400 HASH
0x420C0800 RNG
0x420C0C00 SAES — AES hardware accelerator
0x420C2000 PKA
0x420C7C00 CCB — Coupling and chaining bridge (CCB)
0x44000400 SBS — System configuration, Boot and Security
0x44002000 SPI5 — SPI
0x44002400 LPUART1 — Universal Synchronous Asynchronous Receiver Transmitter
0x44002800 I2C3 — Inter-integrated Circuit Interface
0x44002C00 I2C4 — Inter-integrated Circuit Interface
0x44003000 I3C2 — Improved Inter-integrated Circuit Interface
0x44004400 LPTIM1 — LPTIMER
0x44004800 LPTIM3 — LPTIMER
0x44004C00 LPTIM4 — LPTIMER
0x44005000 LPTIM5 — LPTIMER
0x44005400 LPTIM6 — LPTIMER
0x44007400 VREFBUF
0x44007800 RTC — Real-Time Clock
0x44007C00 TAMP — Tamper and backup registers
0x44008000 PLAY1 — Programmable Logic Array (PLAY)
0x44020800 PWR — Power Control
0x44020C00 RCC — Reset and Clock Control
0x44022000 EXTI — Asynch Interrupt/Event Controller (EXTI)
0x44024000 DBGMCU — Debug MCU
0x46005000 OTFDEC1
0x46005400 OTFDEC2
0x46008000 SDMMC1 — Secure digital input/output Interface
0x46008400 DLYB_SDMMC1 — Delay Block DLYB
0x46008800 DLYB_SDMMC2 — Delay Block DLYB
0x46008C00 SDMMC2 — Secure digital input/output Interface
0x4600F000 DLYB_OCTOSPI1 — Delay Block DLYB
0x4600F400 DLYB_OCTOSPI2 — Delay Block DLYB
0x47000400 FMC_Bank1_R — Flexible Memory Controller
0x47000480 FMC_Bank3_R — Flexible Memory Controller Bank3
0x47000504 FMC_Bank1E_R — Flexible Memory Controller Bank1E
0x47000540 FMC_Bank5_6_R — Flexible Memory Controller Bank5 and 6
0x47001400 OCTOSPI1 — OCTO Serial Peripheral Interface
0x47002400 OCTOSPI2 — OCTO Serial Peripheral Interface
0x47003400 OCTOSPIM — Serial Peripheral Interface IO Manager
0x50000000 TIM2_S — TIM
0x50000400 TIM3_S — TIM
0x50000800 TIM4_S — TIM
0x50000C00 TIM5_S — TIM
0x50001000 TIM6_S — TIM
0x50001400 TIM7_S — TIM
0x50001800 TIM12_S — TIM
0x50001C00 TIM13_S — TIM
0x50002000 TIM14_S — TIM
0x50002C00 WWDG_S — WWDG
0x50003000 IWDG_S — IWDG
0x50003400 OPAMP1_S — Operational Amplifier (OPAMP)
0x50003800 SPI2_S — SPI
0x50003C00 SPI3_S — SPI
0x50004000 COMP12_S — Comparator
0x5000400C COMP1_S
0x50004010 COMP2_S
0x50004400 USART2_S — Universal Synchronous Asynchronous Receiver Transmitter
0x50004800 USART3_S — Universal Synchronous Asynchronous Receiver Transmitter
0x50004C00 UART4_S — Universal Synchronous Asynchronous Receiver Transmitter
0x50005000 UART5_S — Universal Synchronous Asynchronous Receiver Transmitter
0x50005400 I2C1_S — Inter-integrated Circuit Interface
0x50005800 I2C2_S — Inter-integrated Circuit Interface
0x50005C00 I3C1_S — Improved Inter-integrated Circuit Interface
0x50006000 CRS_S — Clock Recovery System
0x50006400 USART6_S — Universal Synchronous Asynchronous Receiver Transmitter
0x50006800 USART10_S — Universal Synchronous Asynchronous Receiver Transmitter
0x50006C00 USART11_S — Universal Synchronous Asynchronous Receiver Transmitter
0x50007000 CEC_S — Consumer Electronics Control
0x50007800 UART7_S — Universal Synchronous Asynchronous Receiver Transmitter
0x50007C00 UART8_S — Universal Synchronous Asynchronous Receiver Transmitter
0x50008000 UART9_S — Universal Synchronous Asynchronous Receiver Transmitter
0x50008400 UART12_S — Universal Synchronous Asynchronous Receiver Transmitter
0x50008C00 DTS_S — DTS
0x50009400 LPTIM2_S — LPTIMER
0x5000A000 FDCAN3_S — FD Controller Area Network
0x5000A400 FDCAN1_S — FD Controller Area Network
0x5000A500 FDCAN_CONFIG_S — FD Controller Area Network Configuration
0x5000A800 FDCAN2_S — FD Controller Area Network
0x5000DC00 UCPD1_S — UCPD
0x50012C00 TIM1_S — TIM
0x50013000 SPI1_S — SPI
0x50013400 TIM8_S — TIM
0x50013800 USART1_S — Universal Synchronous Asynchronous Receiver Transmitter
0x50014000 TIM15_S — TIM
0x50014400 TIM16_S — TIM
0x50014800 TIM17_S — TIM
0x50014C00 SPI4_S — SPI
0x50015000 SPI6_S — SPI
0x50015400 SAI1_S — Serial Audio Interface
0x50015800 SAI2_S — Serial Audio Interface
0x50016C00 LTDC_S — LCD-TFT Display Controller
0x50017400 GFXTIM_S — GFXTIM
0x50020000 GPDMA1_S — DMA Controller
0x50021000 GPDMA2_S — DMA Controller
0x50022000 FLASH_S — FLASH Registers
0x50023000 CRC_S — CRC calculation unit
0x50023800 CORDIC_S — CORDIC
0x50023C00 FMAC_S — FMAC
0x50025000 MDF1_S — MDF/ADF
0x50026000 RAMCFG_S
0x50026100 RAMCFG_BKPRAM_S — SRAMs configuration controller
0x50028000 ETH_S — Ethernet MAC
0x5002A000 DMA2D_S — DMA2D Controller
0x5002B000 JPEG_S — JPEG Codec
0x50030400 ICACHE_S — Instruction Cache
0x50031400 DCACHE1_S — Data Cache
0x50032400 GTZC_TZSC1_S — Global TrustZone Controller
0x50032800 GTZC_TZIC1_S
0x50032C00 GTZC_MPCBB1_S
0x50033000 GTZC_MPCBB2_S
0x50033400 GTZC_MPCBB3_S
0x50033800 GTZC_MPCBB4_S
0x50033C00 GTZC_MPCBB5_S
0x50040000 USB_OTG_HS_S — USB_OTG_Core_register
0x52020000 GPIOA_S — General Purpose I/O
0x52020400 GPIOB_S — General Purpose I/O
0x52020800 GPIOC_S — General Purpose I/O
0x52020C00 GPIOD_S — General Purpose I/O
0x52021000 GPIOE_S — General Purpose I/O
0x52021400 GPIOF_S — General Purpose I/O
0x52021800 GPIOG_S — General Purpose I/O
0x52021C00 GPIOH_S — General Purpose I/O
0x52022000 GPIOI_S — General Purpose I/O
0x52022400 GPIOJ_S — General Purpose I/O
0x52022800 GPIOK_S — General Purpose I/O
0x52028000 ADC1_S — ADC
0x52028100 ADC2_S — ADC
0x52028300 ADC12_COMMON_S
0x52028400 DAC1_S — DAC
0x5202C000 DCMI_S — DCMI
0x5202C400 PSSI_S — PSSI
0x5202C800 ADF1_S — MDF/ADF
0x5202D800 ADC3_S — ADC
0x52080000 USB_OTG_FS_S — USB_OTG_Core_register
0x520C0000 AES_S — AES hardware accelerator
0x520C0400 HASH_S — HASH
0x520C0800 RNG_S — RNG
0x520C0C00 SAES_S — AES hardware accelerator
0x520C2000 PKA_S — PKA
0x520C7C00 CCB_S — Coupling and chaining bridge (CCB)
0x54000400 SBS_S — System configuration, Boot and Security
0x54002000 SPI5_S — SPI
0x54002400 LPUART1_S — Universal Synchronous Asynchronous Receiver Transmitter
0x54002800 I2C3_S — Inter-integrated Circuit Interface
0x54002C00 I2C4_S — Inter-integrated Circuit Interface
0x54003000 I3C2_S — Improved Inter-integrated Circuit Interface
0x54004400 LPTIM1_S — LPTIMER
0x54004800 LPTIM3_S — LPTIMER
0x54004C00 LPTIM4_S — LPTIMER
0x54005000 LPTIM5_S — LPTIMER
0x54005400 LPTIM6_S — LPTIMER
0x54007400 VREFBUF_S — VREFBUF
0x54007800 RTC_S — Real-Time Clock
0x54007C00 TAMP_S — Tamper and backup registers
0x54008000 PLAY1_S — Programmable Logic Array (PLAY)
0x54020800 PWR_S — Power Control
0x54020C00 RCC_S — Reset and Clock Control
0x54022000 EXTI_S — Asynch Interrupt/Event Controller (EXTI)
0x56005000 OTFDEC1_S
0x56005400 OTFDEC2_S
0x56008000 SDMMC1_S — Secure digital input/output Interface
0x56008400 DLYB_SDMMC1_S — Delay Block DLYB
0x56008800 DLYB_SDMMC2_S — Delay Block DLYB
0x56008C00 SDMMC2_S — Secure digital input/output Interface
0x5600F000 DLYB_OCTOSPI1_S — Delay Block DLYB
0x5600F400 DLYB_OCTOSPI2_S — Delay Block DLYB
0x57000400 FMC_Bank1_R_S — Flexible Memory Controller
0x57000480 FMC_Bank3_R_S — Flexible Memory Controller Bank3
0x57000504 FMC_Bank1E_R_S — Flexible Memory Controller Bank1E
0x57000540 FMC_Bank5_6_R_S — Flexible Memory Controller Bank5 and 6
0x57001400 OCTOSPI1_S — OCTO Serial Peripheral Interface
0x57002400 OCTOSPI2_S — OCTO Serial Peripheral Interface
0x57003400 OCTOSPIM_S — Serial Peripheral Interface IO Manager

## Interrupts
0 WWDG — Window WatchDog interrupt
2 RTC — RTC non-secure interrupt
3 RTC_S — RTC secure interrupt
4 TAMP — Tamper global interrupt
5 RAMCFG — RAMCFG global interrupt
6 FLASH — FLASH non-secure global interrupt
7 FLASH_S — FLASH secure global interrupt
9 RCC — RCC non secure global interrupt
10 RCC_S — RCC secure global interrupt
{n+11} EXTI{n} (EXTI) (n=0..15) — EXTI Line{n} interrupt
{n+27} GPDMA1_Channel{n} (GPDMA1) (n=0..7) — GPDMA1 Channel {n} global interrupt
35 IWDG — IWDG global interrupt
36 SAES — Secure AES global interrupt
37 ADC1 — ADC1 global interrupt
38 DAC1 — DAC1 global interrupt
39 FDCAN1_IT0 (FDCAN1) — FDCAN1 interrupt 0
40 FDCAN1_IT1 (FDCAN1) — FDCAN1 interrupt 1
41 TIM1_BRK (TIM1) — TIM1 Break interrupt
42 TIM1_UP (TIM1) — TIM1 Update interrupt
43 TIM1_TRG_COM (TIM1) — TIM1 Trigger and Commutation interrupt
44 TIM1_CC (TIM1) — TIM1 Capture Compare interrupt
45 TIM2 — TIM2 global interrupt
46 TIM3 — TIM3 global interrupt
47 TIM4 — TIM4 global interrupt
48 TIM5 — TIM5 global interrupt
49 TIM6 — TIM6 global interrupt
50 TIM7 — TIM7 global interrupt
51 I2C1_EV (I2C1) — I2C1 Event interrupt
52 I2C1_ER (I2C1) — I2C1 Error interrupt
53 I2C2_EV (I2C2) — I2C2 Event interrupt
54 I2C2_ER (I2C2) — I2C2 Error interrupt
55 SPI1 — SPI1 global interrupt
56 SPI2 — SPI2 global interrupt
57 SPI3 — SPI3 global interrupt
58 USART1 — USART1 global interrupt
59 USART2 — USART2 global interrupt
60 USART3 — USART3 global interrupt
61 UART4 — UART4 global interrupt
62 UART5 — UART5 global interrupt
63 LPUART1 — LPUART1 global interrupt
64 LPTIM1 — LPTIM1 global interrupt
65 TIM8_BRK (TIM8) — TIM8 Break interrupt
66 TIM8_UP (TIM8) — TIM8 Update interrupt
67 TIM8_TRG_COM (TIM8) — TIM8 Trigger and Commutation interrupt
68 TIM8_CC (TIM8) — TIM8 Capture Compare interrupt
69 ADC2 — ADC2 global interrupt
70 LPTIM2 — LPTIM2 global interrupt
71 TIM15 — TIM15 global interrupt
72 TIM16 — TIM16 global interrupt
73 TIM17 — TIM17 global interrupt
74 OTG_FS (USB_OTG_FS) — USB OTG FS global interrupt
75 CRS — CRS global interrupt
76 UCPD1 — UCPD1 global interrupt
78 OCTOSPI1 — OctoSPI1 global interrupt
79 SDMMC1 — SDMMC1 global interrupt
80 I2C3_EV (I2C3) — I2C3 event interrupt
81 I2C3_ER (I2C3) — I2C3 error interrupt
82 SPI4 — SPI4 global interrupt
83 SPI5 — SPI5 global interrupt
84 SPI6 — SPI6 global interrupt
85 USART6 — USART6 global interrupt
86 USART10 — USART10 global interrupt
87 USART11 — USART11 global interrupt
88 SAI1 — Serial Audio Interface 1 global interrupt
89 SAI2 — Serial Audio Interface 2 global interrupt
{n+90} GPDMA2_Channel{n} (GPDMA2) (n=0..7) — GPDMA2 Channel {n} global interrupt
98 UART7 — UART7 global interrupt
99 UART8 — UART8 global interrupt
100 UART9 — UART9 global interrupt
101 UART12 — UART12 global interrupt
102 SDMMC2 — SDMMC2 global interrupt
104 ICACHE — Instruction cache global interrupt
105 DCACHE1 — Data cache global interrupt
106 ETH — Ethernet global interrupt
107 ETH_WKUP (ETH) — Ethernet Wakeup global interrupt
108 DCMI_PSSI (DCMI, PSSI) — DCMI/PSSI global interrupt
109 FDCAN2_IT0 (FDCAN2) — FDCAN2 interrupt 0
110 FDCAN2_IT1 (FDCAN2) — FDCAN2 interrupt 1
111 CORDIC — CORDIC global interrupt
112 FMAC — FMAC global interrupt
113 DTS — DTS global interrupt
114 RNG — RNG global interrupt
115 OTFDEC1 — OTFDEC1 global interrupt
116 AES — AES global interrupt
117 HASH — HASH global interrupt
118 PKA — PKA global interrupt
119 CEC — CEC-HDMI global interrupt
120 TIM12 — TIM12 global interrupt
121 TIM13 — TIM13 global interrupt
122 TIM14 — TIM14 global interrupt
123 I3C1_EV (I3C1) — I3C1 event interrupt
124 I3C1_ER (I3C1) — I3C1 error interrupt
125 I2C4_EV (I2C4) — I2C4 event interrupt
126 I2C4_ER (I2C4) — I2C4 error interrupt
127 LPTIM3 — LPTIM3 global interrupt
128 LPTIM4 — LPTIM4 global interrupt
129 LPTIM5 — LPTIM5 global interrupt
130 LPTIM6 — LPTIM6 global interrupt
131 I3C2_EV (I3C2) — I3C2 Event interrupt
132 I3C2_ER (I3C2) — I3C2 Error interrupt
133 COMP (COMP12, COMP2) — COMP1 COMP2 global interrupt
134 DMA2D — DMA2D global interrupt
135 JPEG — JPEG global interrupt
136 GPDMA1_Channel8 (GPDMA1) — GPDMA1 Channel 8 global interrupt
137 GPDMA1_Channel9 (GPDMA1) — GPDMA1 Channel 9 global interrupt
138 GPDMA1_Channel10 (GPDMA1) — GPDMA1 Channel 10 global interrupt
139 GPDMA1_Channel11 (GPDMA1) — GPDMA1 Channel 11 global interrupt
140 GPDMA2_Channel8 (GPDMA2) — GPDMA2 Channel 8 global interrupt
141 GPDMA2_Channel9 (GPDMA2) — GPDMA2 Channel 9 global interrupt
142 GPDMA2_Channel10 (GPDMA2) — GPDMA2 Channel 10 global interrupt
143 GPDMA2_Channel11 (GPDMA2) — GPDMA2 Channel 11 global interrupt
144 GFXTIM — GFXTIM global interrupt
147 PLAY1 — PLAY1 global non-secure interrupt
148 PLAY1_S — PLAY1 global secure interrupt
149 ADC3 — ADC3 global interrupt
150 OCTOSPI2 — OCTOSPI2 global interrupt
151 OTFDEC2 — OTFDEC2 global interrupt
152 FDCAN3_IT0 (FDCAN3) — FDCAN3 Interrupt 0
153 FDCAN3_IT1 (FDCAN3) — FDCAN3 Interrupt 1
154 MDF1_FLT0 (MDF1) — MDF1 Filter 0 global interrupt
155 MDF1_FLT1 (MDF1) — MDF1 Filter 1 global interrupt
156 MDF1_FLT2 (MDF1) — MDF1 Filter 2 global interrupt
157 MDF1_FLT3 (MDF1) — MDF1 Filter 3 global interrupt
158 MDF1_FLT4 (MDF1) — MDF1 Filter 4 global interrupt
159 MDF1_FLT5 (MDF1) — MDF1 Filter 5 global interrupt
160 ADF1_FLT0 (ADF1) — ADF1 Filter 0 global interrupt
161 OTG_HS (USB_OTG_HS) — USB OTG HS global interrupt

# STM32G484xx register map
File version: 1.0
Registers are 32-bit, read-write, reset 0x0 unless marked. A register's access mark holds for its fields unless they carry their own. Offsets are from the block's base; lines under a group give offsets from that group; [hi:lo] are bit positions; {n}, {i} and the like mark numbered series; 'fields as' and 'values as' point back to an identical list; <NAME> marks a mode.

## Memory map
0x40000000 TIM2 — TIM
0x40000400 TIM3 — TIM
0x40000800 TIM4 — TIM
0x40000C00 TIM5 — TIM
0x40001000 TIM6 — TIM
0x40001400 TIM7 — TIM
0x40002000 CRS — Clock Recovery System
0x40002400 TAMP — Tamper and backup registers
0x40002800 RTC
0x40002C00 WWDG — Window WATCHDOG
0x40003000 IWDG — Independent WATCHDOG
0x40003800 SPI2 — Serial Peripheral Interface
0x40003C00 SPI3 — Serial Peripheral Interface
0x40004400 USART2 — Universal Synchronous Asynchronous Receiver Transmitter
0x40004800 USART3 — Universal Synchronous Asynchronous Receiver Transmitter
0x40004C00 UART4 — Universal Synchronous Asynchronous Receiver Transmitter
0x40005000 UART5 — Universal Synchronous Asynchronous Receiver Transmitter
0x40005400 I2C1 — Inter-integrated Circuit Interface
0x40005800 I2C2 — Inter-integrated Circuit Interface
0x40005C00 USB — Universal Serial Bus Full Speed Device
0x40006400 FDCAN1 — FD Controller Area Network
0x40006500 FDCAN_CONFIG — FD Controller Area Network Configuration
0x40006800 FDCAN2 — FD Controller Area Network
0x40006C00 FDCAN3 — FD Controller Area Network
0x40007000 PWR — Power Control
0x40007800 I2C3 — Inter-integrated Circuit Interface
0x40007C00 LPTIM1 — LPTIMER
0x40008000 LPUART1 — Universal Synchronous Asynchronous Receiver Transmitter
0x40008400 I2C4 — Inter-integrated Circuit Interface
0x4000A000 UCPD1 — UCPD
0x40010000 SYSCFG — System configuration controller
0x40010030 VREFBUF
0x40010200 COMP1 — Comparator
0x40010204 COMP2 — Comparator
0x40010208 COMP3 — Comparator
0x4001020C COMP4 — Comparator
0x40010210 COMP5 — Comparator
0x40010214 COMP6 — Comparator
0x40010218 COMP7 — Comparator
0x40010300 OPAMP — Operational Amplifier (OPAMP)
0x40010300 OPAMP1 — Operational Amplifier (OPAMP)
0x40010304 OPAMP2 — Operational Amplifier (OPAMP)
0x40010308 OPAMP3 — Operational Amplifier (OPAMP)
0x4001030C OPAMP4 — Operational Amplifier (OPAMP)
0x40010310 OPAMP5 — Operational Amplifier (OPAMP)
0x40010314 OPAMP6 — Operational Amplifier (OPAMP)
0x40010400 EXTI — External Interrupt/Event Controller
0x40012C00 TIM1 — TIM
0x40013000 SPI1 — Serial Peripheral Interface
0x40013400 TIM8 — TIM
0x40013800 USART1 — Universal Synchronous Asynchronous Receiver Transmitter
0x40013C00 SPI4 — Serial Peripheral Interface
0x40014000 TIM15 — TIM
0x40014400 TIM16 — TIM
0x40014800 TIM17 — TIM
0x40015000 TIM20 — TIM
0x40015400 SAI1 — Serial Audio Interface
0x40016800 HRTIM1
0x40020000 DMA1
0x40020400 DMA2
0x40020800 DMAMUX1 — DMA Multiplexer
0x40020C00 CORDIC
0x40021000 RCC — Reset and Clock Control
0x40021400 FMAC
0x40022000 FLASH — FLASH Registers
0x40023000 CRC — CRC calculation unit
0x48000000 GPIOA — General Purpose I/O
0x48000400 GPIOB — General Purpose I/O
0x48000800 GPIOC — General Purpose I/O
0x48000C00 GPIOD — General Purpose I/O
0x48001000 GPIOE — General Purpose I/O
0x48001400 GPIOF — General Purpose I/O
0x48001800 GPIOG — General Purpose I/O
0x50000000 ADC1 — Analog to Digital Converter
0x50000100 ADC2 — Analog to Digital Converter
0x50000300 ADC12_COMMON
0x50000400 ADC3 — Analog to Digital Converter
0x50000500 ADC4 — Analog to Digital Converter
0x50000600 ADC5 — Analog to Digital Converter
0x50000700 ADC345_COMMON
0x50000800 DAC — Digital to Analog Converter
0x50000800 DAC1 — Digital to Analog Converter
0x50000C00 DAC2 — Digital to Analog Converter
0x50001000 DAC3 — Digital to Analog Converter
0x50001400 DAC4 — Digital to Analog Converter
0x50060000 AES — AES hardware accelerator
0x50060800 RNG
0xA0000000 FMC_Bank1_R — Flexible Memory Controller
0xA0000080 FMC_Bank3_R — Flexible Memory Controller Bank3
0xA0000104 FMC_Bank1E_R — Flexible Memory Controller Bank1E
0xA0001000 QUADSPI — QUAD Serial Peripheral Interface
0xE0042000 DBGMCU — Debug MCU

## Interrupts
0 WWDG — Window WatchDog Interrupt
2 RTC_TAMP_LSECSS (TAMP, RTC) — RTC Tamper and TimeStamp and RCC LSE CSS interrupts through the EXTI
3 RTC_WKUP (RTC) — RTC Wakeup interrupt through the EXTI line
4 FLASH — FLASH global Interrupt
5 RCC — RCC global Interrupt
6 EXTI0 (EXTI) — EXTI Line0 Interrupt
7 EXTI1 (EXTI) — EXTI Line1 Interrupt
8 EXTI2 (EXTI) — EXTI Line2 Interrupt
9 EXTI3 (EXTI) — EXTI Line3 Interrupt
10 EXTI4 (EXTI) — EXTI Line4 Interrupt
11 DMA1_Channel1 (DMA1) — DMA1 Channel 1 global Interrupt
12 DMA1_Channel2 (DMA1) — DMA1 Channel 2 global Interrupt
13 DMA1_Channel3 (DMA1) — DMA1 Channel 3 global Interrupt
14 DMA1_Channel4 (DMA1) — DMA1 Channel 4 global Interrupt
15 DMA1_Channel5 (DMA1) — DMA1 Channel 5 global Interrupt
16 DMA1_Channel6 (DMA1) — DMA1 Channel 6 global Interrupt
17 DMA1_Channel7 (DMA1) — DMA1 Channel 7 global Interrupt
18 ADC1_2 (ADC1) — ADC1 and ADC2 global Interrupt
19 USB_HP (USB) — USB HP Interrupt
20 USB_LP (USB) — USB LP Interrupt
21 FDCAN1_IT0 (FDCAN1) — FDCAN1 IT0 Interrupt
22 FDCAN1_IT1 (FDCAN1) — FDCAN1 IT1 Interrupt
23 EXTI9_5 (EXTI) — External Line[9:5] Interrupts
24 TIM1_BRK_TIM15 (TIM15) — TIM1 Break, Transition error, Index error and TIM15 global interrupt
25 TIM1_UP_TIM16 (TIM16) — TIM1 Update Interrupt and TIM16 global interrupt
26 TIM1_TRG_COM_TIM17 (TIM17) — TIM1 TIM1 Trigger, Commutation, Direction change, Index and TIM17 global interrupt
27 TIM1_CC (TIM1) — TIM1 Capture Compare Interrupt
28 TIM2 — TIM2 global Interrupt
29 TIM3 — TIM3 global Interrupt
30 TIM4 — TIM4 global Interrupt
31 I2C1_EV (I2C1) — I2C1 Event Interrupt
32 I2C1_ER (I2C1) — I2C1 Error Interrupt
33 I2C2_EV (I2C2) — I2C2 Event Interrupt
34 I2C2_ER (I2C2) — I2C2 Error Interrupt
35 SPI1 — SPI1 global Interrupt
36 SPI2 — SPI2 global Interrupt
37 USART1 — USART1 global Interrupt
38 USART2 — USART2 global Interrupt
39 USART3 — USART3 global Interrupt
40 EXTI15_10 (EXTI) — External Line[15:10] Interrupts
41 RTC_Alarm (RTC) — RTC Alarm (A and B) through EXTI Line Interrupt
43 TIM8_BRK (TIM8) — TIM8 Break, Transition error and Index error Interrupt
44 TIM8_UP (TIM8) — TIM8 Update Interrupt
45 TIM8_TRG_COM (TIM8) — TIM8 Trigger, Commutation, Direction change and Index Interrupt
46 TIM8_CC (TIM8) — TIM8 Capture Compare Interrupt
47 ADC3 — ADC3 global Interrupt
49 LPTIM1 — LP TIM1 Interrupt
50 TIM5 — TIM5 global Interrupt
51 SPI3 — SPI3 global Interrupt
52 UART4 — UART4 global Interrupt
53 UART5 — UART5 global Interrupt
54 TIM6_DAC (TIM6, DAC) — TIM6 global and DAC1&3 underrun error interrupts
55 TIM7_DAC (TIM7, DAC) — TIM7 global and DAC2&4 underrun error interrupts
56 DMA2_Channel1 (DMA2) — DMA2 Channel 1 global Interrupt
57 DMA2_Channel2 (DMA2) — DMA2 Channel 2 global Interrupt
58 DMA2_Channel3 (DMA2) — DMA2 Channel 3 global Interrupt
59 DMA2_Channel4 (DMA2) — DMA2 Channel 4 global Interrupt
60 DMA2_Channel5 (DMA2) — DMA2 Channel 5 global Interrupt
61 ADC4 — ADC4 global Interrupt
62 ADC5 — ADC5 global Interrupt
63 UCPD1 — UCPD global Interrupt
64 COMP1_2_3 (COMP1) — COMP1, COMP2 and COMP3 Interrupts
65 COMP4_5_6 (COMP4) — COMP4, COMP5 and COMP6
66 COMP7 — COMP7 Interrupt
67 HRTIM1_Master (HRTIM1) — HRTIM Master Timer global Interrupt
68 HRTIM1_TIMA (HRTIM1) — HRTIM Timer A global Interrupt
69 HRTIM1_TIMB (HRTIM1) — HRTIM Timer B global Interrupt
70 HRTIM1_TIMC (HRTIM1) — HRTIM Timer C global Interrupt
71 HRTIM1_TIMD (HRTIM1) — HRTIM Timer D global Interrupt
72 HRTIM1_TIME (HRTIM1) — HRTIM Timer E global Interrupt
73 HRTIM1_FLT (HRTIM1) — HRTIM Fault global Interrupt
74 HRTIM1_TIMF (HRTIM1) — HRTIM Timer F global Interrupt
75 CRS — CRS global interrupt
76 SAI1 — Serial Audio Interface global interrupt
77 TIM20_BRK (TIM20) — TIM20 Break, Transition error and Index error Interrupt
78 TIM20_UP (TIM20) — TIM20 Update interrupt
79 TIM20_TRG_COM (TIM20) — TIM20 Trigger, Commutation, Direction change and Index Interrupt
80 TIM20_CC (TIM20) — TIM20 Capture Compare interrupt
82 I2C4_EV (I2C4) — I2C4 Event interrupt
83 I2C4_ER (I2C4) — I2C4 Error interrupt
84 SPI4 — SPI4 Event interrupt
85 AES — AES global interrupt
86 FDCAN2_IT0 (FDCAN2) — FDCAN2 interrupt line 0 interrupt
87 FDCAN2_IT1 (FDCAN2) — FDCAN2 interrupt line 1 interrupt
88 FDCAN3_IT0 (FDCAN3) — FDCAN3 interrupt line 0 interrupt
89 FDCAN3_IT1 (FDCAN3) — FDCAN3 interrupt line 1 interrupt
90 RNG — RNG global interrupt
91 LPUART1 — LP UART 1 Interrupt
92 I2C3_EV (I2C3) — I2C3 Event Interrupt
93 I2C3_ER (I2C3) — I2C3 Error interrupt
94 DMAMUX_OVR (DMAMUX1) — DMAMUX overrun global interrupt
95 QUADSPI — QUADSPI interrupt
96 DMA1_Channel8 (DMA1) — DMA1 Channel 8 interrupt
97 DMA2_Channel6 (DMA2) — DMA2 Channel 6 interrupt
98 DMA2_Channel7 (DMA2) — DMA2 Channel 7 interrupt
99 DMA2_Channel8 (DMA2) — DMA2 Channel 8 interrupt
100 CORDIC — CORDIC global Interrupt
101 FMAC — FMAC global Interrupt

# STM32L4Q5xx register map
File version: 1.0
Registers are 32-bit, read-write, reset 0x0 unless marked. A register's access mark holds for its fields unless they carry their own. Offsets are from the block's base; lines under a group give offsets from that group; [hi:lo] are bit positions; {n}, {i} and the like mark numbered series; 'fields as' and 'values as' point back to an identical list; <NAME> marks a mode.

## Memory map
0x40000000 TIM2 — TIM
0x40000400 TIM3 — TIM
0x40000800 TIM4 — TIM
0x40000C00 TIM5 — TIM
0x40001000 TIM6 — TIM
0x40001400 TIM7 — TIM
0x40002800 RTC — Real-Time Clock
0x40002C00 WWDG — Window WATCHDOG
0x40003000 IWDG — Independent WATCHDOG
0x40003400 TAMP — Tamper and backup registers
0x40003800 SPI2 — Serial Peripheral Interface
0x40003C00 SPI3 — Serial Peripheral Interface
0x40004400 USART2 — Universal Synchronous Asynchronous Receiver Transmitter
0x40004800 USART3 — Universal Synchronous Asynchronous Receiver Transmitter
0x40004C00 UART4 — Universal Synchronous Asynchronous Receiver Transmitter
0x40005000 UART5 — Universal Synchronous Asynchronous Receiver Transmitter
0x40005400 I2C1 — Inter-integrated Circuit Interface
0x40005800 I2C2 — Inter-integrated Circuit Interface
0x40005C00 I2C3 — Inter-integrated Circuit Interface
0x40006000 CRS — Clock Recovery System
0x40006400 CAN — Controller Area Network
0x40006400 CAN1 — Controller Area Network
0x40007000 PWR — Power Control
0x40007400 DAC — Digital to Analog Converter
0x40007400 DAC1 — Digital to Analog Converter
0x40007800 OPAMP — Operational Amplifier (OPAMP)
0x40007800 OPAMP1 — Operational Amplifier (OPAMP)
0x40007800 OPAMP12_COMMON
0x40007810 OPAMP2 — Operational Amplifier (OPAMP)
0x40007C00 LPTIM1 — LPTIMER
0x40008000 LPUART1 — Universal Synchronous Asynchronous Receiver Transmitter
0x40008400 I2C4 — Inter-integrated Circuit Interface
0x40009400 LPTIM2 — LPTIMER
0x40010000 SYSCFG — System configuration controller
0x40010030 VREFBUF
0x40010200 COMP1 — Comparator
0x40010204 COMP12_COMMON
0x40010204 COMP2 — Comparator
0x40010400 EXTI — External Interrupt/Event Controller
0x40011C00 FIREWALL
0x40012C00 TIM1 — TIM
0x40013000 SPI1 — Serial Peripheral Interface
0x40013400 TIM8 — TIM
0x40013800 USART1 — Universal Synchronous Asynchronous Receiver Transmitter
0x40014000 TIM15 — TIM
0x40014400 TIM16 — TIM
0x40014800 TIM17 — TIM
0x40015400 SAI1 — Serial Audio Interface
0x40015800 SAI2 — Serial Audio Interface
0x40016000 DFSDM1
0x40016800 LTDC — LCD-TFT Display Controller
0x40020000 DMA1
0x40020400 DMA2
0x40020800 DMAMUX1 — DMA Multiplexer
0x40021000 RCC — Reset and Clock Control
0x40022000 FLASH — FLASH Registers
0x40023000 CRC — CRC calculation unit
0x40024000 TSC — Touch Sensing Controller (TSC)
0x4002B000 DMA2D — DMA2D Controller
0x48000000 GPIOA — General Purpose I/O
0x48000400 GPIOB — General Purpose I/O
0x48000800 GPIOC — General Purpose I/O
0x48000C00 GPIOD — General Purpose I/O
0x48001000 GPIOE — General Purpose I/O
0x48001400 GPIOF — General Purpose I/O
0x48001800 GPIOG — General Purpose I/O
0x48001C00 GPIOH — General Purpose I/O
0x48002000 GPIOI — General Purpose I/O
0x50000000 USB_OTG_FS — USB_OTG_Core_register
0x50040000 ADC1 — Analog to Digital Converter
0x50040100 ADC2 — Analog to Digital Converter
0x50040300 ADC12_COMMON
0x50050000 DCMI
0x50050400 PSSI
0x5005E000 PKA — Public Key Accelerator (PKA)
0x50060000 AES — AES hardware accelerator
0x50060400 HASH
0x50060800 RNG
0x50061C00 OCTOSPIM — OCTO Serial Peripheral Interface IO Manager
0x50062400 SDMMC1 — Secure digital input/output Interface
0x50062800 SDMMC2 — Secure digital input/output Interface
0xA0000000 FMC_Bank1_R — Flexible Memory Controller
0xA0000080 FMC_Bank3_R — Flexible Memory Controller Bank3
0xA0000104 FMC_Bank1E_R — Flexible Memory Controller Bank1E
0xA0001000 OCTOSPI1 — OCTO Serial Peripheral Interface
0xA0001400 OCTOSPI2 — OCTO Serial Peripheral Interface
0xE0042000 DBGMCU — Debug MCU

## Interrupts
0 WWDG — Window WatchDog Interrupt
2 TAMP_STAMP (TAMP) — Tamper and TimeStamp interrupts through the EXTI line
3 RTC_WKUP (RTC) — RTC Wakeup interrupt through the EXTI line
4 FLASH — FLASH global Interrupt
5 RCC — RCC global Interrupt
6 EXTI0 (EXTI) — EXTI Line0 Interrupt
7 EXTI1 (EXTI) — EXTI Line1 Interrupt
8 EXTI2 (EXTI) — EXTI Line2 Interrupt
9 EXTI3 (EXTI) — EXTI Line3 Interrupt
10 EXTI4 (EXTI) — EXTI Line4 Interrupt
11 DMA1_Channel1 (DMA1) — DMA1 Channel 1 global Interrupt
12 DMA1_Channel2 (DMA1) — DMA1 Channel 2 global Interrupt
13 DMA1_Channel3 (DMA1) — DMA1 Channel 3 global Interrupt
14 DMA1_Channel4 (DMA1) — DMA1 Channel 4 global Interrupt
15 DMA1_Channel5 (DMA1) — DMA1 Channel 5 global Interrupt
16 DMA1_Channel6 (DMA1) — DMA1 Channel 6 global Interrupt
17 DMA1_Channel7 (DMA1) — DMA1 Channel 7 global Interrupt
18 ADC1_2 (ADC1) — ADC1, ADC2 SAR global Interrupts
19 CAN1_TX (CAN1) — CAN1 TX Interrupt
20 CAN1_RX0 (CAN1) — CAN1 RX0 Interrupt
21 CAN1_RX1 (CAN1) — CAN1 RX1 Interrupt
22 CAN1_SCE (CAN1) — CAN1 SCE Interrupt
23 EXTI9_5 (EXTI) — External Line[9:5] Interrupts
24 TIM1_BRK_TIM15 (TIM15) — TIM1 Break interrupt and TIM15 global interrupt
25 TIM1_UP_TIM16 (TIM16) — TIM1 Update Interrupt and TIM16 global interrupt
26 TIM1_TRG_COM_TIM17 (TIM17) — TIM1 Trigger and Commutation Interrupt and TIM17 global interrupt
27 TIM1_CC (TIM1) — TIM1 Capture Compare Interrupt
28 TIM2 — TIM2 global Interrupt
29 TIM3 — TIM3 global Interrupt
30 TIM4 — TIM4 global Interrupt
31 I2C1_EV (I2C1) — I2C1 Event Interrupt
32 I2C1_ER (I2C1) — I2C1 Error Interrupt
33 I2C2_EV (I2C2) — I2C2 Event Interrupt
34 I2C2_ER (I2C2) — I2C2 Error Interrupt
35 SPI1 — SPI1 global Interrupt
36 SPI2 — SPI2 global Interrupt
37 USART1 — USART1 global Interrupt
38 USART2 — USART2 global Interrupt
39 USART3 — USART3 global Interrupt
40 EXTI15_10 (EXTI) — External Line[15:10] Interrupts
41 RTC_Alarm (RTC) — RTC Alarm (A and B) through EXTI Line Interrupt
43 TIM8_BRK (TIM8) — TIM8 Break Interrupt
44 TIM8_UP (TIM8) — TIM8 Update Interrupt
45 TIM8_TRG_COM (TIM8) — TIM8 Trigger and Commutation Interrupt
46 TIM8_CC (TIM8) — TIM8 Capture Compare Interrupt
47 SDMMC2 — SDMMC2 global Interrupt
49 SDMMC1 — SDMMC1 global Interrupt
50 TIM5 — TIM5 global Interrupt
51 SPI3 — SPI3 global Interrupt
52 UART4 — UART4 global Interrupt
53 UART5 — UART5 global Interrupt
54 TIM6_DAC (TIM6, DAC) — TIM6 global and DAC1&2 underrun error interrupts
55 TIM7 — TIM7 global interrupt
56 DMA2_Channel1 (DMA2) — DMA2 Channel 1 global Interrupt
57 DMA2_Channel2 (DMA2) — DMA2 Channel 2 global Interrupt
58 DMA2_Channel3 (DMA2) — DMA2 Channel 3 global Interrupt
59 DMA2_Channel4 (DMA2) — DMA2 Channel 4 global Interrupt
60 DMA2_Channel5 (DMA2) — DMA2 Channel 5 global Interrupt
61 DFSDM1_FLT0 (DFSDM1) — DFSDM1 Filter 0 global Interrupt
62 DFSDM1_FLT1 (DFSDM1) — DFSDM1 Filter 1 global Interrupt
64 COMP (COMP1, COMP2) — COMP1 and COMP2 Interrupts
65 LPTIM1 — LP TIM1 interrupt
66 LPTIM2 — LP TIM2 interrupt
67 OTG_FS (USB_OTG_FS) — USB OTG FS global Interrupt
68 DMA2_Channel6 (DMA2) — DMA2 Channel 6 global interrupt
69 DMA2_Channel7 (DMA2) — DMA2 Channel 7 global interrupt
70 LPUART1 — LP UART1 interrupt
71 OCTOSPI1 — OctoSPI1 global interrupt
72 I2C3_EV (I2C3) — I2C3 event interrupt
73 I2C3_ER (I2C3) — I2C3 error interrupt
74 SAI1 — Serial Audio Interface 1 global interrupt
75 SAI2 — Serial Audio Interface 2 global interrupt
76 OCTOSPI2 — OctoSPI2 global interrupt
77 TSC — Touch Sense Controller global interrupt
79 AES — AES global interrupt
80 RNG — RNG global interrupt
82 HASH_CRS (CRS, HASH) — HASH and CRS interrupt
83 I2C4_ER (I2C4) — I2C4 Error interrupt
84 I2C4_EV (I2C4) — I2C4 Event interrupt
85 DCMI_PSSI (DCMI, PSSI) — DCMI and PSSI global interrupt
86 PKA — PKA global interrupt
90 DMA2D — DMA2D global interrupt
91 LTDC — LTDC global Interrupt
92 LTDC_ER (LTDC) — LTDC Error global Interrupt
94 DMAMUX1_OVR (DMAMUX1) — DMAMUX1 overrun global interrupt

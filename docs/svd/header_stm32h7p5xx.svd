# STM32H7P5xx register map
File version: 1.0
Registers are 32-bit, read-write, reset 0x0 unless marked. A register's access mark holds for its fields unless they carry their own. Offsets are from the block's base; lines under a group give offsets from that group; [hi:lo] are bit positions; {n}, {i} and the like mark numbered series; 'fields as' and 'values as' point back to an identical list; <NAME> marks a mode.

## Memory map
0x40000000 TIM2 — General Purpose Timer
0x40000400 TIM3 — General Purpose Timer
0x40000800 TIM4 — General Purpose Timer
0x40000C00 TIM5 — General Purpose Timer
0x40001000 TIM6 — General Purpose Timer
0x40001400 TIM7 — General Purpose Timer
0x40001800 TIM12 — General Purpose Timer
0x40001C00 TIM13 — General Purpose Timer
0x40002000 TIM14 — General Purpose Timer
0x40002400 LPTIM1 — Low Power Timer
0x40002C00 WWDG — Window Watchdog
0x40003000 TIM10 — General Purpose Timer
0x40003400 TIM11 — General Purpose Timer
0x40003800 SPI2 — Serial Peripheral Interface (SPI)
0x40003C00 SPI3 — Serial Peripheral Interface (SPI)
0x40004400 USART2 — Universal Synchronous Asynchronous Receiver Transmitter
0x40004800 USART3 — Universal Synchronous Asynchronous Receiver Transmitter
0x40004C00 UART4 — Universal Synchronous Asynchronous Receiver Transmitter
0x40005000 UART5 — Universal Synchronous Asynchronous Receiver Transmitter
0x40005400 I2C1 — Inter-integrated Circuit Interface
0x40005800 I2C2 — Inter-integrated Circuit Interface
0x40005C00 I2C3 — Inter-integrated Circuit Interface
0x40006000 I3C1 — Improved Inter-integrated Circuit Interface
0x40007800 UART7 — Universal Synchronous Asynchronous Receiver Transmitter
0x40007C00 UART8 — Universal Synchronous Asynchronous Receiver Transmitter
0x40008400 CRS — Clock Recovery System
0x4000A000 FDCAN1 — FD Controller Area Network (FDCAN)
0x4000A100 FDCAN_CONFIG — FD Controller Area Network Configuration
0x4000A400 FDCAN2 — FD Controller Area Network (FDCAN)
0x4000A800 FDCAN3 — FD Controller Area Network (FDCAN)
0x4000EC00 UCPD1 — USB Power Delivery Interface (UCPD)
0x40020C00 HSP1 — Hardware signal processor (HSP)
0x40021000 GPDMA1 — DMA Controller
0x4002F000 ADF1 — Audio Digital Filter (ADF)
0x40080000 USB_OTG_FS — USB_OTG_Core_Registers
0x42000000 TIM1 — General Purpose Timer
0x42000400 TIM8 — General Purpose Timer
0x42000800 TIM20 — General Purpose Timer
0x42001000 USART1 — Universal Synchronous Asynchronous Receiver Transmitter
0x42001400 USART6 — Universal Synchronous Asynchronous Receiver Transmitter
0x42001800 UART9 — Universal Synchronous Asynchronous Receiver Transmitter
0x42001C00 USART10 — Universal Synchronous Asynchronous Receiver Transmitter
0x42003000 SPI1 — Serial Peripheral Interface (SPI)
0x42003400 SPI4 — Serial Peripheral Interface (SPI)
0x42004000 TIM15 — General Purpose Timer
0x42004400 TIM16 — General Purpose Timer
0x42004800 TIM17 — General Purpose Timer
0x42004C00 TIM9 — General Purpose Timer
0x42005000 SPI5 — Serial Peripheral Interface (SPI)
0x42006000 HRTIM1
0x42007000 HRTIM2
0x48004400 CORDIC
0x48004800 FMAC1 — Filter Mathematical ACcelerator unit (FMAC)
0x48020000 RNG — True random number generator (RNG)
0x48020400 HASH — Hash processor
0x48026000 ADC1 — Analog to digital converter (ADC)
0x48026100 ADC2 — Analog to digital converter (ADC)
0x48026300 ADC12_COMMON
0x48026400 ADC3 — Analog to digital converter (ADC)
0x48026500 ADC4 — Analog to digital converter (ADC)
0x48026700 ADC34_COMMON
0x48027000 DAC1 — Digital to Analog Converter (DAC)
0x48027400 DAC2 — Digital to Analog Converter (DAC)
0x48027800 DAC3 — Digital to Analog Converter (DAC)
0x48027C00 DAC4 — Digital to Analog Converter (DAC)
0x52000000 HPDMA1 — DMA Controller
0x52002000 FLASH — FLASH Registers
0x52004000 FMC_NORSRAM1
0x52004080 FMC_NAND — Flexible Memory Controller NAND Bank3 configuration
0x52004140 FMC_SDRAM — Flexible Memory Controller SDRAM Bank1 and Bank2 configuration
0x52005000 XSPI1 — Extended-SPI interface (XSPI)
0x52006000 DLYB_XSPI1 — Delay Block (DLYB)
0x52007000 SDMMC1 — Secure Digital Card/IO Embedded MultiMediaCard Interface
0x52008000 DLYB_SDMMC1 — Delay Block (DLYB)
0x52009000 RAMECC1 — RAM ECC monitoring (RAMECC)
0x58000000 EXTI — Extended interrupt and event controller (EXTI)
0x58000400 SBS — System configuration, Boot and Security (SBS)
0x58000C00 LPUART1 — Universal Synchronous Asynchronous Receiver Transmitter
0x58001400 SPI6 — Serial Peripheral Interface (SPI)
0x58002400 LPTIM2 — Low Power Timer
0x58002800 LPTIM3 — Low Power Timer
0x58002C00 LPTIM4 — Low Power Timer
0x58003000 LPTIM5 — Low Power Timer
0x58003C00 VREFBUF — Voltage Reference Buffer (VREFBUF)
0x58004000 RTC — Real-time clock (RTC)
0x58004400 TAMP — Tamper and backup registers (TAMP)
0x58004800 IWDG — Independent watchdog (IWDG)
0x58006800 DTS — Digital Temperature Sensor (DTS)
{0x58006E00+0x200*n} COMP{n} (n=1..8) — Comparator (COMP)
0x58007000 COMP12_COMMON
0x58007400 COMP34_COMMON
0x58007800 COMP56_COMMON
0x58007C00 COMP78_COMMON
0x58020000 GPIOA — General-purpose I/Os (GPIO)
0x58020400 GPIOB — General-purpose I/Os (GPIO)
0x58020800 GPIOC — General-purpose I/Os (GPIO)
0x58020C00 GPIOD — General-purpose I/Os (GPIO)
0x58021000 GPIOE — General-purpose I/Os (GPIO)
0x58021400 GPIOF — General-purpose I/Os (GPIO)
0x58021800 GPIOG — General-purpose I/Os (GPIO)
0x58021C00 GPIOH — General-purpose I/Os (GPIO)
0x58022000 GPIOI — General-purpose I/Os (GPIO)
0x58024400 RCC — Reset and clock control (RCC)
0x58024800 PWR — Power control (PWR)
0x58024C00 CRC — CRC calculation unit (CRC)
0x58027000 RAMECC2 — RAM ECC monitoring (RAMECC)
0x5C001000 DBGMCU
0xBFF00000 AXIM

## Interrupts
0 PWR_PVD_AVD (PWR) — PVDOUT and AVD through the EXTI line
2 DTS — DTS global interrupt
3 IWDG — Independent watchdog early warning interrupt
4 WWDG — Window Watchdog early warning interrupt
5 RCC — RCC_RDY interrupt (Osc, PLL)
8 FLASH — Flash interface
9 RAMECC (RAMECC1, RAMECC2) — RAMECC1 OR RAMECC2 interrupt
13 TAMP — Tamper interrupt through the EXTI line
{n+16} EXTI{n} (EXTI) (n=0..15) — EXTI Line {n} interrupt through the EXTI line
32 RTC — RTC Wakeup/alarmA+B/timestamp/SSRU interrupt through the EXTI line
34 ADC2 — ADC2 global interrupt
35 ADC4 — ADC4 global interrupt
36 HASH — HASH global interrupt
37 RNG — RNG global interrupt
38 ADC1 — ADC1 global interrupt
{n+39} GPDMA1_CH{n} (GPDMA1) (n=0..7) — GPDMA1 channel {n} interrupt
47 TIM1_BRK_TERR_IERR (TIM1) — TIM1 Break interrupt
48 TIM1_UPD (TIM1) — TIM1 Update interrupt
49 TIM1_TRGI_COM_DIR_IDX (TIM1) — TIM1 Trigger and Commutation interrupts
50 TIM1_CC (TIM1) — TIM1 Capture Compare interrupt
51 TIM2 — TIM2 global interrupt
52 TIM3 — TIM3 global interrupt
53 TIM4 — TIM4 global interrupt
54 TIM5 — TIM5 global interrupt
55 TIM6 — TIM6 global interrupt
56 TIM7 — TIM7 global interrupt
57 TIM9 — TIM9 global interrupt
58 SPI1 — SPI1 global interrupt
59 SPI2 — SPI2 global interrupt
60 SPI3 — SPI3 global interrupt
61 SPI4 — SPI4 global interrupt
62 SPI5 — SPI5 global interrupt
63 SPI6 — SPI6 global interrupt
{n+64} HPDMA1_CH{n} (HPDMA1) (n=0..7) — HPDMA1 channel {n} interrupt
72 TIM8_BRK_TERR_IERR (TIM8) — TIM8 Break interrupt/TIM8 Transition error/TIM8 Index error
73 TIM8_UPD (TIM8) — TIM8 Update interrupt
74 TIM8_TRGI_COM_DIR_IDX (TIM8)
75 TIM8_CC (TIM8) — TIM8 capture compare interrupt
76 I2C1_EV (I2C1) — I2C1 event interrupt
77 I2C1_ERR (I2C1) — I2C1 error interrupt
78 I2C2_EV (I2C2) — I2C2 event interrupt
79 I2C2_ERR (I2C2) — I2C2 error interrupt
80 I2C3_EV (I2C3) — I2C3 event interrupt
81 I2C3_ERR (I2C3) — I2C3 error interrupt
82 USART1 — USART1 global interrupt
83 USART2 — USART2 global interrupt
84 USART3 — USART3 global interrupt
85 UART4 — UART4 global interrupt
86 UART5 — UART5 global interrupt
87 UART7 — UART7 global interrupt
88 UART8 — UART8 global interrupt
89 I3C1_EV (I3C1) — I3C1 event interrupt
90 I3C1_ERR (I3C1) — I3C1 error interrupt
92 FMAC1 — FMAC1 global interrupt
93 CORDIC — CORDIC interrupt
94 ADC3 — ADC3 global interrupt
95 TIM20_BRK_TERR_IERR (TIM20) — TIM20 Break interrupt/TIM20 Transition error/TIM20 Index error
96 TIM20_UPD (TIM20) — TIM20 Update interrupt
97 TIM20_TRGI_COM_DIR_IDX (TIM20)
98 TIM20_CC (TIM20) — TIM20 capture compare interrupt
99 TIM10 — TIM10 global interrupt
100 TIM11 — TIM11 global interrupt
101 I3C1_WKUP (I3C1) — I3C wakeup Interrupt through EXTI line
105 XSPI1 — XSPI1 global interrupt
106 HSP1 — HSP global interrupt
108 SDMMC1 — SDMMC1 global interrupt
109 HSP1_ERR (HSP1) — HSP error interrupt
110 HSP1_EVT (HSP1) — HSP event interrupt
111 HSP1_FWEVT (HSP1) — HSP firmware event interrupt
112 USB_OTG_FS — USB OTG FS global/wakeup/vbus interrupt
113 TIM12 — TIM12 global interrupt
114 TIM13 — TIM13 global interrupt
115 TIM14 — TIM14 global interrupt
116 TIM15 — TIM15 global interrupt
117 TIM16 — TIM16 global interrupt
118 TIM17 — TIM17 global interrupt
119 LPTIM1 — LPTIM1 global interrupt
120 LPTIM2 — LPTIM2 global interrupt
121 LPTIM3 — LPTIM3 global interrupt
122 LPTIM4 — LPTIM4 global interrupt
123 LPTIM5 — LPTIM5 global interrupt
124 UART9 — UART9 global interrupt
125 USART10 — USART10 global interrupt
126 ADF1_FLT0 (ADF1) — ADF1 filter 0 global interrupt
127 CRS — CRS global interrupt
128 UCPD1 — UCPD global interrupt
130 USART6 — USART6 global interrupt
131 LPUART1 — LPUART1 global interrupt
{n+125} GPDMA1_CH{n} (GPDMA1) (n=8..15) — GPDMA1 channel {n} interrupt
{n+133} HPDMA1_CH{n} (HPDMA1) (n=8..15) — HPDMA1 channel {n} interrupt
150 FDCAN3_IT0 (FDCAN3) — FDCAN3 interrupt 0
151 FDCAN3_IT1 (FDCAN3) — FDCAN3 interrupt 1
152 FDCAN1_IT0 (FDCAN1) — FDCAN1 interrupt 0
153 FDCAN1_IT1 (FDCAN1) — FDCAN1 interrupt 1
154 FDCAN2_IT0 (FDCAN2) — FDCAN2 interrupt 0
155 FDCAN2_IT1 (FDCAN2) — FDCAN2 interrupt 1
156 DAC1 — DAC1/2 underrun interrupt
157 DAC2 — DAC3/4 underrun interrupt
158 DAC3 — DAC5/6 underrun interrupt
159 DAC4 — DAC7/8 underrun interrupt
160 COMP1 — COMP1 interrupt through EXTI line
161 COMP2 — COMP2 interrupt through EXTI line
162 COMP3 — COMP3 interrupt through EXTI line
163 COMP4 — COMP4 interrupt through EXTI line
164 HRTIM1_M (HRTIM1) — HRtimer1 master interrupt
165 HRTIM1_TIMA (HRTIM1) — HRtimer1 slave1 interrupt
166 HRTIM1_TIMB (HRTIM1) — HRtimer1 slave2 interrupt
167 HRTIM1_TIMC (HRTIM1) — HRtimer1 slave3 interrupt
168 HRTIM1_TIMD (HRTIM1) — HRtimer1 slave4 interrupt
169 HRTIM1_TIME (HRTIM1) — HRtimer1 slave5 interrupt
170 HRTIM1_TIMF (HRTIM1) — HRtimer1 slave6 interrupt
171 HRTIM1_FLT (HRTIM1) — HRtimer1 error interrupt
172 HRTIM2_M (HRTIM2) — HRtimer1 master interrupt
173 HRTIM2_TIMA (HRTIM2) — HRtimer1 slave1 interrupt
174 HRTIM2_TIMB (HRTIM2) — HRtimer1 slave2 interrupt
175 HRTIM2_TIMC (HRTIM2) — HRtimer1 slave3 interrupt
176 HRTIM2_TIMD (HRTIM2) — HRtimer1 slave4 interrupt
177 HRTIM2_TIME (HRTIM2) — HRtimer1 slave5 interrupt
178 HRTIM2_TIMF (HRTIM2) — HRtimer1 slave6 interrupt
179 HRTIM2_FLT (HRTIM2) — HRtimer1 error interrupt
180 COMP5 — COMP5 interrupt through EXTI line
181 COMP6 — COMP6 interrupt through EXTI line
182 COMP7 — COMP7 interrupt through EXTI line
183 COMP8 — COMP8 interrupt through EXTI line

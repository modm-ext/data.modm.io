# STM32WB5Mxx register map
File version: 1.0
Registers are 32-bit, read-write, reset 0x0 unless marked. A register's access mark holds for its fields unless they carry their own. Offsets are from the block's base; lines under a group give offsets from that group; [hi:lo] are bit positions; {n}, {i} and the like mark numbered series; 'fields as' and 'values as' point back to an identical list; <NAME> marks a mode.

## Memory map
0x40000000 TIM2 — TIM
0x40002400 LCD
0x40002800 RTC — Real-Time Clock
0x40002C00 WWDG — Window WATCHDOG
0x40003000 IWDG — Independent WATCHDOG
0x40003800 SPI2 — Serial Peripheral Interface
0x40005400 I2C1 — Inter-integrated Circuit Interface
0x40005C00 I2C3 — Inter-integrated Circuit Interface
0x40006000 CRS — Clock Recovery System
0x40006800 USB — Universal Serial Bus Full Speed Device
0x40007C00 LPTIM1 — LPTIMER
0x40008000 LPUART1 — Universal Synchronous Asynchronous Receiver Transmitter
0x40009400 LPTIM2 — LPTIMER
0x40010000 SYSCFG — System configuration controller
0x40010030 VREFBUF
0x40010200 COMP1 — Comparator
0x40010204 COMP12_COMMON
0x40010204 COMP2 — Comparator
0x40012C00 TIM1 — TIM
0x40013000 SPI1 — Serial Peripheral Interface
0x40013800 USART1 — Universal Synchronous Asynchronous Receiver Transmitter
0x40014400 TIM16 — TIM
0x40014800 TIM17 — TIM
0x40015400 SAI1 — Serial Audio Interface
0x40020000 DMA1
0x40020400 DMA2
0x40020800 DMAMUX1 — DMA Multiplexer
0x40023000 CRC — CRC calculation unit
0x40024000 TSC — Touch Sensing Controller (TSC)
0x48000000 GPIOA — General Purpose I/O
0x48000400 GPIOB — General Purpose I/O
0x48000800 GPIOC — General Purpose I/O
0x48000C00 GPIOD — General Purpose I/O
0x48001000 GPIOE — General Purpose I/O
0x48001C00 GPIOH — General Purpose I/O
0x50040000 ADC1 — Analog to Digital Converter
0x50060000 AES1 — AES hardware accelerator
0x58000000 RCC — Reset and Clock Control
0x58000400 PWR — Power Control
0x58000800 EXTI — Async Interrupts and Events Controller
0x58000C00 IPCC — Inter-Processor Communication
0x58001000 RNG
0x58001400 HSEM — HW Semaphore HSEM
0x58001800 AES2 — AES hardware accelerator
0x58002000 PKA — Public Key Accelerator (PKA)
0x58004000 FLASH — FLASH Registers
0xA0001000 QUADSPI — QUAD Serial Peripheral Interface
0xE0042000 DBGMCU — Debug MCU

## Interrupts
0 WWDG — Window WatchDog Interrupt
3 RTC_WKUP (RTC) — RTC Wakeup Interrupt
4 FLASH — FLASH (CFI) global Interrupt
5 RCC — RCC Interrupt
6 EXTI0 (EXTI) — EXTI Line 0 Interrupt
7 EXTI1 (EXTI) — EXTI Line 1 Interrupt
8 EXTI2 (EXTI) — EXTI Line 2 Interrupt
9 EXTI3 (EXTI) — EXTI Line 3 Interrupt
10 EXTI4 (EXTI) — EXTI Line 4 Interrupt
11 DMA1_Channel1 (DMA1) — DMA1 Channel 1 Interrupt
12 DMA1_Channel2 (DMA1) — DMA1 Channel 2 Interrupt
13 DMA1_Channel3 (DMA1) — DMA1 Channel 3 Interrupt
14 DMA1_Channel4 (DMA1) — DMA1 Channel 4 Interrupt
15 DMA1_Channel5 (DMA1) — DMA1 Channel 5 Interrupt
16 DMA1_Channel6 (DMA1) — DMA1 Channel 6 Interrupt
17 DMA1_Channel7 (DMA1) — DMA1 Channel 7 Interrupt
18 ADC1 — ADC1 Interrupt
19 USB_HP (USB) — USB High Priority Interrupt
20 USB_LP (USB) — USB Low Priority Interrupt (including USB wakeup)
21 C2SEV_PWR_C2H (PWR) — CPU2 SEV Interrupt
22 COMP (COMP1, COMP2) — COMP1 and COMP2 Interrupts
23 EXTI9_5 (EXTI) — EXTI Lines [9:5] Interrupt
24 TIM1_BRK (TIM1) — TIM1 Break Interrupt
25 TIM1_UP_TIM16 (TIM16) — TIM1 Update and TIM16 global Interrupts
26 TIM1_TRG_COM_TIM17 (TIM17) — TIM1 Trigger and Communication and TIM17 global Interrupts
27 TIM1_CC (TIM1) — TIM1 Capture Compare Interrupt
28 TIM2 — TIM2 Global Interrupt
29 PKA — PKA Interrupt
30 I2C1_EV (I2C1) — I2C1 Event Interrupt
31 I2C1_ER (I2C1) — I2C1 Error Interrupt
32 I2C3_EV (I2C3) — I2C3 Event Interrupt
33 I2C3_ER (I2C3) — I2C3 Error Interrupt
34 SPI1 — SPI1 Interrupt
35 SPI2 — SPI2 Interrupt
36 USART1 — USART1 Interrupt
37 LPUART1 — LPUART1 Interrupt
38 SAI1 — SAI1 A and B global interrupt
39 TSC — TSC Interrupt
40 EXTI15_10 (EXTI) — EXTI Lines1[15:10 ]Interrupts
41 RTC_Alarm (RTC) — RTC Alarms (A and B) Interrupt
42 CRS — CRS interrupt
43 PWR_SOTF_BLEACT_802ACT_RFPHASE (PWR)
44 IPCC_C1_RX (IPCC) — IPCC RX Occupied Interrupt
45 IPCC_C1_TX (IPCC) — IPCC TX Free Interrupt
46 HSEM — HSEM Interrupt
47 LPTIM1 — LPTIM1 Interrupt
48 LPTIM2 — LPTIM2 Interrupt
49 LCD — LCD Interrupt
50 QUADSPI — QUADSPI Interrupt
51 AES1 — AES1 Interrupt
52 AES2 — AES2 Interrupt
53 RNG — RNG Interrupt
55 DMA2_Channel1 (DMA2) — DMA2 Channel 1 Interrupt
56 DMA2_Channel2 (DMA2) — DMA2 Channel 2 Interrupt
57 DMA2_Channel3 (DMA2) — DMA2 Channel 3 Interrupt
58 DMA2_Channel4 (DMA2) — DMA2 Channel 4 Interrupt
59 DMA2_Channel5 (DMA2) — DMA2 Channel 5 Interrupt
60 DMA2_Channel6 (DMA2) — DMA2 Channel 6 Interrupt
61 DMA2_Channel7 (DMA2) — DMA2 Channel 7 Interrupt
62 DMAMUX1_OVR (DMAMUX1) — DMAMUX1 overrun Interrupt

# STM32H757xx_CM4 register map
File version: 1.0
STM32H757XX
Registers are 32-bit, read-write, reset 0x0 unless marked. A register's access mark holds for its fields unless they carry their own. Offsets are from the block's base; lines under a group give offsets from that group; [hi:lo] are bit positions; {n}, {i} and the like mark numbered series; 'fields as' and 'values as' point back to an identical list; <NAME> marks a mode.

## Memory map
0x40000000 TIM2 — TIM
0x40000400 TIM3 — TIM
0x40000800 TIM4 — TIM
0x40000C00 TIM5 — TIM
0x40001000 TIM6 — TIM
0x40001400 TIM7 — TIM
0x40001800 TIM12 — TIM
0x40001C00 TIM13 — TIM
0x40002000 TIM14 — TIM
0x40002400 LPTIM1 — LPTIMIMER
0x40002C00 WWDG2 — Window WATCHDOG
0x40003800 SPI2 — Serial Peripheral Interface
0x40003C00 SPI3 — Serial Peripheral Interface
0x40004000 SPDIFRX — SPDIF-RX Interface
0x40004400 USART2 — Universal Synchronous Asynchronous Receiver Transmitter
0x40004800 USART3 — Universal Synchronous Asynchronous Receiver Transmitter
0x40004C00 UART4 — Universal Synchronous Asynchronous Receiver Transmitter
0x40005000 UART5 — Universal Synchronous Asynchronous Receiver Transmitter
0x40005400 I2C1 — Inter-integrated Circuit Interface
0x40005800 I2C2 — Inter-integrated Circuit Interface
0x40005C00 I2C3 — Inter-integrated Circuit Interface
0x40006C00 CEC — Consumer Electronics Control
0x40007400 DAC1 — Digital to Analog Converter
0x40007800 UART7 — Universal Synchronous Asynchronous Receiver Transmitter
0x40007C00 UART8 — Universal Synchronous Asynchronous Receiver Transmitter
0x40008400 CRS — Clock Recovery System
0x40008800 SWPMI1 — Single Wire Protocol Master Interface SPWMI
0x40009000 OPAMP — Operational Amplifier (OPAMP)
0x40009000 OPAMP1 — Operational Amplifier (OPAMP)
0x40009010 OPAMP2 — Operational Amplifier (OPAMP)
0x40009400 MDIOS
0x4000A000 FDCAN1 — FD Controller Area Network
0x4000A400 FDCAN2 — FD Controller Area Network
0x4000A800 FDCAN_CCU — FD Controller Area Network
0x40010000 TIM1 — TIM
0x40010400 TIM8 — TIM
0x40011000 USART1 — Universal Synchronous Asynchronous Receiver Transmitter
0x40011400 USART6 — Universal Synchronous Asynchronous Receiver Transmitter
0x40013000 SPI1 — Serial Peripheral Interface
0x40013400 SPI4 — Serial Peripheral Interface
0x40014000 TIM15 — TIM
0x40014400 TIM16 — TIM
0x40014800 TIM17 — TIM
0x40015000 SPI5 — Serial Peripheral Interface
0x40015800 SAI1 — Serial Audio Interface
0x40015C00 SAI2 — Serial Audio Interface
0x40016000 SAI3 — Serial Audio Interface
0x40017000 DFSDM1
0x40017400 HRTIM1
0x40020000 DMA1
0x40020400 DMA2
0x40020800 DMAMUX1
0x40022000 ADC1 — Analog to Digital Converter
0x40022100 ADC2 — Analog to Digital Converter
0x40022300 ADC12_COMMON
0x40024400 ART
0x40028000 ETH — Ethernet MAC
0x40040000 USB1_OTG_HS — USB_OTG_Core_Registers
0x40080000 USB2_OTG_FS — USB_OTG_Core_Registers
0x48020000 DCMI
0x48021000 CRYP — Crypto Processor
0x48021400 HASH
0x48021800 RNG
0x48022400 SDMMC2 — Secure digital input/output Interface
0x48022800 DLYB_SDMMC2 — Delay Block DLYB
0x48023000 RAMECC2
0x50000000 DSI — DSI Controller
0x50001000 LTDC — LCD-TFT Display Controller
0x50003000 WWDG1 — Window WATCHDOG
0x51000000 GPV — Global Programmer View
0x52000000 MDMA — MDMA Controller
0x52001000 DMA2D — DMA2D Controller
0x52002000 FLASH — FLASH Registers
0x52003000 JPEG — JPEG Codec
0x52004000 FMC_Bank1_R — Flexible Memory Controller
0x52004060 FMC_Bank2_R — Flexible Memory Controller Bank2
0x52004080 FMC_Bank3_R — Flexible Memory Controller Bank3
0x52004104 FMC_Bank1E_R — Flexible Memory Controller Bank1E
0x52004140 FMC_Bank5_6_R — Flexible Memory Controller Bank5 and 6
0x52005000 QUADSPI — QUAD Serial Peripheral Interface
0x52006000 DLYB_QUADSPI — Delay Block DLYB
0x52007000 SDMMC1 — Secure digital input/output Interface
0x52008000 DLYB_SDMMC1 — Delay Block DLYB
0x52009000 RAMECC1
0x58000000 EXTI — External Interrupt/Event Controller
0x58000400 SYSCFG — System configuration controller
0x58000C00 LPUART1 — Universal Synchronous Asynchronous Receiver Transmitter
0x58001400 SPI6 — Serial Peripheral Interface
0x58001C00 I2C4 — Inter-integrated Circuit Interface
0x58002400 LPTIM2 — LPTIMIMER
0x58002800 LPTIM3 — LPTIMIMER
0x58002C00 LPTIM4 — LPTIMIMER
0x58003000 LPTIM5 — LPTIMIMER
0x58003800 COMP12 — Comparator
0x5800380C COMP1
0x58003810 COMP2
0x58003C00 VREFBUF
0x58004000 RTC — Real-Time Clock
0x58004800 IWDG1 — Independent WATCHDOG
0x58004C00 IWDG2 — Independent WATCHDOG
0x58005400 SAI4 — Serial Audio Interface
0x58020000 GPIOA — General Purpose I/O
0x58020400 GPIOB — General Purpose I/O
0x58020800 GPIOC — General Purpose I/O
0x58020C00 GPIOD — General Purpose I/O
0x58021000 GPIOE — General Purpose I/O
0x58021400 GPIOF — General Purpose I/O
0x58021800 GPIOG — General Purpose I/O
0x58021C00 GPIOH — General Purpose I/O
0x58022000 GPIOI — General Purpose I/O
0x58022400 GPIOJ — General Purpose I/O
0x58022800 GPIOK — General Purpose I/O
0x58024400 RCC — Reset and Clock Control
0x58024800 PWR — Power Control
0x58024C00 CRC — CRC calculation unit
0x58025400 BDMA
0x58025800 DMAMUX2
0x58026000 ADC3 — Analog to Digital Converter
0x58026400 HSEM — HW Semaphore HSEM
0x58027000 RAMECC3
0x5C001000 DBGMCU — Debug MCU

## Interrupts
0 WWDG (WWDG2, WWDG1) — Window WatchDog Interrupt ( wwdg1_it, wwdg2_it)
3 RTC_WKUP (RTC) — RTC Wakeup interrupt through the EXTI line
4 FLASH — FLASH global Interrupt
5 RCC — RCC global Interrupt
6 EXTI0 (EXTI) — EXTI Line0 Interrupt
7 EXTI1 (EXTI) — EXTI Line1 Interrupt
8 EXTI2 (EXTI) — EXTI Line2 Interrupt
9 EXTI3 (EXTI) — EXTI Line3 Interrupt
10 EXTI4 (EXTI) — EXTI Line4 Interrupt
11 DMA1_Stream0 (DMA1) — DMA1 Stream 0 global Interrupt
12 DMA1_Stream1 (DMA1) — DMA1 Stream 1 global Interrupt
13 DMA1_Stream2 (DMA1) — DMA1 Stream 2 global Interrupt
14 DMA1_Stream3 (DMA1) — DMA1 Stream 3 global Interrupt
15 DMA1_Stream4 (DMA1) — DMA1 Stream 4 global Interrupt
16 DMA1_Stream5 (DMA1) — DMA1 Stream 5 global Interrupt
17 DMA1_Stream6 (DMA1) — DMA1 Stream 6 global Interrupt
18 ADC (ADC{n} (n=1..3)) — ADC1 and ADC2 global Interrupts
19 FDCAN1_IT0 (FDCAN1) — FDCAN1 Interrupt line 0
20 FDCAN2_IT0 (FDCAN2) — FDCAN2 Interrupt line 0
21 FDCAN1_IT1 (FDCAN1) — FDCAN1 Interrupt line 1
22 FDCAN2_IT1 (FDCAN2) — FDCAN2 Interrupt line 1
23 EXTI9_5 (EXTI) — External Line[9:5] Interrupts
24 TIM1_BRK (TIM1) — TIM1 Break Interrupt
25 TIM1_UP (TIM1) — TIM1 Update Interrupt
26 TIM1_TRG_COM (TIM1) — TIM1 Trigger and Commutation Interrupt
27 TIM1_CC (TIM1) — TIM1 Capture Compare Interrupt
28 TIM2 — TIM2 global Interrupt
29 TIM3 — TIM3 global Interrupt
30 TIM4 — TIM4 global Interrupt
31 I2C1_EV (I2C1) — I2C1 Event Interrupt
32 I2C1_ER (I2C1) — I2C1 Error Interrupt
33 I2C2_EV (I2C2) — I2C2 Event Interrupt
34 I2C2_ER (I2C2) — I2C2 Error Interrupt
35 SPI1 — SPI1 global Interrupt
36 SPI2 — SPI2 global Interrupt
37 USART1 — USART1 global Interrupt
38 USART2 — USART2 global Interrupt
39 USART3 — USART3 global Interrupt
40 EXTI15_10 (EXTI) — External Line[15:10] Interrupts
41 RTC_Alarm (RTC) — RTC Alarm (A and B) through EXTI Line Interrupt
43 TIM8_BRK_TIM12 (TIM12, TIM8) — TIM8 Break Interrupt and TIM12 global interrupt
44 TIM8_UP_TIM13 (TIM13, TIM8) — TIM8 Update Interrupt and TIM13 global interrupt
45 TIM8_TRG_COM_TIM14 (TIM14, TIM8) — TIM8 Trigger and Commutation Interrupt and TIM14 global interrupt
46 TIM8_CC (TIM8) — TIM8 Capture Compare Interrupt
47 DMA1_Stream7 (DMA1) — DMA1 Stream7 Interrupt
49 SDMMC1 — SDMMC1 global Interrupt
50 TIM5 — TIM5 global Interrupt
51 SPI3 — SPI3 global Interrupt
52 UART4 — UART4 global Interrupt
53 UART5 — UART5 global Interrupt
54 TIM6_DAC (TIM6) — TIM6 global and DAC1&2 underrun error interrupts
55 TIM7 — TIM7 global interrupt
56 DMA2_Stream0 (DMA2) — DMA2 Stream 0 global Interrupt
57 DMA2_Stream1 (DMA2) — DMA2 Stream 1 global Interrupt
58 DMA2_Stream2 (DMA2) — DMA2 Stream 2 global Interrupt
59 DMA2_Stream3 (DMA2) — DMA2 Stream 3 global Interrupt
60 DMA2_Stream4 (DMA2) — DMA2 Stream 4 global Interrupt
61 ETH — Ethernet global Interrupt
62 ETH_WKUP (ETH) — Ethernet Wakeup through EXTI line Interrupt
63 FDCAN_CAL (FDCAN1, FDCAN2) — FDCAN Calibration unit Interrupt
68 DMA2_Stream5 (DMA2) — DMA2 Stream 5 global interrupt
69 DMA2_Stream6 (DMA2) — DMA2 Stream 6 global interrupt
70 DMA2_Stream7 (DMA2) — DMA2 Stream 7 global interrupt
71 USART6 — USART6 global interrupt
72 I2C3_EV (I2C3) — I2C3 event interrupt
73 I2C3_ER (I2C3) — I2C3 error interrupt
74 OTG_HS_EP1_OUT (USB1_OTG_HS) — USB OTG HS End Point 1 Out global interrupt
75 OTG_HS_EP1_IN (USB1_OTG_HS) — USB OTG HS End Point 1 In global interrupt
76 OTG_HS_WKUP (USB1_OTG_HS) — USB OTG HS Wakeup through EXTI interrupt
77 OTG_HS (USB1_OTG_HS) — USB OTG HS global interrupt
78 DCMI — DCMI global interrupt
79 CRYP — CRYP crypto global interrupt
80 HASH_RNG (HASH, RNG) — HASH and RNG global interrupt
82 UART7 — UART7 global interrupt
83 UART8 — UART8 global interrupt
84 SPI4 — SPI4 global Interrupt
85 SPI5 — SPI5 global Interrupt
86 SPI6 — SPI6 global Interrupt
87 SAI1 — SAI1 global Interrupt
88 LTDC — LTDC global Interrupt
89 LTDC_ER (LTDC) — LTDC Error global Interrupt
90 DMA2D — DMA2D global Interrupt
91 SAI2 — SAI2 global Interrupt
92 QUADSPI — Quad SPI global interrupt
93 LPTIM1 — LP TIM1 interrupt
94 CEC — HDMI-CEC global Interrupt
95 I2C4_EV (I2C4) — I2C4 Event Interrupt
96 I2C4_ER (I2C4) — I2C4 Error Interrupt
98 OTG_FS_EP1_OUT (USB2_OTG_FS) — USB OTG HS2 global interrupt
99 OTG_FS_EP1_IN (USB2_OTG_FS) — USB OTG HS2 End Point 1 Out global interrupt
100 OTG_FS_WKUP (USB2_OTG_FS) — USB OTG HS2 End Point 1 In global interrupt
101 OTG_FS (USB2_OTG_FS) — USB OTG HS2 Wakeup through EXTI interrupt
102 DMAMUX1_OVR (DMAMUX1) — DMAMUX1 Overrun interrupt
103 HRTIM1_Master (HRTIM1) — HRTIM Master Timer global Interrupts
104 HRTIM1_TIMA (HRTIM1) — HRTIM Timer A global Interrupt
105 HRTIM1_TIMB (HRTIM1) — HRTIM Timer B global Interrupt
106 HRTIM1_TIMC (HRTIM1) — HRTIM Timer C global Interrupt
107 HRTIM1_TIMD (HRTIM1) — HRTIM Timer D global Interrupt
108 HRTIM1_TIME (HRTIM1) — HRTIM Timer E global Interrupt
109 HRTIM1_FLT (HRTIM1) — HRTIM Fault global Interrupt
110 DFSDM1_FLT0 (DFSDM1) — DFSDM Filter1 Interrupt
111 DFSDM1_FLT1 (DFSDM1) — DFSDM Filter2 Interrupt
112 DFSDM1_FLT2 (DFSDM1) — DFSDM Filter3 Interrupt
113 DFSDM1_FLT3 (DFSDM1) — DFSDM Filter4 Interrupt
114 SAI3 — SAI3 global Interrupt
115 SWPMI1 — Serial Wire Interface 1 global interrupt
116 TIM15 — TIM15 global Interrupt
117 TIM16 — TIM16 global Interrupt
118 TIM17 — TIM17 global Interrupt
119 MDIOS_WKUP (MDIOS) — MDIOS Wakeup Interrupt
120 MDIOS — MDIOS global Interrupt
121 JPEG — JPEG global Interrupt
122 MDMA — MDMA global Interrupt
123 DSI — DSI global Interrupt
124 SDMMC2 — SDMMC2 global Interrupt
125 HSEM1 (HSEM) — HSEM1 global Interrupt
126 HSEM2 (HSEM) — HSEM2 global Interrupt
127 ADC3 — ADC3 global Interrupt
128 DMAMUX2_OVR (DMAMUX2) — DMAMUX2 Overrun interrupt
{n+129} BDMA_Channel{n} (BDMA) (n=0..7) — BDMA Channel {n} global Interrupt
137 COMP (COMP12, COMP2) — COMP global Interrupt
138 LPTIM2 — LP TIM2 global interrupt
139 LPTIM3 — LP TIM3 global interrupt
140 LPTIM4 — LP TIM4 global interrupt
141 LPTIM5 — LP TIM5 global interrupt
142 LPUART1 — LP UART1 interrupt
143 WWDG_RST (WWDG2, WWDG1) — Window Watchdog reset interrupt (exti_d2_wwdg_it, exti_d1_wwdg_it)
144 CRS — Clock Recovery Global Interrupt
146 SAI4 — SAI4 global interrupt

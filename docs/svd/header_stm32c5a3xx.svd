# STM32C5A3xx register map
File version: 1.0
Registers are 32-bit, read-write, reset 0x0 unless marked. A register's access mark holds for its fields unless they carry their own. Offsets are from the block's base; lines under a group give offsets from that group; [hi:lo] are bit positions; {n}, {i} and the like mark numbered series; 'fields as' and 'values as' point back to an identical list; <NAME> marks a mode.

## Memory map
0x0BF883E0 EXITHDPLIB_PFUNC — EXITHDPLIB function pointer structure
0x40000000 TIM2 — TIM Address block
0x40000400 TIM3 — TIM Address block
0x40000800 TIM4 — TIM Address block
0x40000C00 TIM5 — TIM Address block
0x40001000 TIM6 — TIM Address block
0x40001400 TIM7 — TIM Address block
0x40001800 TIM12 — TIM Address block
0x40002C00 WWDG
0x40003000 IWDG
0x40003800 SPI2 — Serial peripheral interface (SPI)
0x40003C00 SPI3 — Serial peripheral interface (SPI)
0x40004000 COMP1 — Comparator
0x40004400 USART2 — Universal Synchronous Asynchronous Receiver Transmitter
0x40004800 USART3 — Universal Synchronous Asynchronous Receiver Transmitter
0x40004C00 UART4 — Universal Synchronous Asynchronous Receiver Transmitter
0x40005000 UART5 — Universal Synchronous Asynchronous Receiver Transmitter
0x40005400 I2C1 — Inter-integrated Circuit Interface
0x40005800 I2C2 — Inter-integrated Circuit Interface
0x40005C00 I3C1 — Improved Inter-integrated Circuit Interface
0x40006000 CRS — Clock Recovery System
0x40006400 USART6 — Universal Synchronous Asynchronous Receiver Transmitter
0x40007800 UART7 — Universal Synchronous Asynchronous Receiver Transmitter
0x4000A400 FDCAN1 — FD Controller Area Network
0x4000A500 FDCAN_CONFIG — FD Controller Area Network Configuration
0x4000A800 FDCAN2 — FD Controller Area Network
0x40012C00 TIM1 — TIM Address block
0x40013000 SPI1 — Serial peripheral interface (SPI)
0x40013400 TIM8 — TIM Address block
0x40013800 USART1 — Universal Synchronous Asynchronous Receiver Transmitter
0x40014000 TIM15 — TIM Address block
0x40014400 TIM16 — TIM Address block
0x40014800 TIM17 — TIM Address block
0x40016000 USB_DRD_FS — Universal Serial Bus Full Speed Dual Role Device
0x40016400 USB_DRD_PMA_BUFF — Universal Serial Bus PacketMemoryArea Buffer Descriptor Table
0x40020000 LPDMA1 — DMA Controller (DMA)
0x40021000 LPDMA2 — DMA Controller (DMA)
0x40022000 FLASH — FLASH Registers
0x40023000 CRC — CRC calculation unit
0x40023800 CORDIC
0x40026000 RAMCFG
0x40028000 ETH1 — Ethernet Peripheral
0x40030400 ICACHE — Instruction cache (ICACHE)
0x42020000 GPIOA — General Purpose I/O (GPIO)
0x42020400 GPIOB — General Purpose I/O (GPIO)
0x42020800 GPIOC — General Purpose I/O (GPIO)
0x42020C00 GPIOD — General Purpose I/O (GPIO)
0x42021000 GPIOE — General Purpose I/O (GPIO)
0x42021400 GPIOF — General Purpose I/O (GPIO)
0x42021800 GPIOG — General Purpose I/O (GPIO)
0x42021C00 GPIOH — General Purpose I/O (GPIO)
0x42028000 ADC1 — ADC Analog to Digital Converter
0x42028100 ADC2 — ADC Analog to Digital Converter
0x42028300 ADC12_COMMON
0x42028400 DAC1 — Digital to Analog Converter
0x4202D800 ADC3 — ADC Analog to Digital Converter
0x420C0000 AES — AES hardware accelerator (AES)
0x420C0400 HASH — Hash processor (HASH)
0x420C0800 RNG — True random number generator (RNG)
0x420C0C00 SAES — AES hardware accelerator (AES)
0x420C2000 PKA — Public key accelerator (PKA)
0x420C7C00 CCB — Coupling and chaining bridge
0x44000400 SBS — System configuration, boot and security (SBS)
0x44002400 LPUART1 — Universal Synchronous Asynchronous Receiver Transmitter
0x44004400 LPTIM1 — LPTIMER
0x44007800 RTC — Real-Time Clock
0x44007C00 TAMP — Tamper and backup registers
0x44020800 PWR — Power Control (PWR)
0x44020C00 RCC — Reset and clock control (RCC)
0x44022000 EXTI — Extended interrupts and event controller (EXTI)
0x44024000 DBGMCU — Debug MCU (DBGMCU)
0x4600F000 DLYB_XSPI1 — Delay block (DLYB)
0x47001400 XSPI1 — Extended-SPI interface (XSPI)

## Interrupts
0 WWDG — Window Watchdog interrupt
1 PWR_PVD (PWR) — Power Voltage Monitor
2 RTC — RTC global non-secure interrupts
3 TAMP — Tamper global interrupts
4 RAMCFG — RAM configuration global interrupt
5 FLASH — Flash non-secure global interrupt
6 RCC — RCC non-secure global interrupt
{n+7} EXTI{n} (EXTI) (n=0..15) — EXTI Line{n} interrupt
{n+23} LPDMA1_CH{n} (LPDMA1) (n=0..7) — LPDMA1 channel{n} global interrupt
31 IWDG — Independent watchdog interrupt
32 ADC1 — ADC1 global interrupt
33 ADC2 — ADC2 global interrupt
34 FDCAN1_IT0 (FDCAN1) — FDCAN1 Interrupt 0
35 FDCAN1_IT1 (FDCAN1) — FDCAN1 Interrupt 1
36 TIM1_BRK_TERR_IERR (TIM1) — TIM1 Break/TIM1 Transition error/TIM1 Index error
37 TIM1_UPD (TIM1) — TIM1 Update
38 TIM1_TRGI_COM_DIR_IDX (TIM1) — TIM1 trigger and commutation/TIM1 Direction Change interrupt/TIM1 Index
39 TIM1_CC (TIM1) — TIM1 capture compare interrupt
40 TIM2 — TIM2 global interrupt
41 TIM5 — TIM5 global interrupt
42 TIM6 — TIM6 global interrupt
43 TIM7 — TIM7 global interrupt
44 I2C1_EV (I2C1) — I2C1 event interrupt
45 I2C1_ERR (I2C1) — I2C1 error interrupt
46 I3C1_EV (I3C1) — I3C1 event interrupt
47 I3C1_ERR (I3C1) — I3C1 error interrupt
48 SPI1 — SPI1 global interrupt
49 SPI2 — SPI2 global interrupt
50 SPI3 — SPI3 global interrupt
51 USART1 — USART1 global interrupt
52 USART2 — USART2 global interrupt
53 USART3 — USART3 global interrupt
54 UART4 — UART4 global interrupt
55 UART5 — UART5 global interrupt
56 LPUART1 — LPUART1 Rx interrupt OR LPUART1 Tx interrupt
57 LPTIM1 — LPTIM1 global interrupt
58 TIM12 — TIM12 global interrupt
59 TIM15 — TIM15 global interrupt
60 TIM16 — TIM16 global interrupt
61 TIM17 — TIM17 global interrupt
62 USB_DRD_FS — USB OTG FS global interrupt
63 CRS — Clock Recovery System global interrupt
64 RNG — RNG global interrupt
66 ICACHE — Instruction cache global interrupt
67 CORDIC — CORDIC interrupt
68 AES — AES global interrupt
69 HASH — HASH interrupt
70 I2C2_EV (I2C2) — I2C2 event interrupt
71 I2C2_ERR (I2C2) — I2C2 error interrupt
72 TIM8_BRK_TERR_IERR (TIM8) — TIM8 Break interrupt/TIM8 Transition error/TIM8 Index error
73 TIM8_UPD (TIM8) — TIM8 Update interrupt
74 TIM8_TRGI_COM_DIR_IDX (TIM8)
75 TIM8_CC (TIM8) — TIM8 capture compare interrupt
76 COMP1 — COMP global interrupt
77 DAC1 — DAC1 global interrupt
{n+78} LPDMA2_CH{n} (LPDMA2) (n=0..7) — LPDMA2 channel{n} global interrupt
86 FDCAN2_IT0 (FDCAN2) — FDCAN2 Interrupt 0
87 FDCAN2_IT1 (FDCAN2) — FDCAN2 Interrupt 1
89 TIM3 — TIM3 global interrupt
90 TIM4 — TIM4 global interrupt
91 XSPI1 — OCTOSPI1 global interrupt
92 SAES — SAES global interrupt
93 PKA — PKA global interrupt
94 ETH1 — Ethernet interrupt
95 ETH1_WKUP (ETH1) — Ethernet wakeup interrupt through EXTI line
96 USART6 — USART6 global interrupt
97 UART7 — UART7 global interrupt
98 ADC3 — ADC3 global interrupt

# STM32U3C5xx register map
File version: 1.0
Registers are 32-bit, read-write, reset 0x0 unless marked. A register's access mark holds for its fields unless they carry their own. Offsets are from the block's base; lines under a group give offsets from that group; [hi:lo] are bit positions; {n}, {i} and the like mark numbered series; 'fields as' and 'values as' point back to an identical list; <NAME> marks a mode.

## Memory map
0x0BF99040 RSSLIB_PFUNC — RSSLib function pointer structure
0x40000000 TIM2 — TIM
0x40000400 TIM3 — TIM
0x40000800 TIM4 — TIM
0x40001000 TIM6 — TIM
0x40001400 TIM7 — TIM
0x40002000 SPI3 — SPI
0x40002400 SPI4 — SPI
0x40002C00 WWDG
0x40003000 IWDG
0x40003800 SPI2 — SPI
0x40004400 USART2 — Universal Synchronous Asynchronous Receiver Transmitter
0x40004800 USART3 — Universal Synchronous Asynchronous Receiver Transmitter
0x40004C00 UART4 — Universal Synchronous Asynchronous Receiver Transmitter
0x40005000 UART5 — Universal Synchronous Asynchronous Receiver Transmitter
0x40005400 I2C1 — Inter-integrated Circuit Interface
0x40005800 I2C2 — Inter-integrated Circuit Interface
0x40005C00 I3C1 — Improved Inter-integrated Circuit Interface
0x40006000 CRS — Clock Recovery System
0x40007000 OPAMP12_COMMON
0x40007000 OPAMP1 — Operational Amplifier (OPAMP)
0x40007010 OPAMP2 — Operational Amplifier (OPAMP)
0x40007400 VREFBUF
0x40007800 RTC — Real-Time Clock
0x40007C00 TAMP — Tamper and backup registers
0x40008400 I2C4 — Inter-integrated Circuit Interface
0x40009400 LPTIM2 — LPTIMER
0x4000A400 FDCAN1 — FD Controller Area Network
0x4000A500 FDCAN_CONFIG — FD Controller Area Network Configuration
0x4000A800 FDCAN2 — FD Controller Area Network
0x40012C00 TIM1 — TIM
0x40013000 SPI1 — SPI
0x40013400 TIM8 — TIM
0x40013800 USART1 — Universal Synchronous Asynchronous Receiver Transmitter
0x40013C00 TIM12 — TIM
0x40014000 TIM15 — TIM
0x40014400 TIM16 — TIM
0x40014800 TIM17 — TIM
0x40015400 SAI1 — Serial Audio Interface
0x40016000 USB_DRD_FS — Universal Serial Bus Full Speed Dual Role Device
0x40016400 USB_DRD_PMA_BUFF — Universal Serial Bus PacketMemoryArea Buffer Descriptor Table
0x40016C00 I3C2 — Improved Inter-integrated Circuit Interface
0x40020000 GPDMA1 — DMA Controller
0x40022000 FLASH — FLASH Registers
0x40023000 CRC — CRC calculation unit
0x40024000 TSC — Touch Sensing Controller (TSC)
0x40026000 RAMCFG
0x4002C000 HSP1 — HSP
0x40030400 ICACHE — Instruction Cache
0x40030800 PWR — Power Control
0x40030C00 RCC — Reset and Clock Control
0x40032000 EXTI — Asynch Interrupt/Event Controller (EXTI)
0x40032400 GTZC_TZSC1 — Global TrustZone Controller
0x40032C00 GTZC_MPCBB1
0x40033000 GTZC_MPCBB2
0x40033400 GTZC_MPCBB3
0x40033800 GTZC_MPCBB4
0x40034000 ADF1 — MDF/ADF
0x40040400 SYSCFG — System configuration controller
0x40042400 LPUART1 — Universal Synchronous Asynchronous Receiver Transmitter
0x40042800 I2C3 — Inter-integrated Circuit Interface
0x40044400 LPTIM1 — LPTIMER
0x40044800 LPTIM3 — LPTIMER
0x40044C00 LPTIM4 — LPTIMER
0x40045400 COMP12_COMMON
0x40045400 COMP1 — Comparator
0x40045404 COMP2 — Comparator
0x42020000 GPIOA — General Purpose I/O
0x42020400 GPIOB — General Purpose I/O
0x42020800 GPIOC — General Purpose I/O
0x42020C00 GPIOD — General Purpose I/O
0x42021000 GPIOE — General Purpose I/O
0x42021400 GPIOF — General Purpose I/O
0x42021800 GPIOG — General Purpose I/O
0x42021C00 GPIOH — General Purpose I/O
0x42028000 ADC1 — ADC Analog to Digital Converter
0x42028100 ADC2 — ADC Analog to Digital Converter
0x42028300 ADC12_COMMON
0x42028400 DAC1 — DAC
0x420C0000 AES — AES hardware accelerator
0x420C0400 HASH
0x420C0800 RNG
0x420C0C00 SAES — AES hardware accelerator
0x420C2000 PKA
0x420C7C00 CCB — Coupling and chaining bridge (CCB)
0x420C8000 SDMMC1 — Secure digital input/output Interface
0x420C8400 DLYB_SDMMC1
0x420CF000 DLYB_OCTOSPI1
0x420D1400 OCTOSPI1 — OCTO Serial Peripheral Interface
0xE0044000 DBGMCU — Debug MCU

## Interrupts
0 WWDG — Window WatchDog interrupt
2 RTC — RTC non-secure interrupt
3 RTC_S (RTC) — RTC secure interrupt
4 TAMP — Tamper global interrupt
5 RAMCFG — RAMCFG global interrupt
6 FLASH — FLASH non-secure global interrupt
7 FLASH_S (FLASH) — FLASH secure global interrupt
9 RCC — RCC non secure global interrupt
10 RCC_S (RCC) — RCC secure global interrupt
{n+11} EXTI{n} (EXTI) (n=0..15) — EXTI Line {n} interrupt
27 IWDG — IWDG global interrupt
28 SAES — Secure AES global interrupt
{n+29} GPDMA1_Channel{n} (GPDMA1) (n=0..7) — GPDMA1 Channel {n} global interrupt
37 ADC1 — ADC1 global interrupt
38 DAC1 — DAC1 global interrupt
39 FDCAN1_IT0 (FDCAN1) — FDCAN1 interrupt 0
40 FDCAN1_IT1 (FDCAN1) — FDCAN1 interrupt 1
41 TIM1_BRK_TERR_IERR (TIM1) — TIM1 Break, Transition error and Index error interrupt
42 TIM1_UP (TIM1) — TIM1 Update interrupt
43 TIM1_TRG_COM_DIR_IDX (TIM1) — TIM1 Trigger, Commutation, Direction change and Index interrupt
44 TIM1_CC (TIM1) — TIM1 Capture Compare interrupt
45 TIM2 — TIM2 global interrupt
46 TIM3 — TIM3 global interrupt
47 TIM4 — TIM4 global interrupt
49 TIM6 — TIM6 global interrupt
50 TIM7 — TIM7 global interrupt
51 TIM12 — TIM12 global interrupt
53 I3C1_EV (I3C1) — I3C1 event interrupt
54 I3C1_ER (I3C1) — I3C1 error interrupt
55 I2C1_EV (I2C1) — I2C1 Event interrupt
56 I2C1_ER (I2C1) — I2C1 Error interrupt
57 I2C2_EV (I2C2) — I2C2 Event interrupt
58 I2C2_ER (I2C2) — I2C2 Error interrupt
59 SPI1 — SPI1 global interrupt
60 SPI2 — SPI2 global interrupt
61 USART1 — USART1 global interrupt
62 USART2 — USART2 global interrupt
63 USART3 — USART3 global interrupt
64 UART4 — UART4 global interrupt
65 UART5 — UART5 global interrupt
66 LPUART1 — LPUART1 global interrupt
67 LPTIM1 — LPTIM1 global interrupt
68 LPTIM2 — LPTIM2 global interrupt
69 TIM15 — TIM15 global interrupt
70 TIM16 — TIM16 global interrupt
71 TIM17 — TIM17 global interrupt
72 COMP (COMP1, COMP2) — COMP1 and COMP2 through EXTI Lines interrupts
74 CRS — CRS global interrupt
76 OCTOSPI1 — OctoSPI1 global interrupt
77 HSP1 — HSP1 global interrupt
78 SDMMC1 — SDMMC1 global interrupt
80 GPDMA1_Channel8 (GPDMA1) — GPDMA1 Channel 8 global interrupt
81 GPDMA1_Channel9 (GPDMA1) — GPDMA1 Channel 9 global interrupt
82 GPDMA1_Channel10 (GPDMA1) — GPDMA1 Channel 10 global interrupt
83 GPDMA1_Channel11 (GPDMA1) — GPDMA1 Channel 11 global interrupt
88 I2C3_EV (I2C3) — I2C3 event interrupt
89 I2C3_ER (I2C3) — I2C3 error interrupt
90 SAI1 — Serial Audio Interface 1 global interrupt
92 TSC — Touch Sense Controller global interrupt
93 AES — AES global interrupt
94 RNG — RNG global interrupt
96 HASH — HASH global interrupt
97 PKA — PKA global interrupt
98 LPTIM3 — LPTIM3 global interrupt
99 SPI3 — SPI3 global interrupt
100 I3C2_EV (I3C2) — I3C2 Event interrupt
101 I3C2_ER (I3C2) — I3C2 Error interrupt
102 TIM8_BRK_TERR_IERR (TIM8) — TIM8 Break, Transition error and Index error interrupt
103 TIM8_UP (TIM8) — TIM8 Update interrupt
104 TIM8_TRG_COM_DIR_IDX (TIM8) — TIM8 Trigger, Commutation, Direction change and Index interrupt
105 TIM8_CC (TIM8) — TIM8 Capture Compare interrupt
107 ICACHE — Instruction cache global interrupt
110 LPTIM4 — LPTIM4 global interrupt
112 ADF1 — ADF1 interrupt
113 ADC2 — ADC2 (12bits) global interrupt
114 FDCAN2_IT0 (FDCAN2) — FDCAN2 interrupt 0
115 FDCAN2_IT1 (FDCAN2) — FDCAN2 interrupt 1
116 I2C4_EV (I2C4) — I2C4 Event interrupt
117 I2C4_ER (I2C4) — I2C4 Error interrupt
119 SPI4 — SPI4 global interrupt
123 PWR — PWR non-secure interrupt
124 PWR_S (PWR) — PWR secure interrupt

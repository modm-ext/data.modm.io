# STM32N655xx register map
File version: 1.0
Registers are 32-bit, read-write, reset 0x0 unless marked. A register's access mark holds for its fields unless they carry their own. Offsets are from the block's base; lines under a group give offsets from that group; [hi:lo] are bit positions; {n}, {i} and the like mark numbered series; 'fields as' and 'values as' point back to an identical list; <NAME> marks a mode.

## Memory map
0x40000000 TIM2 — TIM
0x40000400 TIM3 — TIM
0x40000800 TIM4 — TIM
0x40000C00 TIM5 — TIM
0x40001000 TIM6 — TIM
0x40001400 TIM7 — TIM
0x40001800 TIM12 — TIM
0x40001C00 TIM13 — TIM
0x40002000 TIM14 — TIM
0x40002400 LPTIM1 — LPTIMER
0x40002C00 WWDG — Window Watchdog
0x40003000 TIM10 — TIM
0x40003400 TIM11 — TIM
0x40003800 SPI2 — SPI
0x40003C00 SPI3 — SPI
0x40004000 SPDIFRX — SPDIF-RX Interface
0x40004400 USART2 — Universal Synchronous Asynchronous Receiver Transmitter
0x40004800 USART3 — Universal Synchronous Asynchronous Receiver Transmitter
0x40004C00 UART4 — Universal Synchronous Asynchronous Receiver Transmitter
0x40005000 UART5 — Universal Synchronous Asynchronous Receiver Transmitter
0x40005400 I2C1 — Inter-integrated Circuit Interface
0x40005800 I2C2 — Inter-integrated Circuit Interface
0x40005C00 I2C3 — Inter-integrated Circuit Interface
0x40006000 I3C1 — Improved Inter-integrated Circuit Interface
0x40006400 I3C2 — Improved Inter-integrated Circuit Interface
0x40007800 UART7 — Universal Synchronous Asynchronous Receiver Transmitter
0x40007C00 UART8 — Universal Synchronous Asynchronous Receiver Transmitter
0x40009400 MDIOS
0x4000A000 FDCAN1 — FD Controller Area Network
0x4000A400 FDCAN2 — FD Controller Area Network
0x4000A800 FDCAN_CCU — FD Controller Area Network
0x4000E800 FDCAN3 — FD Controller Area Network
0x4000FC00 UCPD1 — UCPD
0x40021000 GPDMA1 — DMA Controller
0x40022000 ADC1 — Analog to Digital Converter (ADC)
0x40022100 ADC2 — Analog to Digital Converter (ADC)
0x40022300 ADC12_COMMON
0x42000000 TIM1 — TIM
0x42000400 TIM8 — TIM
0x42001000 USART1 — Universal Synchronous Asynchronous Receiver Transmitter
0x42001400 USART6 — Universal Synchronous Asynchronous Receiver Transmitter
0x42001800 UART9 — Universal Synchronous Asynchronous Receiver Transmitter
0x42001C00 USART10 — Universal Synchronous Asynchronous Receiver Transmitter
0x42003000 SPI1 — SPI
0x42003400 SPI4 — SPI
0x42003C00 TIM18 — TIM
0x42004000 TIM15 — TIM
0x42004400 TIM16 — TIM
0x42004800 TIM17 — TIM
0x42004C00 TIM9 — TIM
0x42005000 SPI5 — SPI
0x42005800 SAI1 — Serial Audio Interface
0x42005C00 SAI2 — Serial Audio Interface
0x42023000 RAMCFG — RAMs configuration controller
0x42025000 MDF1 — ADF
0x42026000 ADF1 — ADF
0x44001000 DBGMCU — Debug MCU
0x44020000 RNG
0x44020400 HASH
0x44020800 CRYP — Cryp Processor
0x44021000 SAES — SAES Processor
0x44022000 PKA
0x44024000 RIFSC
0x44026000 RISAF1 — RISAF Resource Isolation Slave Unit for Address Space Protection (full version) (RIF User Spec Rev 1.0.14)
0x44027000 RISAF2 — RISAF Resource Isolation Slave Unit for Address Space Protection (full version) (RIF User Spec Rev 1.0.14)
0x44028000 RISAF3 — RISAF Resource Isolation Slave Unit for Address Space Protection (full version) (RIF User Spec Rev 1.0.14)
0x4402B000 RISAF6 — RISAF Resource Isolation Slave Unit for Address Space Protection (full version) (RIF User Spec Rev 1.0.14)
0x4402C000 RISAF7 — RISAF Resource Isolation Slave Unit for Address Space Protection (full version) (RIF User Spec Rev 1.0.14)
0x4402D000 RISAF8 — RISAF Resource Isolation Slave Unit for Address Space Protection (full version) (RIF User Spec Rev 1.0.14)
0x4402E000 RISAF9 — RISAF Resource Isolation Slave Unit for Address Space Protection (full version) (RIF User Spec Rev 1.0.14)
0x44030000 RISAF11 — RISAF Resource Isolation Slave Unit for Address Space Protection (full version) (RIF User Spec Rev 1.0.14)
0x44031000 RISAF12 — RISAF Resource Isolation Slave Unit for Address Space Protection (full version) (RIF User Spec Rev 1.0.14)
0x44032000 RISAF13 — RISAF Resource Isolation Slave Unit for Address Space Protection (full version) (RIF User Spec Rev 1.0.14)
0x44033000 RISAF14 — RISAF Resource Isolation Slave Unit for Address Space Protection (full version) (RIF User Spec Rev 1.0.14)
0x44035000 RISAF21 — RISAF Resource Isolation Slave Unit for Address Space Protection (full version) (RIF User Spec Rev 1.0.14)
0x44036000 RISAF22 — RISAF Resource Isolation Slave Unit for Address Space Protection (full version) (RIF User Spec Rev 1.0.14)
0x44037000 RISAF23 — RISAF Resource Isolation Slave Unit for Address Space Protection (full version) (RIF User Spec Rev 1.0.14)
0x46000C00 LPUART1 — Universal Synchronous Asynchronous Receiver Transmitter
0x46001400 SPI6 — SPI
0x46001C00 I2C4 — Inter-integrated Circuit Interface
0x46002400 LPTIM2 — LPTIMER
0x46002800 LPTIM3 — LPTIMER
0x46002C00 LPTIM4 — LPTIMER
0x46003000 LPTIM5 — LPTIMER
0x46003C00 VREFBUF
0x46004000 RTC — Real-Time Clock
0x46004400 TAMP — Tamper and backup registers
0x46004800 IWDG
0x46008000 SYSCFG — System configuration controller
0x46009000 BSEC — Boot and Security
0x4600A000 DTS — DTS Controller
0x46020000 GPIOA — General Purpose I/O
0x46020400 GPIOB — General Purpose I/O
0x46020800 GPIOC — General Purpose I/O
0x46020C00 GPIOD — General Purpose I/O
0x46021000 GPIOE — General Purpose I/O
0x46021400 GPIOF — General Purpose I/O
0x46021800 GPIOG — General Purpose I/O
0x46021C00 GPIOH — General Purpose I/O
0x46023400 GPION — General Purpose I/O
0x46023800 GPIOO — General Purpose I/O
0x46023C00 GPIOP — General Purpose I/O
0x46024000 GPIOQ — General Purpose I/O
0x46024800 PWR — Power Control
0x46024C00 CRC — CRC calculation unit
0x46025000 EXTI — External Interrupt/Event Controller
0x46028000 RCC — Reset and Clock Control
0x48001000 LTDC — LCD-TFT Display Controller (LTDC)
0x48002000 DCMIPP
0x48004000 GFXTIM
0x48006000 CSI
0x48020000 HPDMA1 — DMA Controller
0x48021000 DMA2D — DMA2D Controller
0x48023000 JPEG — JPEG Codec
0x48024000 FMC_Bank1_R — Flexible Memory Controller Bank1
0x48024020 FMC_Common_R — Flexible Memory Controller Common
0x48024080 FMC_Bank3_R — Flexible Memory Controller Bank3
0x48024104 FMC_Bank1E_R — Flexible Memory Controller Bank1E
0x48024140 FMC_Bank5_6_R — Flexible Memory Controller Bank2
0x48025000 XSPI1 — Extended-SPI Interface
0x48026400 PSSI
0x48026800 SDMMC2 — Secure digital input/output Interface
0x48026C00 DLYB_SDMMC2
0x48027000 SDMMC1 — Secure digital input/output Interface
0x48028000 DLYB_SDMMC1
0x48028400 DCMI
0x4802A000 XSPI2 — Extended-SPI Interface
0x4802B400 XSPIM — XSPI IO Manager
0x4802B800 MCE1
0x4802BC00 MCE2
0x4802C000 MCE3
0x4802D000 XSPI3 — Extended-SPI Interface
0x4802E000 MCE4
0x48030000 GFXMMU
0x48035000 ICACHE — Instruction Cache
0x48036000 ETH1 — Ethernet MAC
0x4803FC00 USB1_HS_PHYC
0x48040000 USB1_OTG_HS — USB_OTG_Core_register
0x48080000 USB2_OTG_HS — USB_OTG_Core_register
0x480C0000 USB2_HS_PHYC

## Interrupts
2 DTS — Thermal Sensor interruption
3 RCC — RCC non-secure global interrupts through EXTI Line detection
10 RTC_S (RTC) — RTC secure interrupts through EXTI Line detection
11 TAMP — Tamper secure and non-secure interrupts through EXTI Line detection
12 RIFSC_TAMPER (RIFSC) — RIF Tamper interrupts
14 RCC_S (RCC) — RCC secure global interrupts through EXTI Line detection
16 RTC — RTC non-secure interrupts through EXTI Line detection
18 IWDG — Internal Watchdog interrupt
19 WWDG — Window Watchdog interrupt
{n+20} EXTI{n} (EXTI) (n=0..15) — EXTI Line{n} interrupt
36 SAES — SAES interrupt
37 CRYP — CRYP interrupt
38 PKA — PKA interrupt
39 HASH — HASH interrupt
40 RNG — RNG global interrupt
42 MCE1 — MCE1 global interrupt
43 MCE2 — MCE2 global interrupt
44 MCE3 — MCE3 global interrupt
45 MCE4 — MCE4 global interrupt
46 ADC1_2 (ADC1) — ADC1 & ADC2 interrupt
47 CSI — CSI global interrupt
48 DCMIPP — DCMIPP global interrupt
58 LTDC_LO (LTDC) — LTDC low-layer global interrupt
59 LTDC_LO_ERR (LTDC) — LTDC low-layer error interrupt
60 DMA2D — DMA2D global interrupt
61 JPEG — JPEG global interrupt
63 GFXMMU — GFXMMU global interrupt
64 GFXTIM — GFXTIM global interrupt
67 ICACHE — GPU2D cache interrupt
{n+68} HPDMA1_Channel{n} (HPDMA1) (n=0..15) — HPDMA1 Channel {n} global interrupt
{n+84} GPDMA1_Channel{n} (GPDMA1) (n=0..15) — GPDMA1 Channel {n} interrupt
100 I2C1_EV (I2C1) — I2C1 event interrupt
101 I2C1_ER (I2C1) — I2C1 error interrupt
102 I2C2_EV (I2C2) — I2C2 event interrupt
103 I2C2_ER (I2C2) — I2C2 error interrupt
104 I2C3_EV (I2C3) — I2C3 event interrupt
105 I2C3_ER (I2C3) — I2C3 error interrupt
106 I2C4_EV (I2C4) — I2C4 event interrupt
107 I2C4_ER (I2C4) — I2C4 error interrupt
108 I3C1_EV (I3C1) — I3C1 event interrupt
109 I3C1_ER (I3C1) — I3C1 error interrupt
110 I3C2_EV (I3C2) — I3C2 event interrupt
111 I3C2_ER (I3C2) — I3C2 error interrupt
112 TIM1_BRK (TIM1) — TIM1 Break interrupt
113 TIM1_UP (TIM1) — TIM1 Update interrupt
114 TIM1_TRG_COM (TIM1) — TIM1 Trigger and Commutation interrupt
115 TIM1_CC (TIM1) — TIM1 Capture Compare interrupt
116 TIM2 — TIM2 global interrupt
117 TIM3 — TIM3 global interrupt
118 TIM4 — TIM4 global interrupt
119 TIM5 — TIM5 global interrupt
120 TIM6 — TIM6 global interrupt
121 TIM7 — TIM7 global interrupt
122 TIM8_BRK (TIM8) — TIM8 Break interrupt
123 TIM8_UP (TIM8) — TIM8 Update interrupt
124 TIM8_TRG_COM (TIM8) — TIM8 Trigger and Commutation interrupt
125 TIM8_CC (TIM8) — TIM8 Capture Compare interrupt
{n+117} TIM{n} (n=9..18) — TIM{n} global interrupt
136 LPTIM1 — LPTIM1 global interrupt
137 LPTIM2 — LPTIM2 global interrupt
138 LPTIM3 — LPTIM3 global interrupt
139 LPTIM4 — LPTIM4 global interrupt
140 LPTIM5 — LPTIM5 global interrupt
141 ADF1_FLT0 (ADF1) — ADF1 Filter 0 global interrupt
142 MDF1_FLT0 (MDF1) — MDF1 Filter 0 global interrupt
143 MDF1_FLT1 (MDF1) — MDF1 Filter 1 global interrupt
144 MDF1_FLT2 (MDF1) — MDF1 Filter 2 global interrupt
145 MDF1_FLT3 (MDF1) — MDF1 Filter 3 global interrupt
146 MDF1_FLT4 (MDF1) — MDF1 Filter 4 global interrupt
147 MDF1_FLT5 (MDF1) — MDF1 Filter 5 global interrupt
148 SAI1_A (SAI1) — Serial Audio Interface 1 block A interrupt
149 SAI1_B (SAI1) — Serial Audio Interface 1 block B interrupt
150 SAI2_A (SAI2) — Serial Audio Interface 2 block A interrupt
151 SAI2_B (SAI2) — Serial Audio Interface 2 block B interrupt
152 SPDIFRX1 (SPDIFRX) — SPDIFRX1 interrupt
153 SPI1 — SPI1 global interrupt
154 SPI2 — SPI2 global interrupt
155 SPI3 — SPI3 global interrupt
156 SPI4 — SPI4 global interrupt
157 SPI5 — SPI5 global interrupt
158 SPI6 — SPI6 global interrupt
159 USART1 — USART1 global interrupt
160 USART2 — USART2 global interrupt
161 USART3 — USART3 global interrupt
162 UART4 — UART4 global interrupt
163 UART5 — UART5 global interrupt
164 USART6 — USART3 global interrupt
165 UART7 — UART7 global interrupt
166 UART8 — UART8 global interrupt
167 UART9 — UART9 global interrupt
168 USART10 — USART10 global interrupt
169 LPUART1 — LPUART1 global interrupt
170 XSPI1 — XSPI1 global interrupt
171 XSPI2 — XSPI2 global interrupt
172 XSPI3 — XSPI3 global interrupt
174 SDMMC1 — SDMMC1 global interrupt
175 SDMMC2 — SDMMC2 global interrupt
176 UCPD1 — UCPD1 global interrupt
177 USB1_OTG_HS (USB1_OTG_HS, USB2_OTG_HS) — USB1 OTG HS interrupt
178 USB2_OTG_HS (USB1_OTG_HS, USB2_OTG_HS) — USB2 OTG HS interrupt
179 ETH1 — ETH1 global interrupt
180 FDCAN1_IT0 (FDCAN1) — FDCAN1 interrupt 0
181 FDCAN1_IT1 (FDCAN1) — FDCAN1 interrupt 1
182 FDCAN2_IT0 (FDCAN2) — FDCAN2 interrupt 0
183 FDCAN2_IT1 (FDCAN2) — FDCAN2 interrupt 1
184 FDCAN3_IT0 (FDCAN3) — FDCAN3 interrupt 0
185 FDCAN3_IT1 (FDCAN3) — FDCAN3 interrupt 1
186 FDCAN_CU (FDCAN{n} (n=1..3)) — FDCAN Clock Unit interrupt
187 MDIOS — MDIOS global interrupt
188 DCMI_PSSI (PSSI, DCMI) — DCMI/PSSI global interrupt
193 LTDC_UP (LTDC) — LTDC up-layer global interrupt
194 LTDC_UP_ERR (LTDC) — LTDC up-layer error interrupt

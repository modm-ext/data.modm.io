# STM32F303xE register map
File version: 1.0
Registers are 32-bit, read-write, reset 0x0 unless marked. A register's access mark holds for its fields unless they carry their own. Offsets are from the block's base; lines under a group give offsets from that group; [hi:lo] are bit positions; {n}, {i} and the like mark numbered series; 'fields as' and 'values as' point back to an identical list; <NAME> marks a mode.

## Memory map
0x1FFFF800 OB — Option Bytes Registers
0x40000000 TIM2 — TIM
0x40000400 TIM3 — TIM
0x40000800 TIM4 — TIM
0x40001000 TIM6 — TIM
0x40001400 TIM7 — TIM
0x40002800 RTC — Real-Time Clock
0x40002C00 WWDG — Window WATCHDOG
0x40003000 IWDG — Independent WATCHDOG
0x40003400 I2S2ext — Serial Peripheral Interface
0x40003800 SPI2 — Serial Peripheral Interface
0x40003C00 SPI3 — Serial Peripheral Interface
0x40004000 I2S3ext — Serial Peripheral Interface
0x40004400 USART2 — Universal Synchronous Asynchronous Receiver Transmitter
0x40004800 USART3 — Universal Synchronous Asynchronous Receiver Transmitter
0x40004C00 UART4 — Universal Synchronous Asynchronous Receiver Transmitter
0x40005000 UART5 — Universal Synchronous Asynchronous Receiver Transmitter
0x40005400 I2C1 — Inter-integrated Circuit Interface
0x40005800 I2C2 — Inter-integrated Circuit Interface
0x40005C00 USB — Universal Serial Bus Full Speed Device
0x40006400 CAN — Controller Area Network
0x40007000 PWR — Power Control
0x40007400 DAC — Digital to Analog Converter
0x40007400 DAC1 — Digital to Analog Converter
0x40007800 I2C3 — Inter-integrated Circuit Interface
0x40010000 SYSCFG — System configuration controller
0x4001001C COMP — Analog Comparators
0x4001001C COMP1 — Analog Comparators
0x40010020 COMP12_COMMON
0x40010020 COMP2 — Analog Comparators
0x40010024 COMP3 — Analog Comparators
0x40010028 COMP34_COMMON
0x40010028 COMP4 — Analog Comparators
0x4001002C COMP5 — Analog Comparators
0x40010030 COMP56_COMMON
0x40010030 COMP6 — Analog Comparators
0x40010034 COMP7 — Analog Comparators
0x40010038 OPAMP — Operational Amplifier (OPAMP)
0x40010038 OPAMP1 — Operational Amplifier (OPAMP)
0x4001003C OPAMP2 — Operational Amplifier (OPAMP)
0x40010040 OPAMP3 — Operational Amplifier (OPAMP)
0x40010044 OPAMP4 — Operational Amplifier (OPAMP)
0x40010400 EXTI — External Interrupt/Event Controller
0x40012C00 TIM1 — TIM
0x40013000 SPI1 — Serial Peripheral Interface
0x40013400 TIM8 — TIM
0x40013800 USART1 — Universal Synchronous Asynchronous Receiver Transmitter
0x40013C00 SPI4 — Serial Peripheral Interface
0x40014000 TIM15 — TIM
0x40014400 TIM16 — TIM
0x40014800 TIM17 — TIM
0x40015000 TIM20 — TIM
0x40020000 DMA1
0x40020400 DMA2
0x40021000 RCC — Reset and Clock Control
0x40022000 FLASH — FLASH Registers
0x40023000 CRC — CRC calculation unit
0x40024000 TSC — Touch Sensing Controller (TSC)
0x48000000 GPIOA — General Purpose I/O
0x48000400 GPIOB — General Purpose I/O
0x48000800 GPIOC — General Purpose I/O
0x48000C00 GPIOD — General Purpose I/O
0x48001000 GPIOE — General Purpose I/O
0x48001400 GPIOF — General Purpose I/O
0x48001800 GPIOG — General Purpose I/O
0x48001C00 GPIOH — General Purpose I/O
0x50000000 ADC1 — Analog to Digital Converter
0x50000100 ADC2 — Analog to Digital Converter
0x50000300 ADC12_COMMON
0x50000400 ADC3 — Analog to Digital Converter
0x50000500 ADC4 — Analog to Digital Converter
0x50000700 ADC34_COMMON
0xA0000000 FMC
0xA0000060 FMC_Bank2_3 — Flexible Memory Controller Bank2
0xA0000104 FMC_Bank1E — Flexible Memory Controller Bank1E
0xE0042000 DBGMCU — Debug MCU

## Interrupts
0 WWDG — Window WatchDog Interrupt
3 RTC_WKUP (RTC) — RTC Wakeup interrupt through the EXTI line 20
4 FLASH — FLASH global Interrupt
5 RCC — RCC global Interrupt
6 EXTI0 (EXTI) — EXTI Line0 Interrupt
7 EXTI1 (EXTI) — EXTI Line1 Interrupt
8 EXTI2_TSC (TSC) — EXTI Line2 Interrupt and Touch Sense Controller Interrupt
9 EXTI3 (EXTI) — EXTI Line3 Interrupt
10 EXTI4 (EXTI) — EXTI Line4 Interrupt
11 DMA1_Channel1 (DMA1) — DMA1 Channel 1 Interrupt
12 DMA1_Channel2 (DMA1) — DMA1 Channel 2 Interrupt
13 DMA1_Channel3 (DMA1) — DMA1 Channel 3 Interrupt
14 DMA1_Channel4 (DMA1) — DMA1 Channel 4 Interrupt
15 DMA1_Channel5 (DMA1) — DMA1 Channel 5 Interrupt
16 DMA1_Channel6 (DMA1) — DMA1 Channel 6 Interrupt
17 DMA1_Channel7 (DMA1) — DMA1 Channel 7 Interrupt
18 ADC1_2 (ADC1) — ADC1 & ADC2 Interrupts
19 USB_HP_CAN_TX (USB, CAN) — USB Device High Priority or CAN TX Interrupts
20 USB_LP_CAN_RX0 (USB, CAN) — USB Device Low Priority or CAN RX0 Interrupts
21 CAN_RX1 (CAN) — CAN RX1 Interrupt
22 CAN_SCE (CAN) — CAN SCE Interrupt
23 EXTI9_5 (EXTI) — External Line[9:5] Interrupts
24 TIM1_BRK_TIM15 (TIM15) — TIM1 Break and TIM15 Interrupts
25 TIM1_UP_TIM16 (TIM16) — TIM1 Update and TIM16 Interrupts
26 TIM1_TRG_COM_TIM17 (TIM17) — TIM1 Trigger and Commutation and TIM17 Interrupt
27 TIM1_CC (TIM1) — TIM1 Capture Compare Interrupt
28 TIM2 — TIM2 global Interrupt
29 TIM3 — TIM3 global Interrupt
30 TIM4 — TIM4 global Interrupt
31 I2C1_EV (I2C1) — I2C1 Event Interrupt & EXTI Line23 Interrupt (I2C1 wakeup)
32 I2C1_ER (I2C1) — I2C1 Error Interrupt
33 I2C2_EV (I2C2) — I2C2 Event Interrupt & EXTI Line24 Interrupt (I2C2 wakeup)
34 I2C2_ER (I2C2) — I2C2 Error Interrupt
35 SPI1 — SPI1 global Interrupt
36 SPI2 — SPI2 global Interrupt
37 USART1 — USART1 global Interrupt & EXTI Line25 Interrupt (USART1 wakeup)
38 USART2 — USART2 global Interrupt & EXTI Line26 Interrupt (USART2 wakeup)
39 USART3 — USART3 global Interrupt & EXTI Line28 Interrupt (USART3 wakeup)
40 EXTI15_10 (EXTI) — External Line[15:10] Interrupts
41 RTC_Alarm (RTC) — RTC Alarm (A and B) through EXTI Line 17 Interrupt
43 TIM8_BRK (TIM8) — TIM8 Break Interrupt
44 TIM8_UP (TIM8) — TIM8 Update Interrupt
45 TIM8_TRG_COM (TIM8) — TIM8 Trigger and Commutation Interrupt
46 TIM8_CC (TIM8) — TIM8 Capture Compare Interrupt
47 ADC3 — ADC3 global Interrupt
48 FMC — FMC global Interrupt
51 SPI3 — SPI3 global Interrupt
52 UART4 — UART4 global Interrupt & EXTI Line34 Interrupt (UART4 wakeup)
53 UART5 — UART5 global Interrupt & EXTI Line35 Interrupt (UART5 wakeup)
54 TIM6_DAC (TIM6, DAC) — TIM6 global and DAC underrun error Interrupt
55 TIM7 — TIM7 global Interrupt
56 DMA2_Channel1 (DMA2) — DMA2 Channel 1 global Interrupt
57 DMA2_Channel2 (DMA2) — DMA2 Channel 2 global Interrupt
58 DMA2_Channel3 (DMA2) — DMA2 Channel 3 global Interrupt
59 DMA2_Channel4 (DMA2) — DMA2 Channel 4 global Interrupt
60 DMA2_Channel5 (DMA2) — DMA2 Channel 5 global Interrupt
61 ADC4 — ADC4 global Interrupt
64 COMP1_2_3 (COMP1) — COMP1, COMP2 and COMP3 global Interrupt via EXTI Line21, 22 and 29
65 COMP4_5_6 (COMP4) — COMP4, COMP5 and COMP6 global Interrupt via EXTI Line30, 31 and 32
66 COMP7 — COMP7 global Interrupt via EXTI Line33
72 I2C3_EV (I2C3) — I2C3 event interrupt
73 I2C3_ER (I2C3) — I2C3 Error Interrupt
74 USB_HP (USB) — USB High Priority global Interrupt
75 USB_LP (USB) — USB Low Priority global Interrupt
77 TIM20_BRK (TIM20) — TIM20 Break Interrupt
78 TIM20_UP (TIM20) — TIM20 Update Interrupt
79 TIM20_TRG_COM (TIM20) — TIM20 Trigger and Commutation Interrupt
80 TIM20_CC (TIM20) — TIM20 Capture Compare Interrupt
84 SPI4 — SPI4 global Interrupt

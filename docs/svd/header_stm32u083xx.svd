# STM32U083xx register map
File version: 1.0
Registers are 32-bit, read-write, reset 0x0 unless marked. A register's access mark holds for its fields unless they carry their own. Offsets are from the block's base; lines under a group give offsets from that group; [hi:lo] are bit positions; {n}, {i} and the like mark numbered series; 'fields as' and 'values as' point back to an identical list; <NAME> marks a mode.

## Memory map
0x40000000 TIM2 — TIM
0x40000400 TIM3 — TIM
0x40001000 TIM6 — TIM
0x40001400 TIM7 — TIM
0x40002400 LCD
0x40002800 RTC — Real-Time Clock
0x40002C00 WWDG — Window WATCHDOG
0x40003000 IWDG — Independent WATCHDOG
0x40003800 SPI2 — Serial Peripheral Interface
0x40003C00 SPI3 — Serial Peripheral Interface
0x40004400 USART2 — Universal Synchronous Asynchronous Receiver Transmitter
0x40004800 USART3 — Universal Synchronous Asynchronous Receiver Transmitter
0x40004C00 USART4 — Universal Synchronous Asynchronous Receiver Transmitter
0x40005400 I2C1 — Inter-integrated Circuit Interface
0x40005800 I2C2 — Inter-integrated Circuit Interface
0x40005C00 USB_DRD_FS — Universal Serial Bus Full Speed Dual Role Device
0x40006C00 CRS — Clock Recovery System
0x40007000 PWR — Power Control
0x40007400 DAC1 — Digital to Analog Converter
0x40007800 OPAMP1 — Operational Amplifier (OPAMP)
0x40007C00 LPTIM1 — LPTIMER
0x40008000 LPUART1 — Universal Synchronous Asynchronous Receiver Transmitter
0x40008400 LPUART2 — Universal Synchronous Asynchronous Receiver Transmitter
0x40008800 I2C3 — Inter-integrated Circuit Interface
0x40008C00 LPUART3 — Universal Synchronous Asynchronous Receiver Transmitter
0x40009000 LPTIM3 — LPTIMER
0x40009400 LPTIM2 — LPTIMER
0x40009800 USB_DRD_PMA_BUFF — Universal Serial Bus PacketMemoryArea Buffer Descriptor Table
0x4000A000 I2C4 — Inter-integrated Circuit Interface
0x4000B000 TAMP — Tamper and backup registers
0x40010000 SYSCFG — System configuration controller
0x40010030 VREFBUF
0x40010200 COMP1 — Comparator
0x40010200 COMP12_COMMON
0x40010204 COMP2 — Comparator
0x40012400 ADC1 — Analog to Digital Converter
0x40012C00 TIM1 — TIM
0x40013000 SPI1 — Serial Peripheral Interface
0x40013800 USART1 — Universal Synchronous Asynchronous Receiver Transmitter
0x40014000 TIM15 — TIM
0x40014400 TIM16 — TIM
0x40015800 DBGMCU — Debug MCU
0x40020000 DMA1
0x40020400 DMA2
0x40020800 DMAMUX1 — DMA Multiplexer
0x40021000 RCC — Reset and Clock Control
0x40021800 EXTI — Asynch Interrupt/Event Controller (EXTI)
0x40022000 FLASH — FLASH Registers
0x40023000 CRC — CRC calculation unit
0x40024000 TSC — Touch Sensing Controller (TSC)
0x40025000 RNG
0x40026000 AES — AES hardware accelerator
0x50000000 GPIOA — General Purpose I/O
0x50000400 GPIOB — General Purpose I/O
0x50000800 GPIOC — General Purpose I/O
0x50000C00 GPIOD — General Purpose I/O
0x50001000 GPIOE — General Purpose I/O
0x50001400 GPIOF — General Purpose I/O

## Interrupts
0 WWDG_IWDG (WWDG, IWDG) — Window watchdog interrupt + Independent watchdog interrupt
2 RTC_TAMP (RTC, TAMP) — RTC and TAMP interrupts (combined EXTI lines 20 & 21)
3 FLASH_ECC (FLASH) — FLASH global Interrupt + FLASH ECC interrupt
4 RCC_CRS (CRS, RCC) — RCC global Interrupt + CRS global interrupt
5 EXTI0_1 (EXTI) — EXTI Line0 & Line1 Interrupt
6 EXTI2_3 (EXTI) — EXTI Line2 & Line3 Interrupt
7 EXTI4_15 (EXTI) — EXTI Line4 to Line15 Interrupt
8 USB_DRD_FS — USB global interrupt (combined with EXTI 36)
9 DMA1_Channel1 (DMA1) — DMA1 Channel 1 Interrupt
10 DMA1_Channel2_3 (DMA1) — DMA1 Channel 2 and Channel 3 Interrupts
11 DMA1_Ch4_7_DMA2_Ch1_5_DMAMUX_OVR (DMA1, DMA2) — DMAMUX_OVR_IT + DMA1 channel 4 to 7 + DMA2 channel 1 to 5
12 ADC_COMP1_2 (COMP1) — ADC and COMP1/COMP2 interrupts (ADC combined with EXTI 17 & 18)
13 TIM1_BRK_UP_TRG_COM (TIM1) — TIM1 break, update, trigger, commutation, error, direction change and index interrupts
14 TIM1_CC (TIM1) — TIM1 Capture Compare interrupt
15 TIM2 — TIM2 global Interrupt
16 TIM3 — TIM3 global Interrupt
17 TIM6_DAC_LPTIM1 (TIM6, LPTIM1) — TIM6 + LPTIM1 + DAC global interrupt (combined with EXTI 31)
18 TIM7_LPTIM2 (TIM7, LPTIM2) — TIM7 + LPTIM2 global interrupt (combined with EXTI 32)
19 TIM15_LPTIM3 (LPTIM3, TIM15) — TIM15 + LPTIM3 global interrupt (combined with EXTI 33)
20 TIM16 — TIM16 global interrupt
21 TSC — TSC global interrupt
22 LCD — LCD global interrupt
23 I2C1 — I2C1 global interrupt (combined with EXTI 23)
24 I2C2_3_4 (I2C2) — I2C2 + I2C3 global interrupt (combined with EXTI 22) + I2C4 global interrupt
25 SPI1 — SPI1/I2S1 global interrupt
26 SPI2_3 (SPI2) — SPI2 and SPI3 global interrupt
27 USART1 — USART1 global interrupt (combined with EXTI 25)
28 USART2_LPUART2 (USART2, LPUART2) — USART2 global interrupt (combined with EXTI 26) + LPUART2 global interrupt (combined with EXTI lines 35)
29 USART3_LPUART1 (USART3, LPUART1) — USART3 (combined with EXTI 24) + LPUART1 global interrupt (combined with EXTI lines 28)
30 USART4_LPUART3 (USART4, LPUART3) — USART4 global interrupt (combined with EXTI 20) + LPUART3 (combined with EXTI lines 34)
31 RNG_CRYP (RNG) — RNG + CRYPTO global interrupt

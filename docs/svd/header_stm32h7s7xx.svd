# STM32H7S7xx register map
File version: 1.0
Registers are 32-bit, read-write, reset 0x0 unless marked. A register's access mark holds for its fields unless they carry their own. Offsets are from the block's base; lines under a group give offsets from that group; [hi:lo] are bit positions; {n}, {i} and the like mark numbered series; 'fields as' and 'values as' point back to an identical list; <NAME> marks a mode.

## Memory map
0x1FF1FD4C RSSLIB_PFUNC — RSSLib callable function pointer structure
0x40000000 TIM2 — TIM
0x40000400 TIM3 — TIM
0x40000800 TIM4 — TIM
0x40000C00 TIM5 — TIM
0x40001000 TIM6 — TIM
0x40001400 TIM7 — TIM
0x40001800 TIM12 — TIM
0x40001C00 TIM13 — TIM
0x40002000 TIM14 — TIM
0x40002400 LPTIM1 — LPTIMER
0x40002C00 WWDG — Window Watchdog
0x40003800 SPI2 — SPI
0x40003C00 SPI3 — SPI
0x40004000 SPDIFRX — SPDIF-RX Interface
0x40004400 USART2 — Universal Synchronous Asynchronous Receiver Transmitter
0x40004800 USART3 — Universal Synchronous Asynchronous Receiver Transmitter
0x40004C00 UART4 — Universal Synchronous Asynchronous Receiver Transmitter
0x40005000 UART5 — Universal Synchronous Asynchronous Receiver Transmitter
0x40005400 I2C1 — Inter-integrated Circuit Interface
0x40005400 I3C1 — Improved Inter-integrated Circuit Interface
0x40005800 I2C2 — Inter-integrated Circuit Interface
0x40005C00 I2C3 — Inter-integrated Circuit Interface
0x40006C00 CEC — Consumer Electronics Control
0x40007800 UART7 — Universal Synchronous Asynchronous Receiver Transmitter
0x40007C00 UART8 — Universal Synchronous Asynchronous Receiver Transmitter
0x40008400 CRS — Clock Recovery System
0x40009400 MDIOS
0x4000A000 FDCAN1 — FD Controller Area Network
0x4000A100 FDCAN_CONFIG — FD Controller Area Network Configuration
0x4000A400 FDCAN2 — FD Controller Area Network
0x4000EC00 UCPD1 — UCPD
0x40021000 GPDMA1 — DMA Controller
0x40022000 ADC1 — Analog to Digital Converter
0x40022100 ADC2 — Analog to Digital Converter
0x40022300 ADC12_COMMON
0x40028000 ETH — Ethernet MAC
0x4002F000 ADF1 — ADF
0x40040000 USB_OTG_HS — USB_OTG_Core_register
0x40080000 USB_OTG_FS — USB_OTG_Core_register
0x42000000 TIM1 — TIM
0x42001000 USART1 — Universal Synchronous Asynchronous Receiver Transmitter
0x42003000 SPI1 — SPI
0x42003400 SPI4 — SPI
0x42004000 TIM15 — TIM
0x42004400 TIM16 — TIM
0x42004800 TIM17 — TIM
0x42004C00 TIM9 — TIM
0x42005000 SPI5 — SPI
0x42005800 SAI1 — Serial Audio Interface
0x42005C00 SAI2 — Serial Audio Interface
0x48000400 PSSI
0x48002400 SDMMC2 — Secure Digital Card/IO Embedded MultiMediaCard Interface
0x48002800 DLYB_SDMMC2
0x48004400 CORDIC
0x48020000 RNG — Random Number Generator
0x48020400 HASH
0x48020800 CRYP — Cryp Processor
0x48021000 SAES — SAES Processor
0x48022000 PKA — Public Key Accelerator (PKA)
0x50001000 LTDC — LCD-TFT Display Controller
0x50002000 DCMIPP
0x50004000 GFXTIM
0x52000000 HPDMA1 — DMA Controller
0x52001000 DMA2D — DMA2D Controller
0x52002000 FLASH — FLASH Registers
0x52003000 JPEG — JPEG Codec
0x52004000 FMC_Bank1_R — Flexible Memory Controller Bank1
0x52004080 FMC_Bank3_R — Flexible Memory Controller Bank3
0x52004104 FMC_Bank1E_R — Flexible Memory Controller Bank1 Extended
0x52004140 FMC_Bank5_6_R — Flexible Memory Controller Bank5 & 6
0x52005000 XSPI1 — XSPI
0x52007000 SDMMC1 — Secure Digital Card/IO Embedded MultiMediaCard Interface
0x52008000 DLYB_SDMMC1
0x52009000 RAMECC1
0x5200A000 XSPI2 — XSPI
0x5200B400 XSPIM — XSPI IO Manager
0x5200B800 MCE1
0x5200BC00 MCE2
0x5200C000 MCE3
0x52010000 GFXMMU
0x52015000 ICACHE — Instruction Cache
0x58000000 EXTI — External Interrupt/Event Controller
0x58000400 SBS — System configuration, boot and security controller
0x58000C00 LPUART1 — Universal Synchronous Asynchronous Receiver Transmitter
0x58001400 SPI6 — SPI
0x58002400 LPTIM2 — LPTIMER
0x58002800 LPTIM3 — LPTIMER
0x58002C00 LPTIM4 — LPTIMER
0x58003000 LPTIM5 — LPTIMER
0x58003C00 VREFBUF
0x58004000 RTC — Real-Time Clock
0x58004400 TAMP — Tamper and backup registers
0x58004800 IWDG
0x58006800 DTS
0x58020000 GPIOA — General Purpose I/O
0x58020400 GPIOB — General Purpose I/O
0x58020800 GPIOC — General Purpose I/O
0x58020C00 GPIOD — General Purpose I/O
0x58021000 GPIOE — General Purpose I/O
0x58021400 GPIOF — General Purpose I/O
0x58021800 GPIOG — General Purpose I/O
0x58021C00 GPIOH — General Purpose I/O
0x58023000 GPIOM — General Purpose I/O
0x58023400 GPION — General Purpose I/O
0x58023800 GPIOO — General Purpose I/O
0x58023C00 GPIOP — General Purpose I/O
0x58024400 RCC — Reset and Clock Control
0x58024800 PWR — Power Control
0x58024C00 CRC — CRC calculation unit
0x58027000 RAMECC2
0x5C001000 DBGMCU — Debug MCU
{0xBFF01000+0x1000*n} AXIM_AMIB_{n} (n=1..10)
{0xBFF41000+0x1000*n} AXIM_ASIB_{n} (n=1..11) — AXIM ASIB

## Interrupts
2 DTS — Digital Temperature Sensor interrupt
3 IWDG — Internal Watchdog interrupt
4 WWDG — Window Watchdog interrupt
5 RCC — RCC global interrupts through EXTI Line detection
8 FLASH — FLASH interrupts
9 RAMECC (RAMECC1, RAMECC2) — RAMECC interrupts
13 TAMP — Tamper and TimeStamp interrupts through EXTI Line detection
{n+16} EXTI{n} (EXTI) (n=0..15) — EXTI Line{n} interrupt
32 RTC — RTC Wakeup and Alarm interrupts through EXTI Line detection
33 SAES — SAES interrupt
34 CRYP — CRYP interrupt
35 PKA — PKA interrupt
36 HASH — HASH interrupt
37 RNG — RNG global interrupt
38 ADC1_2 (ADC1) — ADC1 & ADC2 interrupt
{n+39} GPDMA1_Channel{n} (GPDMA1) (n=0..7) — GPDMA1 Channel {n} interrupt
47 TIM1_BRK (TIM1) — TIM1 Break interrupt
48 TIM1_UP (TIM1) — TIM1 Update interrupt
49 TIM1_TRG_COM (TIM1) — TIM1 Trigger and Commutation interrupt
50 TIM1_CC (TIM1) — TIM1 Capture Compare interrupt
51 TIM2 — TIM2 global interrupt
52 TIM3 — TIM3 global interrupt
53 TIM4 — TIM4 global interrupt
54 TIM5 — TIM5 global interrupt
55 TIM6 — TIM6 global interrupt
56 TIM7 — TIM7 global interrupt
57 TIM9 — TIM9 global interrupt
58 SPI1 — SPI1 global interrupt
59 SPI2 — SPI2 global interrupt
60 SPI3 — SPI3 global interrupt
61 SPI4 — SPI4 global interrupt
62 SPI5 — SPI5 global interrupt
63 SPI6 — SPI6 global interrupt
{n+64} HPDMA1_Channel{n} (HPDMA1) (n=0..7) — HPDMA1 Channel {n} global interrupt
72 SAI1_A (SAI1) — Serial Audio Interface 1 block A interrupt
73 SAI1_B (SAI1) — Serial Audio Interface 1 block B interrupt
74 SAI2_A (SAI2) — Serial Audio Interface 2 block A interrupt
75 SAI2_B (SAI2) — Serial Audio Interface 2 block B interrupt
76 I2C1_EV (I2C1) — I2C1 event interrupt
77 I2C1_ER (I2C1) — I2C1 error interrupt
78 I2C2_EV (I2C2) — I2C2 event interrupt
79 I2C2_ER (I2C2) — I2C2 error interrupt
80 I2C3_EV (I2C3) — I2C3 event interrupt
81 I2C3_ER (I2C3) — I2C3 error interrupt
82 USART1 — USART1 global interrupt
83 USART2 — USART2 global interrupt
84 USART3 — USART3 global interrupt
85 UART4 — UART4 global interrupt
86 UART5 — UART5 global interrupt
87 UART7 — UART7 global interrupt
88 UART8 — UART8 global interrupt
89 I3C1_EV (I3C1) — I3C1 event interrupt
90 I3C1_ER (I3C1) — I3C1 error interrupt
91 OTG_HS (USB_OTG_HS) — USB OTG HS interrupt
92 ETH — Ethernet global interrupt
93 CORDIC — CORDIC global interrupt
94 GFXTIM — GFXTIM global interrupt
95 DCMIPP — DCMIPP global interrupt
96 LTDC — LTDC global interrupt
97 LTDC_ER (LTDC) — LTDC error global interrupt
98 DMA2D — DMA2D global interrupt
99 JPEG — JPEG global interrupt
100 GFXMMU — GFXMMU global interrupt
101 I3C1_WKUP (I3C1) — I3C1 wakeup global interrupt
102 MCE1 — MCE1 global interrupt
103 MCE2 — MCE2 global interrupt
104 MCE3 — MCE3 global interrupt
105 XSPI1 — XSPI1 global interrupt
106 XSPI2 — XSPI2 global interrupt
108 SDMMC1 — SDMMC1 global interrupt
109 SDMMC2 — SDMMC2 global interrupt
112 OTG_FS (USB_OTG_FS) — USB OTG FS interrupt
113 TIM12 — TIM12 global interrupt
114 TIM13 — TIM13 global interrupt
115 TIM14 — TIM14 global interrupt
116 TIM15 — TIM15 global interrupt
117 TIM16 — TIM16 global interrupt
118 TIM17 — TIM17 global interrupt
119 LPTIM1 — LPTIM1 global interrupt
120 LPTIM2 — LPTIM2 global interrupt
121 LPTIM3 — LPTIM3 global interrupt
122 LPTIM4 — LPTIM4 global interrupt
123 LPTIM5 — LPTIM5 global interrupt
125 MDIOS — MDIOS global interrupt
126 ADF1_FLT0 (ADF1) — ADF1 Filter 0 global Interrupt
127 CRS — CRS global interrupt
128 UCPD1 — UCPD1 global interrupt
129 CEC — HDMI_CEC global Interrupt
130 PSSI — PSSI global interrupt
131 LPUART1 — LPUART1 global interrupt
{n+125} GPDMA1_Channel{n} (GPDMA1) (n=8..15) — GPDMA1 Channel {n} global interrupt
{n+133} HPDMA1_Channel{n} (HPDMA1) (n=8..15) — HPDMA1 Channel {n} global interrupt
151 ICACHE — ICACHE interrupt
152 FDCAN1_IT0 (FDCAN1) — FDCAN1 interrupt 0
153 FDCAN1_IT1 (FDCAN1) — FDCAN1 interrupt 1
154 FDCAN2_IT0 (FDCAN2) — FDCAN2 interrupt 0
155 FDCAN2_IT1 (FDCAN2) — FDCAN2 interrupt 1

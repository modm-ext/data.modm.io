# STM32F103xG register map
File version: 1.0
Registers are 32-bit, read-write, reset 0x0 unless marked. A register's access mark holds for its fields unless they carry their own. Offsets are from the block's base; lines under a group give offsets from that group; [hi:lo] are bit positions; {n}, {i} and the like mark numbered series; 'fields as' and 'values as' point back to an identical list; <NAME> marks a mode.

## Memory map
0x1FFFF800 OB — Option Bytes Registers
0x40000000 TIM2 — TIM Timers
0x40000400 TIM3 — TIM Timers
0x40000800 TIM4 — TIM Timers
0x40000C00 TIM5 — TIM Timers
0x40001000 TIM6 — TIM Timers
0x40001400 TIM7 — TIM Timers
0x40001800 TIM12 — TIM Timers
0x40001C00 TIM13 — TIM Timers
0x40002000 TIM14 — TIM Timers
0x40002800 RTC — Real-Time Clock
0x40002C00 WWDG — Window WATCHDOG
0x40003000 IWDG — Independent WATCHDOG
0x40003800 SPI2 — Serial Peripheral Interface
0x40003C00 SPI3 — Serial Peripheral Interface
0x40004400 USART2 — Universal Synchronous Asynchronous Receiver Transmitter
0x40004800 USART3 — Universal Synchronous Asynchronous Receiver Transmitter
0x40004C00 UART4 — Universal Synchronous Asynchronous Receiver Transmitter
0x40005000 UART5 — Universal Synchronous Asynchronous Receiver Transmitter
0x40005400 I2C1 — Inter Integrated Circuit Interface
0x40005800 I2C2 — Inter Integrated Circuit Interface
0x40005C00 USB — Universal Serial Bus Full Speed Device
0x40006400 CAN1 — Controller Area Network
0x40006C00 BKP — Backup Registers
0x40007000 PWR — Power Control
0x40007400 DAC — Digital to Analog Converter
0x40007400 DAC1 — Digital to Analog Converter
0x40010000 AFIO — Alternate Function I/O
0x40010400 EXTI — External Interrupt/Event Controller
0x40010800 GPIOA — General Purpose I/O
0x40010C00 GPIOB — General Purpose I/O
0x40011000 GPIOC — General Purpose I/O
0x40011400 GPIOD — General Purpose I/O
0x40011800 GPIOE — General Purpose I/O
0x40011C00 GPIOF — General Purpose I/O
0x40012000 GPIOG — General Purpose I/O
0x40012400 ADC1 — Analog to Digital Converter
0x40012400 ADC12_COMMON
0x40012800 ADC2 — Analog to Digital Converter
0x40012C00 TIM1 — TIM Timers
0x40013000 SPI1 — Serial Peripheral Interface
0x40013400 TIM8 — TIM Timers
0x40013800 USART1 — Universal Synchronous Asynchronous Receiver Transmitter
0x40013C00 ADC3 — Analog to Digital Converter
0x40014C00 TIM9 — TIM Timers
0x40015000 TIM10 — TIM Timers
0x40015400 TIM11 — TIM Timers
0x40018000 SDIO — SD host Interface
0x40020000 DMA1
0x40020400 DMA2
0x40021000 RCC — Reset and Clock Control
0x40022000 FLASH — FLASH Registers
0x40023000 CRC — CRC calculation unit
0xA0000000 FSMC
0xA0000060 FSMC_Bank2_3 — Flexible Static Memory Controller Bank2
0xA0000104 FSMC_Bank1E — Flexible Static Memory Controller Bank1E
0xE0042000 DBGMCU — Debug MCU

## Interrupts
0 WWDG — Window WatchDog Interrupt
3 RTC — RTC global Interrupt
4 FLASH — FLASH global Interrupt
5 RCC — RCC global Interrupt
6 EXTI0 (EXTI) — EXTI Line0 Interrupt
7 EXTI1 (EXTI) — EXTI Line1 Interrupt
8 EXTI2 (EXTI) — EXTI Line2 Interrupt
9 EXTI3 (EXTI) — EXTI Line3 Interrupt
10 EXTI4 (EXTI) — EXTI Line4 Interrupt
11 DMA1_Channel1 (DMA1) — DMA1 Channel 1 global Interrupt
12 DMA1_Channel2 (DMA1) — DMA1 Channel 2 global Interrupt
13 DMA1_Channel3 (DMA1) — DMA1 Channel 3 global Interrupt
14 DMA1_Channel4 (DMA1) — DMA1 Channel 4 global Interrupt
15 DMA1_Channel5 (DMA1) — DMA1 Channel 5 global Interrupt
16 DMA1_Channel6 (DMA1) — DMA1 Channel 6 global Interrupt
17 DMA1_Channel7 (DMA1) — DMA1 Channel 7 global Interrupt
18 ADC1_2 (ADC1) — ADC1 and ADC2 global Interrupt
19 USB_HP_CAN1_TX (USB, CAN1) — USB Device High Priority or CAN1 TX Interrupts
20 USB_LP_CAN1_RX0 (USB, CAN1) — USB Device Low Priority or CAN1 RX0 Interrupts
21 CAN1_RX1 (CAN1) — CAN1 RX1 Interrupt
22 CAN1_SCE (CAN1) — CAN1 SCE Interrupt
23 EXTI9_5 (EXTI) — External Line[9:5] Interrupts
24 TIM1_BRK_TIM9 (TIM1, TIM9) — TIM1 Break Interrupt and TIM9 global Interrupt
25 TIM1_UP_TIM10 (TIM10) — TIM1 Update Interrupt and TIM10 global Interrupt
26 TIM1_TRG_COM_TIM11 (TIM11) — TIM1 Trigger and Commutation Interrupt and TIM11 global interrupt
27 TIM1_CC (TIM1) — TIM1 Capture Compare Interrupt
28 TIM2 — TIM2 global Interrupt
29 TIM3 — TIM3 global Interrupt
30 TIM4 — TIM4 global Interrupt
31 I2C1_EV (I2C1) — I2C1 Event Interrupt
32 I2C1_ER (I2C1) — I2C1 Error Interrupt
33 I2C2_EV (I2C2) — I2C2 Event Interrupt
34 I2C2_ER (I2C2) — I2C2 Error Interrupt
35 SPI1 — SPI1 global Interrupt
36 SPI2 — SPI2 global Interrupt
37 USART1 — USART1 global Interrupt
38 USART2 — USART2 global Interrupt
39 USART3 — USART3 global Interrupt
40 EXTI15_10 (EXTI) — External Line[15:10] Interrupts
41 RTC_Alarm (RTC) — RTC Alarm through EXTI Line Interrupt
43 TIM8_BRK_TIM12 (TIM12, TIM8) — TIM8 Break Interrupt and TIM12 global Interrupt
44 TIM8_UP_TIM13 (TIM13, TIM8) — TIM8 Update Interrupt and TIM13 global Interrupt
45 TIM8_TRG_COM_TIM14 (TIM14, TIM8) — TIM8 Trigger and Commutation Interrupt and TIM14 global interrupt
46 TIM8_CC (TIM8) — TIM8 Capture Compare Interrupt
47 ADC3 — ADC3 global Interrupt
48 FSMC — FSMC global Interrupt
49 SDIO — SDIO global Interrupt
50 TIM5 — TIM5 global Interrupt
51 SPI3 — SPI3 global Interrupt
52 UART4 — UART4 global Interrupt
53 UART5 — UART5 global Interrupt
54 TIM6 — TIM6 global Interrupt
55 TIM7 — TIM7 global Interrupt
56 DMA2_Channel1 (DMA2) — DMA2 Channel 1 global Interrupt
57 DMA2_Channel2 (DMA2) — DMA2 Channel 2 global Interrupt
58 DMA2_Channel3 (DMA2) — DMA2 Channel 3 global Interrupt
59 DMA2_Channel4_5 (DMA2) — DMA2 Channel 4 and Channel 5 global Interrupt

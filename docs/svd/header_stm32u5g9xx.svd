# STM32U5G9xx register map
File version: 1.0
Registers are 32-bit, read-write, reset 0x0 unless marked. A register's access mark holds for its fields unless they carry their own. Offsets are from the block's base; lines under a group give offsets from that group; [hi:lo] are bit positions; {n}, {i} and the like mark numbered series; 'fields as' and 'values as' point back to an identical list; <NAME> marks a mode.

## Memory map
0x0BF99E40 RSSLIB_PFUNC — RSSLib function pointer structure
0x40000000 TIM2 — TIM
0x40000400 TIM3 — TIM
0x40000800 TIM4 — TIM
0x40000C00 TIM5 — TIM
0x40001000 TIM6 — TIM
0x40001400 TIM7 — TIM
0x40002C00 WWDG
0x40003000 IWDG
0x40003800 SPI2 — SPI
0x40004400 USART2 — Universal Synchronous Asynchronous Receiver Transmitter
0x40004800 USART3 — Universal Synchronous Asynchronous Receiver Transmitter
0x40004C00 UART4 — Universal Synchronous Asynchronous Receiver Transmitter
0x40005000 UART5 — Universal Synchronous Asynchronous Receiver Transmitter
0x40005400 I2C1 — Inter-integrated Circuit Interface
0x40005800 I2C2 — Inter-integrated Circuit Interface
0x40006000 CRS — Clock Recovery System
0x40006400 USART6 — Universal Synchronous Asynchronous Receiver Transmitter
0x40008400 I2C4 — Inter-integrated Circuit Interface
0x40009400 LPTIM2 — LPTIMER
0x40009800 I2C5 — Inter-integrated Circuit Interface
0x40009C00 I2C6 — Inter-integrated Circuit Interface
0x4000A400 FDCAN1 — FD Controller Area Network
0x4000A500 FDCAN_CONFIG — FD Controller Area Network Configuration
0x4000DC00 UCPD1 — UCPD
0x40012C00 TIM1 — TIM
0x40013000 SPI1 — SPI
0x40013400 TIM8 — TIM
0x40013800 USART1 — Universal Synchronous Asynchronous Receiver Transmitter
0x40014000 TIM15 — TIM
0x40014400 TIM16 — TIM
0x40014800 TIM17 — TIM
0x40015400 SAI1 — Serial Audio Interface
0x40015800 SAI2 — Serial Audio Interface
0x40016400 GFXTIM
0x40016800 LTDC — LCD-TFT Display Controller
0x40016C00 DSI — DSI Controller
0x40020000 GPDMA1 — DMA Controller
0x40021000 CORDIC
0x40021400 FMAC
0x40022000 FLASH — FLASH Registers
0x40023000 CRC — CRC calculation unit
0x40024000 TSC — Touch Sensing Controller (TSC)
0x40025000 MDF1 — MDF/ADF
0x40026000 RAMCFG
0x40026100 RAMCFG_BKPRAM — SRAMs configuration controller
0x4002A000 JPEG — JPEG Codec
0x4002B000 DMA2D — DMA2D Controller
0x4002C000 GFXMMU — GFXMMU registers
0x40030400 ICACHE — Instruction Cache
0x40031400 DCACHE1 — Data Cache
0x40031800 DCACHE2 — Data Cache
0x40032400 GTZC_TZSC1 — Global TrustZone Controller
0x40032800 GTZC_TZIC1
0x40032C00 GTZC_MPCBB1
0x40033000 GTZC_MPCBB2
0x40033400 GTZC_MPCBB3
0x40033800 GTZC_MPCBB5
0x40033C00 GTZC_MPCBB6
0x42020000 GPIOA — General Purpose I/O
0x42020400 GPIOB — General Purpose I/O
0x42020800 GPIOC — General Purpose I/O
0x42020C00 GPIOD — General Purpose I/O
0x42021000 GPIOE — General Purpose I/O
0x42021400 GPIOF — General Purpose I/O
0x42021800 GPIOG — General Purpose I/O
0x42021C00 GPIOH — General Purpose I/O
0x42022000 GPIOI — General Purpose I/O
0x42022400 GPIOJ — General Purpose I/O
0x42028000 ADC1 — ADC
0x42028100 ADC2 — ADC
0x42028300 ADC12_COMMON
0x4202C000 DCMI
0x4202C400 PSSI
0x42040000 USB_OTG_HS — USB_OTG_Core_register
0x420C0000 AES — AES hardware accelerator
0x420C0400 HASH
0x420C0800 RNG
0x420C0C00 SAES — AES hardware accelerator
0x420C2000 PKA
0x420C4000 OCTOSPIM — Serial Peripheral Interface IO Manager
0x420C5000 OTFDEC1
0x420C5400 OTFDEC2
0x420C8000 SDMMC1 — Secure digital input/output Interface
0x420C8400 DLYB_SDMMC1 — Delay Block DLYB
0x420C8800 DLYB_SDMMC2 — Delay Block DLYB
0x420C8C00 SDMMC2 — Secure digital input/output Interface
0x420CF000 DLYB_OCTOSPI1 — Delay Block DLYB
0x420CF400 DLYB_OCTOSPI2 — Delay Block DLYB
0x420D0400 FMC_Bank1_R — Flexible Memory Controller
0x420D0480 FMC_Bank3_R — Flexible Memory Controller Bank3
0x420D0504 FMC_Bank1E_R — Flexible Memory Controller Bank1E
0x420D1400 OCTOSPI1 — HEXA and OCTO Serial Peripheral Interface
0x420D2400 OCTOSPI2 — HEXA and OCTO Serial Peripheral Interface
0x420D3400 HSPI1 — HEXA and OCTO Serial Peripheral Interface
0x46000400 SYSCFG — System configuration controller
0x46002000 SPI3 — SPI
0x46002400 LPUART1 — Universal Synchronous Asynchronous Receiver Transmitter
0x46002800 I2C3 — Inter-integrated Circuit Interface
0x46004400 LPTIM1 — LPTIMER
0x46004800 LPTIM3 — LPTIMER
0x46004C00 LPTIM4 — LPTIMER
0x46005000 OPAMP12_COMMON
0x46005000 OPAMP1 — Operational Amplifier (OPAMP)
0x46005000 OPAMP — Operational Amplifier (OPAMP)
0x46005010 OPAMP2 — Operational Amplifier (OPAMP)
0x46005400 COMP12 — Comparator
0x46005400 COMP1 — Comparator
0x46005404 COMP2 — Comparator
0x46007400 VREFBUF
0x46007800 RTC — Real-Time Clock
0x46007C00 TAMP — Tamper and backup registers
0x46020000 LPGPIO1 — General Purpose I/O
0x46020800 PWR — Power Control
0x46020C00 RCC — Reset and Clock Control
0x46021000 ADC4 — ADC
0x46021800 DAC1 — DAC
0x46022000 EXTI — Asynch Interrupt/Event Controller (EXTI)
0x46023000 GTZC_TZSC2 — Global TrustZone Controller
0x46023400 GTZC_TZIC2
0x46023800 GTZC_MPCBB4
0x46024000 ADF1 — MDF/ADF
0x46025000 LPDMA1 — DMA Controller
0x50000000 TIM2_S — TIM
0x50000400 TIM3_S — TIM
0x50000800 TIM4_S — TIM
0x50000C00 TIM5_S — TIM
0x50001000 TIM6_S — TIM
0x50001400 TIM7_S — TIM
0x50002C00 WWDG_S — WWDG
0x50003000 IWDG_S — IWDG
0x50003800 SPI2_S — SPI
0x50004400 USART2_S — Universal Synchronous Asynchronous Receiver Transmitter
0x50004800 USART3_S — Universal Synchronous Asynchronous Receiver Transmitter
0x50004C00 UART4_S — Universal Synchronous Asynchronous Receiver Transmitter
0x50005000 UART5_S — Universal Synchronous Asynchronous Receiver Transmitter
0x50005400 I2C1_S — Inter-integrated Circuit Interface
0x50005800 I2C2_S — Inter-integrated Circuit Interface
0x50006000 CRS_S — Clock Recovery System
0x50006400 USART6_S — Universal Synchronous Asynchronous Receiver Transmitter
0x50008400 I2C4_S — Inter-integrated Circuit Interface
0x50009400 LPTIM2_S — LPTIMER
0x50009800 I2C5_S — Inter-integrated Circuit Interface
0x50009C00 I2C6_S — Inter-integrated Circuit Interface
0x5000A400 FDCAN1_S — FD Controller Area Network
0x5000A500 FDCAN_CONFIG_S — FD Controller Area Network Configuration
0x5000DC00 UCPD1_S — UCPD
0x50012C00 TIM1_S — TIM
0x50013000 SPI1_S — SPI
0x50013400 TIM8_S — TIM
0x50013800 USART1_S — Universal Synchronous Asynchronous Receiver Transmitter
0x50014000 TIM15_S — TIM
0x50014400 TIM16_S — TIM
0x50014800 TIM17_S — TIM
0x50015400 SAI1_S — Serial Audio Interface
0x50015800 SAI2_S — Serial Audio Interface
0x50016400 GFXTIM_S — GFXTIM
0x50016800 LTDC_S — LCD-TFT Display Controller
0x50016C00 DSI_S — DSI Controller
0x50020000 GPDMA1_S — DMA Controller
0x50021000 CORDIC_S — CORDIC
0x50021400 FMAC_S — FMAC
0x50022000 FLASH_S — FLASH Registers
0x50023000 CRC_S — CRC calculation unit
0x50024000 TSC_S — Touch Sensing Controller (TSC)
0x50025000 MDF1_S — MDF/ADF
0x50026000 RAMCFG_S
0x50026100 RAMCFG_BKPRAM_S — SRAMs configuration controller
0x5002A000 JPEG_S — JPEG Codec
0x5002B000 DMA2D_S — DMA2D Controller
0x5002C000 GFXMMU_S — GFXMMU registers
0x50030400 ICACHE_S — Instruction Cache
0x50031400 DCACHE1_S — Data Cache
0x50031800 DCACHE2_S — Data Cache
0x50032400 GTZC_TZSC1_S — Global TrustZone Controller
0x50032800 GTZC_TZIC1_S
0x50032C00 GTZC_MPCBB1_S
0x50033000 GTZC_MPCBB2_S
0x50033400 GTZC_MPCBB3_S
0x50033800 GTZC_MPCBB5_S
0x50033C00 GTZC_MPCBB6_S
0x52020000 GPIOA_S — General Purpose I/O
0x52020400 GPIOB_S — General Purpose I/O
0x52020800 GPIOC_S — General Purpose I/O
0x52020C00 GPIOD_S — General Purpose I/O
0x52021000 GPIOE_S — General Purpose I/O
0x52021400 GPIOF_S — General Purpose I/O
0x52021800 GPIOG_S — General Purpose I/O
0x52021C00 GPIOH_S — General Purpose I/O
0x52022000 GPIOI_S — General Purpose I/O
0x52022400 GPIOJ_S — General Purpose I/O
0x52028000 ADC1_S — ADC
0x52028100 ADC2_S — ADC
0x52028300 ADC12_COMMON_S
0x5202C000 DCMI_S — DCMI
0x5202C400 PSSI_S — PSSI
0x52040000 USB_OTG_HS_S — USB_OTG_Core_register
0x520C0000 AES_S — AES hardware accelerator
0x520C0400 HASH_S — HASH
0x520C0800 RNG_S — RNG
0x520C0C00 SAES_S — AES hardware accelerator
0x520C2000 PKA_S — PKA
0x520C4000 OCTOSPIM_S — Serial Peripheral Interface IO Manager
0x520C5000 OTFDEC1_S
0x520C5400 OTFDEC2_S
0x520C8000 SDMMC1_S — Secure digital input/output Interface
0x520C8400 DLYB_SDMMC1_S — Delay Block DLYB
0x520C8800 DLYB_SDMMC2_S — Delay Block DLYB
0x520C8C00 SDMMC2_S — Secure digital input/output Interface
0x520CF000 DLYB_OCTOSPI1_S — Delay Block DLYB
0x520CF400 DLYB_OCTOSPI2_S — Delay Block DLYB
0x520D0400 FMC_Bank1_R_S — Flexible Memory Controller
0x520D0480 FMC_Bank3_R_S — Flexible Memory Controller Bank3
0x520D0504 FMC_Bank1E_R_S — Flexible Memory Controller Bank1E
0x520D1400 OCTOSPI1_S — HEXA and OCTO Serial Peripheral Interface
0x520D2400 OCTOSPI2_S — HEXA and OCTO Serial Peripheral Interface
0x520D3400 HSPI1_S — HEXA and OCTO Serial Peripheral Interface
0x56000400 SYSCFG_S — System configuration controller
0x56002000 SPI3_S — SPI
0x56002400 LPUART1_S — Universal Synchronous Asynchronous Receiver Transmitter
0x56002800 I2C3_S — Inter-integrated Circuit Interface
0x56004400 LPTIM1_S — LPTIMER
0x56004800 LPTIM3_S — LPTIMER
0x56004C00 LPTIM4_S — LPTIMER
0x56005000 OPAMP12_COMMON_S
0x56005000 OPAMP1_S — Operational Amplifier (OPAMP)
0x56005000 OPAMP_S — Operational Amplifier (OPAMP)
0x56005010 OPAMP2_S — Operational Amplifier (OPAMP)
0x56005400 COMP12_S — Comparator
0x56005400 COMP1_S — Comparator
0x56005404 COMP2_S — Comparator
0x56007400 VREFBUF_S — VREFBUF
0x56007800 RTC_S — Real-Time Clock
0x56007C00 TAMP_S — Tamper and backup registers
0x56020000 LPGPIO1_S — General Purpose I/O
0x56020800 PWR_S — Power Control
0x56020C00 RCC_S — Reset and Clock Control
0x56021000 ADC4_S — ADC
0x56021800 DAC1_S — DAC
0x56022000 EXTI_S — Asynch Interrupt/Event Controller (EXTI)
0x56023000 GTZC_TZSC2_S — Global TrustZone Controller
0x56023400 GTZC_TZIC2_S
0x56023800 GTZC_MPCBB4_S
0x56024000 ADF1_S — MDF/ADF
0x56025000 LPDMA1_S — DMA Controller
0xE0044000 DBGMCU — Debug MCU

## Interrupts
0 WWDG — Window WatchDog interrupt
2 RTC — RTC non-secure interrupt
3 RTC_S — RTC secure interrupt
4 TAMP — Tamper global interrupt
5 RAMCFG — RAMCFG global interrupt
6 FLASH — FLASH non-secure global interrupt
7 FLASH_S — FLASH secure global interrupt
9 RCC — RCC non secure global interrupt
10 RCC_S — RCC secure global interrupt
{n+11} EXTI{n} (EXTI) (n=0..15) — EXTI Line{n} interrupt
27 IWDG — IWDG global interrupt
28 SAES — Secure AES global interrupt
{n+29} GPDMA1_Channel{n} (GPDMA1) (n=0..7) — GPDMA1 Channel {n} global interrupt
37 ADC1_2 (ADC1) — ADC1_2 global interrupt
38 DAC1 — DAC1 global interrupt
39 FDCAN1_IT0 (FDCAN1) — FDCAN1 interrupt 0
40 FDCAN1_IT1 (FDCAN1) — FDCAN1 interrupt 1
41 TIM1_BRK (TIM1) — TIM1 Break interrupt
42 TIM1_UP (TIM1) — TIM1 Update interrupt
43 TIM1_TRG_COM (TIM1) — TIM1 Trigger and Commutation interrupt
44 TIM1_CC (TIM1) — TIM1 Capture Compare interrupt
45 TIM2 — TIM2 global interrupt
46 TIM3 — TIM3 global interrupt
47 TIM4 — TIM4 global interrupt
48 TIM5 — TIM5 global interrupt
49 TIM6 — TIM6 global interrupt
50 TIM7 — TIM7 global interrupt
51 TIM8_BRK (TIM8) — TIM8 Break interrupt
52 TIM8_UP (TIM8) — TIM8 Update interrupt
53 TIM8_TRG_COM (TIM8) — TIM8 Trigger and Commutation interrupt
54 TIM8_CC (TIM8) — TIM8 Capture Compare interrupt
55 I2C1_EV (I2C1) — I2C1 Event interrupt
56 I2C1_ER (I2C1) — I2C1 Error interrupt
57 I2C2_EV (I2C2) — I2C2 Event interrupt
58 I2C2_ER (I2C2) — I2C2 Error interrupt
59 SPI1 — SPI1 global interrupt
60 SPI2 — SPI2 global interrupt
61 USART1 — USART1 global interrupt
62 USART2 — USART2 global interrupt
63 USART3 — USART3 global interrupt
64 UART4 — UART4 global interrupt
65 UART5 — UART5 global interrupt
66 LPUART1 — LPUART1 global interrupt
67 LPTIM1 — LPTIM1 global interrupt
68 LPTIM2 — LPTIM2 global interrupt
69 TIM15 — TIM15 global interrupt
70 TIM16 — TIM16 global interrupt
71 TIM17 — TIM17 global interrupt
72 COMP (COMP12, COMP2) — COMP1 and COMP2 through EXTI Lines interrupts
73 OTG_HS (USB_OTG_HS) — USB OTG HS global interrupt
74 CRS — CRS global interrupt
76 OCTOSPI1 — OctoSPI1 global interrupt
77 PWR_S3WU (PWR) — PWR wake up from Stop3 interrupt
78 SDMMC1 — SDMMC1 global interrupt
79 SDMMC2 — SDMMC2 global interrupt
{n+72} GPDMA1_Channel{n} (GPDMA1) (n=8..15) — GPDMA1 Channel {n} global interrupt
88 I2C3_EV (I2C3) — I2C3 event interrupt
89 I2C3_ER (I2C3) — I2C3 error interrupt
90 SAI1 — Serial Audio Interface 1 global interrupt
91 SAI2 — Serial Audio Interface 2 global interrupt
92 TSC — Touch Sense Controller global interrupt
93 AES — AES global interrupt
94 RNG — RNG global interrupt
96 HASH — HASH global interrupt
97 PKA — PKA global interrupt
98 LPTIM3 — LPTIM3 global interrupt
99 SPI3 — SPI3 global interrupt
100 I2C4_ER (I2C4) — I2C4 Error interrupt
101 I2C4_EV (I2C4) — I2C4 Event interrupt
102 MDF1_FLT0 (MDF1) — MDF1 Filter 0 global interrupt
103 MDF1_FLT1 (MDF1) — MDF1 Filter 1 global interrupt
104 MDF1_FLT2 (MDF1) — MDF1 Filter 2 global interrupt
105 MDF1_FLT3 (MDF1) — MDF1 Filter 3 global interrupt
106 UCPD1 — UCPD1 global interrupt
107 ICACHE — Instruction cache global interrupt
108 OTFDEC1 — OTFDEC1 global interrupt
109 OTFDEC2 — OTFDEC2 global interrupt
110 LPTIM4 — LPTIM4 global interrupt
111 DCACHE1 — Data cache global interrupt
112 ADF1 — ADF interrupt
113 ADC4 — ADC4 (12bits) global interrupt
114 LPDMA1_Channel0 (LPDMA1) — LPDMA1 SmartRun Channel 0 global interrupt
115 LPDMA1_Channel1 (LPDMA1) — LPDMA1 SmartRun Channel 1 global interrupt
116 LPDMA1_Channel2 (LPDMA1) — LPDMA1 SmartRun Channel 2 global interrupt
117 LPDMA1_Channel3 (LPDMA1) — LPDMA1 SmartRun Channel 3 global interrupt
118 DMA2D — DMA2D global interrupt
119 DCMI_PSSI (DCMI, PSSI) — DCMI/PSSI global interrupt
120 OCTOSPI2 — OCTOSPI2 global interrupt
121 MDF1_FLT4 (MDF1) — MDF1 Filter 4 global interrupt
122 MDF1_FLT5 (MDF1) — MDF1 Filter 5 global interrupt
123 CORDIC — CORDIC global interrupt
124 FMAC — FMAC global interrupt
126 USART6 — USART6 global interrupt
127 I2C5_ER (I2C5) — I2C5 Error interrupt
128 I2C5_EV (I2C5) — I2C5 Event interrupt
129 I2C6_ER (I2C6) — I2C6 Error interrupt
130 I2C6_EV (I2C6) — I2C6 Error interrupt
131 HSPI1 — HSPI1 global interrupt
134 GFXMMU — GFXMMU global interrupt
135 LTDC — LCD-TFT global interrupt
136 LTDC_ER (LTDC) — LCD-TFT Error interrupt
137 DSI — DSIHOST global interrupt
138 DCACHE2 — DCACHE2 Data cache global interrupt
139 GFXTIM — GFXTIM global interrupt
140 JPEG — JPEG sync interrupt
